#include <SE05X.h>

// CAVS 11.1
const char currentTest[] = "FIPS186-3 - SigVerPSS_186-3 RSASSA-PSS: Mod Size 3072 with SHA-1(Salt len: 0)";

#define SHA1_LENGTH                 20
#define SHA224_LENGTH               28
#define SHA256_LENGTH               32
#define SHA384_LENGTH               48
#define SHA512_LENGTH               64

#define E_LEN                       4
#define N_LEN                       384
#define D_LEN                       384

#define S_LEN                       N_LEN
#define MSG_LEN                     128
#define HASH_LEN                    SHA1_LENGTH
#define SALT_LEN                    0 //Empty salt

// RSA Modulus (n)
const byte n[] = {0xfa, 0x15, 0x59, 0x40, 0x57, 0xe2, 0x1d, 0xfd, 0x0b, 0x41, 0xc9, 0x21, 0x62,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 0xce, 0xbd}; // Length: 384 bytes

// Public Exponent (e)
const byte e[6][4] = {
    {0x00, 0x0a, 0x67, 0x3f},
    {0x00, 0x0a, 0x67, 0x3f},
    {0x00, 0x0a, 0x67, 0x3f},
    {0x00, 0x0a, 0x67, 0x3f},
    {0x00, 0x0a, 0x67, 0x3f},
    {0x00, 0x0c, 0x9c, 0x31}
}; // 6 vectors, each of max length 4 bytes

// Private Exponent (d)
const byte d[6][384] = {
    {0x46, 0xdc, 0x5b, 0x6c, 0xac, 0xa5, 0xca, 0x0c, 0xb9, 0xa5, 0xca, 0xdf, 0x06,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 0xb1, 0x81},
    {0x46, 0xdc, 0x5b, 0x6c, 0xac, 0xa5, 0xca, 0x0c, 0xb9, 0xa5, 0xca, 0xdf, 0x06,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 0xb1, 0x81},
    {0x46, 0xdc, 0x5b, 0x6c, 0xac, 0xa5, 0xca, 0x0c, 0xb9, 0xa5, 0xca, 0xdf, 0x06,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 0xb1, 0x81},
    {0x46, 0xdc, 0x5b, 0x6c, 0xac, 0xa5, 0xca, 0x0c, 0xb9, 0xa5, 0xca, 0xdf, 0x06,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 0xb1, 0x81},
    {0x46, 0xdc, 0x5b, 0x6c, 0xac, 0xa5, 0xca, 0x0c, 0xb9, 0xa5, 0xca, 0xdf, 0x06,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 0xb1, 0x81},
    {0x46, 0xdc, 0x5b, 0x6c, 0xac, 0xa5, 0xca, 0x0c, 0xb9, 0xa5, 0xca, 0xdf, 0x06,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 0xb1, 0x81}
}; // 6 vectors, each of max length 384 bytes

// Messages (msg)
const byte msg[6][128] = {
    {0x34, 0x8d, 0x82, 0x53, 0xc3, 0xfd, 0x1e, 0x01, 0x75, 0xf2, 0x63, 0x08, 0x1c,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 0x21, 0xec},
    {0x07, 0xdd, 0x79, 0xfa, 0x6d, 0x61, 0x0e, 0x1c, 0x9f, 0x3c, 0x64, 0xa2, 0xb9,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 0x40, 0x2a},
    {0xb6, 0x1e, 0xab, 0xe9, 0xeb, 0x62, 0x74, 0x0c, 0x50, 0x0b, 0x32, 0xe9, 0xb0,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 0xc9, 0xa4},
    {0xe5, 0x94, 0xd6, 0x40, 0xdc, 0x2f, 0xb4, 0xd4, 0xd9, 0x52, 0x3e, 0xa1, 0x71,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 0x98, 0x3c},
    {0x74, 0x4a, 0x12, 0x8d, 0x95, 0x41, 0x61, 0x47, 0xb6, 0x35, 0xc3, 0xad, 0x24,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 0x7e, 0xcb},
    {0xea, 0xf9, 0x89, 0x92, 0x7d, 0x18, 0xe7, 0x89, 0xa4, 0xc2, 0xc8, 0x89, 0xfc,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 0x6c, 0x22}
}; // 6 vectors, each of max length 128 bytes

// Signatures (s)
const byte s[6][384] = {
    {0x72, 0x47, 0x18, 0x2f, 0x6a, 0x34, 0x68, 0x44, 0x02, 0x02, 0x8e, 0xb1, 0xf0,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 0x07, 0x03},
    {0xba, 0xfb, 0xff, 0x97, 0x0e, 0x29, 0xb5, 0x6a, 0xde, 0xd3, 0x54, 0xa1, 0x40,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 0xd1, 0x72},
    {0x09, 0xb5, 0x73, 0xed, 0x2b, 0xe2, 0x13, 0xb3, 0xe1, 0xad, 0x49, 0xab, 0x1f,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 0x5b, 0x64},
    {0x85, 0x65, 0x68, 0x0f, 0x99, 0x57, 0xf0, 0xdc, 0xb5, 0x40, 0xc1, 0xcb, 0x61,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 0xf6, 0xce},
    {0x28, 0x74, 0xdc, 0xd9, 0x99, 0x7e, 0x8f, 0x60, 0xed, 0x51, 0xf9, 0xc4, 0x72,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 0x1e, 0x7e},
    {0xa5, 0xdb, 0x83, 0xaa, 0x53, 0x18, 0xaa, 0xa5, 0xed, 0x79, 0xb8, 0xe2, 0xf7,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 0xc9, 0xef}
}; // 6 vectors, each of max length 384 bytes

// Salt Value (SaltVal)
uint8_t saltVal[6][1] = {
    {0x00},
    {0x00},
    {0x00},
    {0x00},
    {0x00},
    {0x00}
}; // 6 vectors, each of max length 1 bytes

// Expected results
bool result[] = { 0, 0, 0, 0, 1, 0 };
const int num_vectors = 6; // Number of test vectors

void printBufferHex(const byte input[], size_t inputLength)
{
  for (size_t i = 0; i < inputLength; i++) {
    Serial.print(input[i] >> 4, HEX);
    Serial.print(input[i] & 0x0f, HEX);
    Serial.print(",");
  }
  Serial.println();
}

void setup() {
  Serial.begin(9600);
  while (!Serial);

  if (!SE05X.begin()) {
    Serial.println("Failed to communicate with SE05X!");
    while (1);
  }

  Serial.println(currentTest);

  byte hash[HASH_LEN] = {0};
  size_t hashLen = HASH_LEN;
  byte emsa[N_LEN] = {0};
  size_t emsaLen = N_LEN;
  byte signature[N_LEN] = {0};
  size_t signatureLen = 0;

  const int KeyId = 9996;
  for(int i = 0; i < num_vectors; i++){

    SE05X.deleteBinaryObject(KeyId);
    SE05X.writeRSAKey(KeyId,
                      kSE05x_RSABitLength_3072,
                      NULL,
                      0,
                      NULL,
                      0,
                      NULL,
                      0,
                      NULL,
                      0,
                      NULL,
                      0,
                      &e[i][0],
                      E_LEN,
                      &d[i][0],
                      D_LEN,
                      n,
                      N_LEN,
                      kSE05x_RSAKeyFormat_RAW,
                      false,
                      kSE05x_KeyPart_Pair,
                      NULL);

    Serial.println("");
    Serial.print("Test ");
    Serial.println((i+1));

    // print the input
    Serial.print("Input is:                     ");
    printBufferHex(&msg[i][0], MSG_LEN);

    //calculate the input hash
    hashLen = HASH_LEN;
    SE05X.beginSHA1();
    SE05X.updateSHA1(&msg[i][0], MSG_LEN);
    SE05X.endSHA1(hash, &hashLen);

    Serial.print("Input SHA1 is:              ");
    printBufferHex(hash, hashLen);

    emsaLen = S_LEN;
    if(SALT_LEN == 0 && saltVal[i][0] == 0){
      SE05X.emsa_pss_encode(hash, hashLen, emsa, &emsaLen, kSE05x_RSASignatureAlgo_SHA1_PKCS1_PSS, kSE05x_RSABitLength_3072, NULL, SALT_LEN);
    }else{
      SE05X.emsa_pss_encode(hash, hashLen, emsa, &emsaLen, kSE05x_RSASignatureAlgo_SHA1_PKCS1_PSS, kSE05x_RSABitLength_3072, &saltVal[i][0], SALT_LEN);
    }
    Serial.print("emsa is:                     ");
    printBufferHex(emsa, emsaLen);

    // calculate the signature
    signatureLen = 0;
    SE05X.SignRSA(KeyId, emsa, emsaLen, signature, sizeof(signature), &signatureLen);

    // print the signature
    Serial.print("Signature using KeyId ");
    Serial.print(KeyId);
    Serial.print(" is: ");
    printBufferHex(signature, signatureLen);
    Serial.println();
    
    // To make the signature verifcation + the signature comparison fail, uncomment the next line:
    //signature[0] = 0x00;
    if(signatureLen == S_LEN){
      if(memcmp(&s[i][0],signature,signatureLen) == 0){
        Serial.println("SE050 Generated Signature matches test vector");
      }else{
        Serial.println("SE050 Generated Signature does not match test vector");
        Serial.print("Signature from test vector: ");
        printBufferHex(&s[i][0], S_LEN);
      }
    }else{
      Serial.println("SE050 Generated Signature does not match test vector");
      Serial.print("Signature from test vector: ");
      printBufferHex(&s[i][0], S_LEN);
    }


    // To make the signature verifcation fail, uncomment the next line:
    //signature[0] = 0x00;

    // validate the signature
    if (SE05X.VerifyRSASSA_PSS(KeyId, hash, hashLen, &s[i][0], S_LEN)){
      Serial.println("test vector Verified");
      if(result[i]){
        Serial.println("---TEST PASSED---");
      }else{
        Serial.println("---TEST FAILED---");
      }
    }
    else
    {
      Serial.println("failed to verify test vector");
      if(!result[i]){
        Serial.println("---TEST PASSED---");
      }else{
        Serial.println("---TEST FAILED---");
      }
    }
  }

  SE05X.deleteBinaryObject(KeyId);
}


void loop() {

}
