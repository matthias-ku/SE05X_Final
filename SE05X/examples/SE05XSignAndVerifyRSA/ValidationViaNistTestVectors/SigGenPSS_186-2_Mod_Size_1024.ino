#include <SE05X.h>

// CAVS 11.4
const char currentTest[] = "FIPS186-2 - SigGen PKCS#1 RSASSA-PSS: Mod Size 1024 with SHA-1 SHA-224 SHA-256 SHA-384 SHA-512";

#define SHA1_LENGTH                 20
#define SHA224_LENGTH               28
#define SHA256_LENGTH               32
#define SHA384_LENGTH               48
#define SHA512_LENGTH               64

#define E_LEN                       4
#define N_LEN                       128
#define D_LEN                       128

#define S_LEN                       N_LEN
#define MSG_LEN                     128
#define SALT_LEN                    20

// Hashing algorithm (sha_alg)
SE05x_RSASignatureAlgo_t sha_alg[] = {kSE05x_RSASignatureAlgo_SHA1_PKCS1_PSS, kSE05x_RSASignatureAlgo_SHA1_PKCS1_PSS, kSE05x_RSASignatureAlgo_SHA1_PKCS1_PSS, kSE05x_RSASignatureAlgo_SHA1_PKCS1_PSS, kSE05x_RSASignatureAlgo_SHA1_PKCS1_PSS, kSE05x_RSASignatureAlgo_SHA1_PKCS1_PSS, kSE05x_RSASignatureAlgo_SHA1_PKCS1_PSS, kSE05x_RSASignatureAlgo_SHA1_PKCS1_PSS, kSE05x_RSASignatureAlgo_SHA1_PKCS1_PSS, kSE05x_RSASignatureAlgo_SHA1_PKCS1_PSS,
     kSE05x_RSASignatureAlgo_SHA224_PKCS1_PSS, kSE05x_RSASignatureAlgo_SHA224_PKCS1_PSS, kSE05x_RSASignatureAlgo_SHA224_PKCS1_PSS, kSE05x_RSASignatureAlgo_SHA224_PKCS1_PSS, kSE05x_RSASignatureAlgo_SHA224_PKCS1_PSS, kSE05x_RSASignatureAlgo_SHA224_PKCS1_PSS, kSE05x_RSASignatureAlgo_SHA224_PKCS1_PSS, kSE05x_RSASignatureAlgo_SHA224_PKCS1_PSS, kSE05x_RSASignatureAlgo_SHA224_PKCS1_PSS, kSE05x_RSASignatureAlgo_SHA224_PKCS1_PSS, 
     kSE05x_RSASignatureAlgo_SHA256_PKCS1_PSS, kSE05x_RSASignatureAlgo_SHA256_PKCS1_PSS, kSE05x_RSASignatureAlgo_SHA256_PKCS1_PSS, kSE05x_RSASignatureAlgo_SHA256_PKCS1_PSS, kSE05x_RSASignatureAlgo_SHA256_PKCS1_PSS, kSE05x_RSASignatureAlgo_SHA256_PKCS1_PSS, kSE05x_RSASignatureAlgo_SHA256_PKCS1_PSS, kSE05x_RSASignatureAlgo_SHA256_PKCS1_PSS, kSE05x_RSASignatureAlgo_SHA256_PKCS1_PSS, kSE05x_RSASignatureAlgo_SHA256_PKCS1_PSS, 
     kSE05x_RSASignatureAlgo_SHA384_PKCS1_PSS, kSE05x_RSASignatureAlgo_SHA384_PKCS1_PSS, kSE05x_RSASignatureAlgo_SHA384_PKCS1_PSS, kSE05x_RSASignatureAlgo_SHA384_PKCS1_PSS, kSE05x_RSASignatureAlgo_SHA384_PKCS1_PSS, kSE05x_RSASignatureAlgo_SHA384_PKCS1_PSS, kSE05x_RSASignatureAlgo_SHA384_PKCS1_PSS, kSE05x_RSASignatureAlgo_SHA384_PKCS1_PSS, kSE05x_RSASignatureAlgo_SHA384_PKCS1_PSS, kSE05x_RSASignatureAlgo_SHA384_PKCS1_PSS, 
     kSE05x_RSASignatureAlgo_SHA512_PKCS1_PSS, kSE05x_RSASignatureAlgo_SHA512_PKCS1_PSS, kSE05x_RSASignatureAlgo_SHA512_PKCS1_PSS, kSE05x_RSASignatureAlgo_SHA512_PKCS1_PSS, kSE05x_RSASignatureAlgo_SHA512_PKCS1_PSS, kSE05x_RSASignatureAlgo_SHA512_PKCS1_PSS, kSE05x_RSASignatureAlgo_SHA512_PKCS1_PSS, kSE05x_RSASignatureAlgo_SHA512_PKCS1_PSS, kSE05x_RSASignatureAlgo_SHA512_PKCS1_PSS, kSE05x_RSASignatureAlgo_SHA512_PKCS1_PSS};
// Length: 50 values

// RSA Modulus (n)
const byte n[128] = {0xbc, 0xb4, 0x7b, 0x2e, 0x0d, 0xaf, 0xcb, 0xa8, 0x1f, 0xf2, 0xa2, 0xb5, 0xcb,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 0xe7, 0x6b}; // 1 vectors, each of max length 128 bytes

// Public Exponent (e)
const byte e[4] = {0x00, 0x01, 0x00, 0x01}; // 1 vectors, each of max length 4 bytes

// Private Exponent (d)
const byte d[128] = {0x38, 0x3a, 0x6f, 0x19, 0xe1, 0xea, 0x27, 0xfd, 0x08, 0xc7, 0xfb, 0xc3, 0xbf,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 0x25, 0xc1}; // 1 vectors, each of max length 128 bytes

// Messages (msg)
const byte msg[50][128] = {
    {0x12, 0x48, 0xf6, 0x2a, 0x43, 0x89, 0xf4, 0x2f, 0x7b, 0x4b, 0xb1, 0x31, 0x05,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 0x7b, 0x0c},
    {0x99, 0x68, 0x80, 0x9a, 0x55, 0x7b, 0xb4, 0xf8, 0x92, 0x03, 0x9f, 0xf2, 0xb6,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 0xc6, 0x2b},
    {0xf9, 0xbe, 0x76, 0xe9, 0xb0, 0x29, 0xc4, 0x93, 0x32, 0x60, 0x24, 0x9d, 0xd7,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 0xd9, 0xe1},
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    {0x5d, 0x95, 0x51, 0xdf, 0x21, 0x0c, 0xea, 0x61, 0xf9, 0xae, 0xc3, 0xd2, 0xef,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 0xfd, 0x3b}
}; // 50 vectors, each of max length 128 bytes

// Signatures (s)
const byte s[50][128] = {
    {0x68, 0x2c, 0xf5, 0x3c, 0x11, 0x45, 0xd2, 0x2a, 0x50, 0xca, 0xa9, 0xeb, 0x1a,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 0xb3, 0x1a},
    {0x8f, 0x5e, 0xa7, 0x03, 0x73, 0x67, 0xe0, 0xdb, 0x75, 0x67, 0x05, 0x04, 0x08,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 0x81, 0xdb},
    {0x4f, 0x7f, 0xf1, 0x12, 0xa7, 0x93, 0x77, 0x07, 0xd5, 0x29, 0xb5, 0x60, 0x2e,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 0x70, 0x2f},
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    {0x38, 0x88, 0x9a, 0x9f, 0x36, 0x46, 0xf6, 0x75, 0x67, 0x53, 0x8d, 0xe1, 0xdd,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 0x8d, 0xd1}
}; // 50 vectors, each of max length 128 bytes

// Salt Value (SaltVal)
uint8_t saltVal[50][20] = {
    {0x6f, 0x28, 0x41, 0x16, 0x6a, 0x64, 0x47, 0x1d, 0x4f, 0x0b, 0x8e, 0xd0, 0xdb, 0xb7, 0xdb, 0x32, 0x16, 0x1d, 0xa1, 0x3b},
    {0x6f, 0x28, 0x41, 0x16, 0x6a, 0x64, 0x47, 0x1d, 0x4f, 0x0b, 0x8e, 0xd0, 0xdb, 0xb7, 0xdb, 0x32, 0x16, 0x1d, 0xa1, 0x3b},
    {0x6f, 0x28, 0x41, 0x16, 0x6a, 0x64, 0x47, 0x1d, 0x4f, 0x0b, 0x8e, 0xd0, 0xdb, 0xb7, 0xdb, 0x32, 0x16, 0x1d, 0xa1, 0x3b},
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    {0x6f, 0x28, 0x41, 0x16, 0x6a, 0x64, 0x47, 0x1d, 0x4f, 0x0b, 0x8e, 0xd0, 0xdb, 0xb7, 0xdb, 0x32, 0x16, 0x1d, 0xa1, 0x3b}
}; // 50 vectors, each of max length 20 bytes

const int num_vectors = 50; // Number of test vectors

void printBufferHex(const byte input[], size_t inputLength)
{
  for (size_t i = 0; i < inputLength; i++) {
    Serial.print(input[i] >> 4, HEX);
    Serial.print(input[i] & 0x0f, HEX);
    Serial.print(",");
  }
  Serial.println();
}

void setup() {
  Serial.begin(9600);
  while (!Serial);

  if (!SE05X.begin()) {
    Serial.println("Failed to communicate with SE05X!");
    while (1);
  }

  Serial.println(currentTest);

  byte hash[SHA512_LENGTH] = {0};
  size_t hashLen = SHA512_LENGTH;
  byte emsa[N_LEN] = {0};
  size_t emsaLen = N_LEN;
  byte passedTests = 0;
  byte verifiedSignatures = 0;
  byte signature[S_LEN] = {0};
  size_t signatureLen = 0;

  const int KeyId = 9996;

  SE05X.deleteBinaryObject(KeyId);
  SE05X.writeRSAKey(KeyId,
                    kSE05x_RSABitLength_1024,
                    NULL,
                    0,
                    NULL,
                    0,
                    NULL,
                    0,
                    NULL,
                    0,
                    NULL,
                    0,
                    e,
                    E_LEN,
                    d,
                    D_LEN,
                    n,
                    N_LEN,
                    kSE05x_RSAKeyFormat_RAW,
                    false,
                    kSE05x_KeyPart_Pair,
                    NULL);
  
  for(int i = 0; i < num_vectors; i++){

    Serial.println("");
    Serial.print("Test ");
    Serial.println((i+1));
    

    // print the input
    Serial.print("Input is:                     ");
    printBufferHex(&msg[i][0], MSG_LEN);

    //calculate the input hash
    switch (sha_alg[i])
    {
    case kSE05x_RSASignatureAlgo_SHA1_PKCS1_PSS:
      hashLen = SHA1_LENGTH;
      SE05X.beginSHA1();
      SE05X.updateSHA1(&msg[i][0], MSG_LEN);
      SE05X.endSHA1(hash, &hashLen);
      Serial.print("Input SHA1 is:              ");
      printBufferHex(hash, hashLen);
      break;
    case kSE05x_RSASignatureAlgo_SHA224_PKCS1_PSS:
      hashLen = SHA224_LENGTH;
      SE05X.beginSHA224();
      SE05X.updateSHA224(&msg[i][0], MSG_LEN);
      SE05X.endSHA224(hash, &hashLen);
      Serial.print("Input SHA224 is:              ");
      printBufferHex(hash, hashLen);
      break;
    case kSE05x_RSASignatureAlgo_SHA256_PKCS1_PSS:
      hashLen = SHA256_LENGTH;
      SE05X.beginSHA256();
      SE05X.updateSHA256(&msg[i][0], MSG_LEN);
      SE05X.endSHA256(hash, &hashLen);
      Serial.print("Input SHA256 is:              ");
      printBufferHex(hash, hashLen);
      break;
    case kSE05x_RSASignatureAlgo_SHA384_PKCS1_PSS:
      hashLen = SHA384_LENGTH;
      SE05X.beginSHA384();
      SE05X.updateSHA384(&msg[i][0], MSG_LEN);
      SE05X.endSHA384(hash, &hashLen);
      Serial.print("Input SHA384 is:              ");
      printBufferHex(hash, hashLen);
      break;
    case kSE05x_RSASignatureAlgo_SHA512_PKCS1_PSS:
      hashLen = SHA512_LENGTH;
      SE05X.beginSHA512();
      SE05X.updateSHA512(&msg[i][0], MSG_LEN);
      SE05X.endSHA512(hash, &hashLen);
      Serial.print("Input SHA512 is:              ");
      printBufferHex(hash, hashLen);
      break;
    default:
      break;
    }
    
    emsaLen = S_LEN;
    SE05X.emsa_pss_encode(hash, hashLen, emsa, &emsaLen, sha_alg[i], kSE05x_RSABitLength_1024, &saltVal[i][0], SALT_LEN);

    Serial.print("emsa is:                     ");
    printBufferHex(emsa, emsaLen);

    // calculate the signature
    signatureLen = 0;
    SE05X.SignRSA(KeyId, emsa, emsaLen, signature, sizeof(signature), &signatureLen);

    // print the signature
    Serial.print("Signature using KeyId ");
    Serial.print(KeyId);
    Serial.print(" is: ");
    printBufferHex(signature, signatureLen);
    Serial.println();
    
    // To make the signature verifcation + the signature comparison fail, uncomment the next line:
    //signature[0] = 0x00;
    if(signatureLen == S_LEN){
      if(memcmp(&s[i][0],signature,signatureLen) == 0){
        Serial.println("Generated Signature matches test vector - passed");
        passedTests++;
      }else{
        Serial.println("Generated Signature does not match test vector - failed");
        Serial.print("Signature from test vector: ");
      printBufferHex(&s[i][0], S_LEN);
      }
    }else{
      Serial.println("Generated Signature does not match test vector - failed");
      Serial.print("Signature from test vector: ");
      printBufferHex(&s[i][0], S_LEN);
    }
    
    // To make the signature verifcation fail, uncomment the next line:
    //&s[i][0] = 0x00;

    // validate the signature
    if (SE05X.VerifyRSASSA_PSS(KeyId, hash, hashLen, &s[i][0], S_LEN)){
      Serial.println("test vector Verified");
      verifiedSignatures++;
    }
    else
    {
      Serial.println("failed to verify test vector");
    }
  }
  
  Serial.print("Tests Passed:");
  Serial.println(passedTests);
  Serial.print("Verifed Signatures:");
  Serial.println(verifiedSignatures);
  SE05X.deleteBinaryObject(KeyId);
}


void loop() {

}
