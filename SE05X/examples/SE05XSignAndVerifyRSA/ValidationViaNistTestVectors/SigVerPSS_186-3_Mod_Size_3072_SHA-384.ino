#include <SE05X.h>

// CAVS 11.1
const char currentTest[] = "FIPS186-3 - SigVerPSS_186-3 RSASSA-PSS: Mod Size 3072 with SHA-384(Salt len: 24)";

#define SHA1_LENGTH                 20
#define SHA224_LENGTH               28
#define SHA256_LENGTH               32
#define SHA384_LENGTH               48
#define SHA512_LENGTH               64

#define E_LEN                       4
#define N_LEN                       384
#define D_LEN                       384

#define S_LEN                       N_LEN
#define MSG_LEN                     128
#define HASH_LEN                    SHA384_LENGTH
#define SALT_LEN                    24

// RSA Modulus (n)
const byte n[] = {0xb1, 0x25, 0xfc, 0x05, 0x4e, 0x1b, 0x9d, 0xb3, 0xb9, 0x82, 0x12, 0xf5, 0x38,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 0x05, 0xfb}; // Length: 384 bytes

// Public Exponent (e)
const byte e[6][4] = {
    {0x00, 0x14, 0x7e, 0x73},
    {0x00, 0x14, 0x7e, 0x73},
    {0x00, 0x14, 0x7e, 0x73},
    {0x00, 0x14, 0x7e, 0x73},
    {0x00, 0x9e, 0xa2, 0x99},
    {0x00, 0x14, 0x7e, 0x73}
}; // 6 vectors, each of max length 4 bytes

// Private Exponent (d)
const byte d[6][384] = {
    {0x07, 0xc6, 0xb5, 0x8c, 0x1a, 0x52, 0xf0, 0x7d, 0x2b, 0xdd, 0x24, 0xeb, 0x70,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 0x76, 0xd3},
    {0x07, 0xc6, 0xb5, 0x8c, 0x1a, 0x52, 0xf0, 0x7d, 0x2b, 0xdd, 0x24, 0xeb, 0x70,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 0x76, 0xd3},
    {0x07, 0xc6, 0xb5, 0x8c, 0x1a, 0x52, 0xf0, 0x7d, 0x2b, 0xdd, 0x24, 0xeb, 0x70,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 0x76, 0xd3},
    {0x07, 0xc6, 0xb5, 0x8c, 0x1a, 0x52, 0xf0, 0x7d, 0x2b, 0xdd, 0x24, 0xeb, 0x70,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 0x76, 0xd3},
    {0x07, 0xc6, 0xb5, 0x8c, 0x1a, 0x52, 0xf0, 0x7d, 0x2b, 0xdd, 0x24, 0xeb, 0x70,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 0x76, 0xd3},
    {0x07, 0xc6, 0xb5, 0x8c, 0x1a, 0x52, 0xf0, 0x7d, 0x2b, 0xdd, 0x24, 0xeb, 0x70,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 0x76, 0xd3}
}; // 6 vectors, each of max length 384 bytes

// Messages (msg)
const byte msg[6][128] = {
    {0x64, 0x3e, 0x40, 0xf3, 0x63, 0x6d, 0x70, 0x6e, 0x13, 0x37, 0xbc, 0xce, 0x68,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 0xb3, 0x94},
    {0xd5, 0x58, 0x69, 0xd6, 0x62, 0x39, 0x71, 0xfa, 0x7c, 0x90, 0xb5, 0x97, 0xb4,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 0x13, 0xef},
    {0xdc, 0xf6, 0x45, 0xe2, 0x20, 0x1c, 0x31, 0x44, 0xcc, 0xde, 0xd7, 0xcd, 0xf8,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 0x48, 0x19},
    {0xf5, 0xe7, 0x01, 0x0e, 0x48, 0x29, 0xc8, 0x55, 0xdd, 0x6c, 0x3c, 0x84, 0xf5,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 0x07, 0x60},
    {0x96, 0x1d, 0x11, 0xd0, 0x2f, 0xea, 0x21, 0x79, 0xea, 0xd8, 0x3f, 0xa5, 0x16,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 0x6b, 0x27},
    {0x00, 0xd7, 0x6d, 0xc4, 0x29, 0xaf, 0x28, 0x10, 0x12, 0xcb, 0x92, 0xd5, 0xf7,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 0x6d, 0xbc}
}; // 6 vectors, each of max length 128 bytes

// Signatures (s)
const byte s[6][384] = {
    {0x4b, 0x12, 0x64, 0x45, 0x9b, 0x5d, 0x40, 0x66, 0x37, 0x0a, 0x09, 0xc8, 0xe2,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 0x25, 0xa1},
    {0x9c, 0x2d, 0x84, 0x6e, 0xac, 0xd7, 0x5c, 0x81, 0xb7, 0xca, 0xdb, 0xbb, 0x06,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 0xbf, 0x61},
    {0x0e, 0x7a, 0x23, 0x8a, 0x1e, 0xeb, 0x14, 0xed, 0x0a, 0xee, 0xf7, 0x4b, 0xc5,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 0x40, 0xd1},
    {0x5f, 0x23, 0x1b, 0x5b, 0x8e, 0x58, 0x04, 0x69, 0x8a, 0xc2, 0x93, 0x1b, 0x61,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 0x00, 0xfb},
    {0x28, 0xe4, 0xee, 0x25, 0x83, 0xd3, 0x59, 0xcc, 0x91, 0xcf, 0x56, 0xaa, 0xcc,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 0xdd, 0xdc},
    {0x61, 0x96, 0x52, 0xbc, 0xc2, 0x2c, 0xac, 0x50, 0x46, 0xe8, 0xea, 0xc8, 0x69,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 0xdd, 0x83}
}; // 6 vectors, each of max length 384 bytes

// Salt Value (SaltVal)
uint8_t saltVal[6][24] = {
    {0x97, 0xeb, 0xc7, 0x98, 0x27, 0xe2, 0x2c, 0xca, 0xac, 0x44, 0x76, 0xdf, 0xd5, 0xd2, 0xf0, 0x46, 0x66, 0x11, 0x9b, 0x4a, 0x8b, 0x4e, 0x22, 0x39},
    {0x97, 0xeb, 0xc7, 0x98, 0x27, 0xe2, 0x2c, 0xca, 0xac, 0x44, 0x76, 0xdf, 0xd5, 0xd2, 0xf0, 0x46, 0x66, 0x11, 0x9b, 0x4a, 0x8b, 0x4e, 0x22, 0x39},
    {0x97, 0xeb, 0xc7, 0x98, 0x27, 0xe2, 0x2c, 0xca, 0xac, 0x44, 0x76, 0xdf, 0xd5, 0xd2, 0xf0, 0x46, 0x66, 0x11, 0x9b, 0x4a, 0x8b, 0x4e, 0x22, 0x39},
    {0x97, 0xeb, 0xc7, 0x98, 0x27, 0xe2, 0x2c, 0xca, 0xac, 0x44, 0x76, 0xdf, 0xd5, 0xd2, 0xf0, 0x46, 0x66, 0x11, 0x9b, 0x4a, 0x8b, 0x4e, 0x22, 0x39},
    {0x97, 0xeb, 0xc7, 0x98, 0x27, 0xe2, 0x2c, 0xca, 0xac, 0x44, 0x76, 0xdf, 0xd5, 0xd2, 0xf0, 0x46, 0x66, 0x11, 0x9b, 0x4a, 0x8b, 0x4e, 0x22, 0x39},
    {0x97, 0xeb, 0xc7, 0x98, 0x27, 0xe2, 0x2c, 0xca, 0xac, 0x44, 0x76, 0xdf, 0xd5, 0xd2, 0xf0, 0x46, 0x66, 0x11, 0x9b, 0x4a, 0x8b, 0x4e, 0x22, 0x39}
}; // 6 vectors, each of max length 24 bytes

// Expected results
bool result[] = { 0, 1, 0, 0, 0, 0 };
const int num_vectors = 6; // Number of test vectors

void printBufferHex(const byte input[], size_t inputLength)
{
  for (size_t i = 0; i < inputLength; i++) {
    Serial.print(input[i] >> 4, HEX);
    Serial.print(input[i] & 0x0f, HEX);
    Serial.print(",");
  }
  Serial.println();
}

void setup() {
  Serial.begin(9600);
  while (!Serial);

  if (!SE05X.begin()) {
    Serial.println("Failed to communicate with SE05X!");
    while (1);
  }

  Serial.println(currentTest);

  byte hash[HASH_LEN] = {0};
  size_t hashLen = HASH_LEN;
  byte emsa[N_LEN] = {0};
  size_t emsaLen = N_LEN;
  byte signature[N_LEN] = {0};
  size_t signatureLen = 0;

  const int KeyId = 9996;
  for(int i = 0; i < num_vectors; i++){

    SE05X.deleteBinaryObject(KeyId);
    SE05X.writeRSAKey(KeyId,
                      kSE05x_RSABitLength_3072,
                      NULL,
                      0,
                      NULL,
                      0,
                      NULL,
                      0,
                      NULL,
                      0,
                      NULL,
                      0,
                      &e[i][0],
                      E_LEN,
                      &d[i][0],
                      D_LEN,
                      n,
                      N_LEN,
                      kSE05x_RSAKeyFormat_RAW,
                      false,
                      kSE05x_KeyPart_Pair,
                      NULL);

    Serial.println("");
    Serial.print("Test ");
    Serial.println((i+1));

    // print the input
    Serial.print("Input is:                     ");
    printBufferHex(&msg[i][0], MSG_LEN);

    //calculate the input hash
    hashLen = HASH_LEN;
    SE05X.beginSHA384();
    SE05X.updateSHA384(&msg[i][0], MSG_LEN);
    SE05X.endSHA384(hash, &hashLen);

    Serial.print("Input SHA384 is:              ");
    printBufferHex(hash, hashLen);

    emsaLen = S_LEN;
    if(SALT_LEN == 0 && saltVal[i][0] == 0){
      SE05X.emsa_pss_encode(hash, hashLen, emsa, &emsaLen, kSE05x_RSASignatureAlgo_SHA384_PKCS1_PSS, kSE05x_RSABitLength_3072, NULL, SALT_LEN);
    }else{
      SE05X.emsa_pss_encode(hash, hashLen, emsa, &emsaLen, kSE05x_RSASignatureAlgo_SHA384_PKCS1_PSS, kSE05x_RSABitLength_3072, &saltVal[i][0], SALT_LEN);
    }
    Serial.print("emsa is:                     ");
    printBufferHex(emsa, emsaLen);

    // calculate the signature
    signatureLen = 0;
    SE05X.SignRSA(KeyId, emsa, emsaLen, signature, sizeof(signature), &signatureLen);

    // print the signature
    Serial.print("Signature using KeyId ");
    Serial.print(KeyId);
    Serial.print(" is: ");
    printBufferHex(signature, signatureLen);
    Serial.println();
    
    // To make the signature verifcation + the signature comparison fail, uncomment the next line:
    //signature[0] = 0x00;
    if(signatureLen == S_LEN){
      if(memcmp(&s[i][0],signature,signatureLen) == 0){
        Serial.println("SE050 Generated Signature matches test vector");
      }else{
        Serial.println("SE050 Generated Signature does not match test vector");
        Serial.print("Signature from test vector: ");
        printBufferHex(&s[i][0], S_LEN);
      }
    }else{
      Serial.println("SE050 Generated Signature does not match test vector");
      Serial.print("Signature from test vector: ");
      printBufferHex(&s[i][0], S_LEN);
    }


    // To make the signature verifcation fail, uncomment the next line:
    //signature[0] = 0x00;

    // validate the signature
    if (SE05X.VerifyRSASSA_PSS(KeyId, hash, hashLen, &s[i][0], S_LEN)){
      Serial.println("test vector Verified");
      if(result[i]){
        Serial.println("---TEST PASSED---");
      }else{
        Serial.println("---TEST FAILED---");
      }
    }
    else
    {
      Serial.println("failed to verify test vector");
      if(!result[i]){
        Serial.println("---TEST PASSED---");
      }else{
        Serial.println("---TEST FAILED---");
      }
    }
  }

  SE05X.deleteBinaryObject(KeyId);
}


void loop() {

}
