#include <SE05X.h>

// CAVS 11.4
const char currentTest[] = "FIPS186-3 - SigGenPSS_186-3 RSASSA-PSS: Mod Size 3072 with SHA-224(Salt len: 28)";
const byte n[] = {0xa7, 0xa1, 0x88, 0x2a, 0x7f, 0xb8, 0x96, 0x78, 0x60, 0x34, 0xd0, 0x7f, 0xb1,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 0xde, 0x8b}; // Length: 384 bytes
const byte e[] = {0x00, 0x14, 0x15, 0xa7}; // Length: 4 bytes
const byte d[] = {0x07, 0x3a, 0x5f, 0xc4, 0xcd, 0x64, 0x2f, 0x61, 0x13, 0xdf, 0xfc, 0x4f, 0x84,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 0x96, 0x0b}; // Length: 384 bytes
byte saltVal[] = {0x3f, 0x80, 0x50, 0x57, 0x47, 0x1a, 0xab, 0x0a, 0x28, 0xcf, 0xc8, 0x43, 0x0d, 0xab, 0xcf, 0x99, 0x06, 0x12, 0xe8, 0xa9, 0x08, 0xb1, 0x58, 0xae, 0x36, 0xb4, 0xed, 0x53}; // Length: 28 bytes
// Messages (msg)
const byte msg[10][128] = {
  {0xc8, 0xed, 0x14, 0x89, 0x5c, 0x80, 0xa9, 0x1f, 0xda, 0x83, 0x67, 0xcf, 0x4a,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 0x9e, 0x4e},
  {0xd0, 0x4b, 0xe7, 0x58, 0xe9, 0x76, 0x44, 0xee, 0x60, 0xa9, 0x21, 0x2e, 0x5e,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 0xbb, 0x80},
  {0x39, 0xd8, 0xec, 0x48, 0x16, 0xfa, 0x93, 0x65, 0xcd, 0xf2, 0x99, 0xce, 0x60,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 0x27, 0x99},
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  {0x02, 0xa1, 0xa6, 0x5f, 0x8a, 0xf9, 0x0a, 0x29, 0x86, 0x36, 0xfe, 0x8f, 0xd3,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 0xc8, 0xb4}
}; // 10 vectors, each of max length 128 bytes
#define MSG_LEN 128

// Signatures (s)
const byte s[10][384] = {
  {0x27, 0xb4, 0xf0, 0xaa, 0x13, 0x95, 0x65, 0xfb, 0xd7, 0x86, 0x07, 0x60, 0x61,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 0xef, 0xa2},
  {0x4a, 0xba, 0x73, 0x2c, 0x62, 0x55, 0xf0, 0xbc, 0x44, 0x39, 0x39, 0xc1, 0x31,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 0xc6, 0x0d},
  {0x0d, 0xf8, 0x1e, 0xc6, 0xe9, 0xc2, 0xf0, 0xeb, 0xe8, 0x24, 0xc4, 0x45, 0x00,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 0x5f, 0xb5},
  {0x72, 0x76, 0x69, 0xab, 0xeb, 0x6b, 0xcc, 0x95, 0x02, 0xd7, 0xe8, 0x81, 0x62,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 0x59, 0x75},
  {0xa1, 0xa4, 0xd1, 0x69, 0x56, 0xd7, 0x18, 0x83, 0x0f, 0x62, 0x5f, 0x06, 0xc4,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 0xb0, 0x75},
  {0x2e, 0x07, 0x8b, 0x29, 0xb5, 0x28, 0x8a, 0x77, 0xed, 0x25, 0xec, 0xec, 0xec,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 0xfd, 0x24},
  {0x1b, 0xc3, 0x25, 0x41, 0x2c, 0xc9, 0x52, 0xa8, 0xdd, 0x69, 0x18, 0xdb, 0x8f,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 0x77, 0x50},
  {0x79, 0x94, 0x50, 0xa1, 0x25, 0x6d, 0x24, 0x5d, 0xf0, 0xbb, 0x7d, 0x52, 0x90,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 0xa8, 0xe6},
  {0x9c, 0xba, 0x01, 0xf7, 0x9f, 0x35, 0x51, 0xac, 0xfc, 0xcf, 0x56, 0xe7, 0x44,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 0x64, 0x61},
  {0x74, 0x0e, 0xeb, 0x1c, 0x71, 0x94, 0x0c, 0xcb, 0xc0, 0x41, 0xcf, 0x20, 0x44,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 0xcf, 0xc6}
}; // 10 vectors, each of max length 384 bytes
#define S_LEN 384

void printBufferHex(const byte input[], size_t inputLength)
{
  for (size_t i = 0; i < inputLength; i++) {
    Serial.print(input[i] >> 4, HEX);
    Serial.print(input[i] & 0x0f, HEX);
    Serial.print(",");
  }
  Serial.println();
}

void setup() {
  Serial.begin(9600);
  while (!Serial);

  if (!SE05X.begin()) {
    Serial.println("Failed to communicate with SE05X!");
    while (1);
  }

  Serial.println(currentTest);
  const int KeyId = 9996;
  
  SE05X.deleteBinaryObject(KeyId);
  SE05X.writeRSAKey(KeyId,
                    kSE05x_RSABitLength_3072,
                    NULL,
                    0,
                    NULL,
                    0,
                    NULL,
                    0,
                    NULL,
                    0,
                    NULL,
                    0,
                    e,
                    sizeof(e),
                    d,
                    sizeof(d),
                    n,
                    sizeof(n),
                    kSE05x_RSAKeyFormat_RAW,
                    false,
                    kSE05x_KeyPart_Pair,
                    NULL);

  byte sha224[64] = {0};
  byte emsa[384] = {0};
  size_t sha224Len = 64;
  size_t emsaLen = 384;
  byte signature[384] = {0};
  size_t signatureLen = 0;

  for(int i = 0; i < 10; i++){
    Serial.println("");
    Serial.print("Test ");
    Serial.println((i+1));

    // print the input
    Serial.print("Input is:                     ");
    printBufferHex(&msg[i][0], MSG_LEN);

    //calculate the input SHA224
    sha224Len = 64;
    SE05X.beginSHA224();
    SE05X.updateSHA224(&msg[i][0], MSG_LEN);
    SE05X.endSHA224(sha224, &sha224Len);

    Serial.print("Input SHA224 is:              ");
    printBufferHex(sha224, sha224Len);

    emsaLen = 384;
    SE05X.emsa_pss_encode(sha224, sha224Len, emsa, &emsaLen, kSE05x_RSASignatureAlgo_SHA224_PKCS1_PSS, kSE05x_RSABitLength_3072,saltVal,sizeof(saltVal));
    Serial.print("emsa is:                     ");
    printBufferHex(emsa, emsaLen);

    // calculate the signature
    signatureLen = 0;
    SE05X.SignRSA(KeyId, emsa, emsaLen, signature, sizeof(signature), &signatureLen);

    // print the signature
    Serial.print("Signature using KeyId ");
    Serial.print(KeyId);
    Serial.print(" is: ");
    printBufferHex(signature, signatureLen);
    Serial.println();
    
    // To make the signature verifcation + the signature comparison fail, uncomment the next line:
    //signature[0] = 0x00;
    if(signatureLen == S_LEN){
      if(memcmp(&s[i][0],signature,signatureLen) == 0){
        Serial.println("Generated Signature matches test vector - passed");
      }else{
        Serial.println("Generated Signature does not match test vector - failed");
      }
    }else{
      Serial.println("Generated Signature does not match test vector - failed");
    }


    // To make the signature verifcation fail, uncomment the next line:
    //signature[0] = 0x00;

    // validate the signature
    if (SE05X.VerifyRSASSA_PSS(KeyId, sha224, sha224Len, signature, signatureLen)){
      Serial.println("Verified signature successfully :D");
    }
    else
    {
      Serial.println("oh no! failed to verify signature :(");
    }
  }

  SE05X.deleteBinaryObject(KeyId);
}


void loop() {

}
