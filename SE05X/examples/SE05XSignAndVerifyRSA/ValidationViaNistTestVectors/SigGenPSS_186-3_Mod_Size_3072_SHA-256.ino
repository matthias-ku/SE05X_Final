#include <SE05X.h>

// CAVS 11.4
const char currentTest[] = "FIPS186-3 - SigGenPSS_186-3 RSASSA-PSS: Mod Size 3072 with SHA-256(Salt len: 32)";
const byte n[] = {0xa7, 0xa1, 0x88, 0x2a, 0x7f, 0xb8, 0x96, 0x78, 0x60, 0x34, 0xd0, 0x7f, 0xb1,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 0xde, 0x8b}; // Length: 384 bytes
const byte e[] = {0x00, 0x14, 0x15, 0xa7}; // Length: 4 bytes
const byte d[] = {0x07, 0x3a, 0x5f, 0xc4, 0xcd, 0x64, 0x2f, 0x61, 0x13, 0xdf, 0xfc, 0x4f, 0x84,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 0x96, 0x0b}; // Length: 384 bytes
byte saltVal[] = {0x3e, 0x07, 0xad, 0xe7, 0x2a, 0x3f, 0x52, 0x53, 0x0f, 0x53, 0x13, 0x5a, 0x5d, 0x7d, 0x93, 0x21, 0x74, 0x35, 0xba, 0x00, 0x1e, 0xa5, 0x5a, 0x8f, 0x5d, 0x5d, 0x13, 0x04, 0x68, 0x48, 0x74, 0xbc}; // Length: 32 bytes
// Messages (msg)
const byte msg[10][128] = {
  {0xc1, 0x64, 0x99, 0x11, 0x0e, 0xd5, 0x77, 0x20, 0x2a, 0xed, 0x2d, 0x3e, 0x4d,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 0x70, 0x06},
  {0x60, 0x40, 0x2d, 0xed, 0x89, 0xd0, 0x97, 0x9a, 0xfb, 0x49, 0xf8, 0x50, 0x8e,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 0x24, 0x1a},
  {0x2f, 0x03, 0x70, 0x1c, 0x2f, 0xe0, 0x7d, 0x47, 0xf5, 0xfa, 0x2c, 0x83, 0xa8,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 0xda, 0x61},
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  {0x3b, 0x8a, 0x68, 0xda, 0x11, 0xb6, 0x1b, 0x5f, 0xee, 0x1c, 0x2c, 0xa0, 0x0a,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 0x7e, 0xde}
}; // 10 vectors, each of max length 128 bytes
#define MSG_LEN 128

// Signatures (s)
const byte s[10][384] = {
  {0x43, 0x35, 0x70, 0x7d, 0xa7, 0x35, 0xcf, 0xd1, 0x04, 0x11, 0xc9, 0xc0, 0x48,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 0xf8, 0x6e},
  {0x5f, 0x18, 0x30, 0x09, 0x70, 0x8b, 0x37, 0x96, 0x37, 0xda, 0xc2, 0xb1, 0x42,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 0x4b, 0x8f},
  {0x82, 0x91, 0xbc, 0x1b, 0xe9, 0xc9, 0x81, 0x66, 0x31, 0x56, 0xec, 0x80, 0xc1,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 0x8f, 0xce},
  {0x8c, 0x45, 0xe3, 0x8e, 0xaf, 0xaa, 0xf1, 0x0a, 0x71, 0x0e, 0x13, 0x1b, 0xec,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 0x17, 0x31},
  {0x85, 0x1d, 0xcd, 0x2d, 0x4e, 0x1d, 0x34, 0xda, 0xe0, 0xfd, 0x58, 0x5a, 0xf1,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 0xc9, 0x8d},
  {0x72, 0xc5, 0x55, 0x51, 0x11, 0xea, 0xef, 0x95, 0x42, 0x36, 0x16, 0x37, 0x53,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 0x9a, 0x9c},
  {0x79, 0x6a, 0xc3, 0xf6, 0xad, 0xf4, 0xea, 0xbc, 0xb7, 0xa5, 0x28, 0xca, 0x63,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 0xf4, 0xfb},
  {0x85, 0x03, 0xb8, 0x5d, 0xbd, 0x9e, 0xba, 0x8d, 0x6f, 0xc5, 0x7c, 0x6a, 0xe2,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 0xe0, 0xbb},
  {0x66, 0xd1, 0xce, 0xa9, 0x4b, 0x96, 0x03, 0xef, 0xad, 0x92, 0xb6, 0xca, 0x8a,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 0x8e, 0x55},
  {0x79, 0x00, 0x58, 0x35, 0x5d, 0x7a, 0xb9, 0xec, 0xcb, 0x46, 0xea, 0x12, 0x36,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 0xda, 0x80}
}; // 10 vectors, each of max length 384 bytes
#define S_LEN 384

void printBufferHex(const byte input[], size_t inputLength)
{
  for (size_t i = 0; i < inputLength; i++) {
    Serial.print(input[i] >> 4, HEX);
    Serial.print(input[i] & 0x0f, HEX);
    Serial.print(",");
  }
  Serial.println();
}

void setup() {
  Serial.begin(9600);
  while (!Serial);

  if (!SE05X.begin()) {
    Serial.println("Failed to communicate with SE05X!");
    while (1);
  }

  Serial.println(currentTest);
  const int KeyId = 9996;
  
  SE05X.deleteBinaryObject(KeyId);
  SE05X.writeRSAKey(KeyId,
                    kSE05x_RSABitLength_3072,
                    NULL,
                    0,
                    NULL,
                    0,
                    NULL,
                    0,
                    NULL,
                    0,
                    NULL,
                    0,
                    e,
                    sizeof(e),
                    d,
                    sizeof(d),
                    n,
                    sizeof(n),
                    kSE05x_RSAKeyFormat_RAW,
                    false,
                    kSE05x_KeyPart_Pair,
                    NULL);

  byte sha256[64] = {0};
  byte emsa[384] = {0};
  size_t sha256Len = 64;
  size_t emsaLen = 384;
  byte signature[384] = {0};
  size_t signatureLen = 0;

  for(int i = 0; i < 10; i++){
    Serial.println("");
    Serial.print("Test ");
    Serial.println((i+1));

    // print the input
    Serial.print("Input is:                     ");
    printBufferHex(&msg[i][0], MSG_LEN);

    //calculate the input SHA256
    sha256Len = 64;
    SE05X.beginSHA256();
    SE05X.updateSHA256(&msg[i][0], MSG_LEN);
    SE05X.endSHA256(sha256, &sha256Len);

    Serial.print("Input SHA256 is:              ");
    printBufferHex(sha256, sha256Len);

    emsaLen = 384;
    SE05X.emsa_pss_encode(sha256, sha256Len, emsa, &emsaLen, kSE05x_RSASignatureAlgo_SHA256_PKCS1_PSS, kSE05x_RSABitLength_3072,saltVal,sizeof(saltVal));
    Serial.print("emsa is:                     ");
    printBufferHex(emsa, emsaLen);

    // calculate the signature
    signatureLen = 0;
    SE05X.SignRSA(KeyId, emsa, emsaLen, signature, sizeof(signature), &signatureLen);

    // print the signature
    Serial.print("Signature using KeyId ");
    Serial.print(KeyId);
    Serial.print(" is: ");
    printBufferHex(signature, signatureLen);
    Serial.println();
    
    // To make the signature verifcation + the signature comparison fail, uncomment the next line:
    //signature[0] = 0x00;
    if(signatureLen == S_LEN){
      if(memcmp(&s[i][0],signature,signatureLen) == 0){
        Serial.println("Generated Signature matches test vector - passed");
      }else{
        Serial.println("Generated Signature does not match test vector - failed");
      }
    }else{
      Serial.println("Generated Signature does not match test vector - failed");
    }


    // To make the signature verifcation fail, uncomment the next line:
    //signature[0] = 0x00;

    // validate the signature
    if (SE05X.VerifyRSASSA_PSS(KeyId, sha256, sha256Len, signature, signatureLen)){
      Serial.println("Verified signature successfully :D");
    }
    else
    {
      Serial.println("oh no! failed to verify signature :(");
    }
  }

  SE05X.deleteBinaryObject(KeyId);
}


void loop() {

}
