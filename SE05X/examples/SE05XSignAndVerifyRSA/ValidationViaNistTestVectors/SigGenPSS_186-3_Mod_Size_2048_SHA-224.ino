#include <SE05X.h>

// CAVS 11.4
const char currentTest[] = "FIPS186-3 - SigGenPSS_186-3 RSASSA-PSS: Mod Size 2048 with SHA-224(Salt len: 15)";
const byte n[] = {0xc5, 0x06, 0x2b, 0x58, 0xd8, 0x53, 0x9c, 0x76, 0x5e, 0x1e, 0x5d, 0xba, 0xf1,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 0x05, 0xef}; // Length: 256 bytes
const byte e[] = {0x00, 0x86, 0xc9, 0x4f}; // Length: 4 bytes
const byte d[] = {0x49, 0xe5, 0x78, 0x6b, 0xb4, 0xd3, 0x32, 0xf9, 0x45, 0x86, 0x32, 0x7b, 0xde,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 0x06, 0x9f}; // Length: 256 bytes
byte saltVal[] = {0x46, 0x37, 0x29, 0xb3, 0xea, 0xf4, 0x35, 0x02, 0xd9, 0xcf, 0xf1, 0x29, 0x92, 0x56, 0x81}; // Length: 15 bytes

const byte msg[10][128] = {
  {0x37, 0xdd, 0xd9, 0x90, 0x14, 0x78, 0xae, 0x5c, 0x16, 0x87, 0x87, 0x02, 0xce,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 0x12, 0x2e},
  {0x5c, 0x61, 0x54, 0x6b, 0x84, 0x8a, 0x36, 0xe8, 0xe5, 0x1f, 0x8b, 0xeb, 0x11,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 0x0c, 0xd9},
  {0x75, 0x40, 0xed, 0xea, 0x54, 0xa4, 0xfa, 0x57, 0x96, 0x84, 0xa5, 0xb5, 0x9c,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 0x74, 0x63},
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  {0xef, 0x10, 0xb0, 0x3c, 0x04, 0x57, 0x8b, 0xd5, 0xf7, 0x83, 0x35, 0x8d, 0xf3,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 0xf1, 0xbe}
}; // 10 vectors, each of max length 128 bytes
#define MSG_LEN 128
// Signatures (s)
const byte s[10][256] = {
  {0x7e, 0x62, 0x8b, 0xcb, 0xe6, 0xff, 0x83, 0xa9, 0x37, 0xb8, 0x96, 0x11, 0x97,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 0xda, 0xc8},
  {0x13, 0x4e, 0x6a, 0xcd, 0x94, 0xb7, 0x6a, 0x86, 0xe7, 0xff, 0x73, 0x0f, 0x06,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 0x32, 0x30},
  {0x45, 0x54, 0x1a, 0xa6, 0x5f, 0xbb, 0x07, 0x73, 0xb1, 0x43, 0x4c, 0x4f, 0xda,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 0xfa, 0xed},
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  {0x4a, 0x18, 0x3b, 0x82, 0x61, 0x6f, 0x3b, 0xbc, 0x27, 0xa1, 0x46, 0x71, 0x0b,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 0xc7, 0xd7}
}; // 10 vectors, each of max length 256 bytes
#define S_LEN 256

void printBufferHex(const byte input[], size_t inputLength)
{
  for (size_t i = 0; i < inputLength; i++) {
    Serial.print(input[i] >> 4, HEX);
    Serial.print(input[i] & 0x0f, HEX);
    Serial.print(",");
  }
  Serial.println();
}

void setup() {
  Serial.begin(9600);
  while (!Serial);

  if (!SE05X.begin()) {
    Serial.println("Failed to communicate with SE05X!");
    while (1);
  }

  Serial.println(currentTest);
  const int KeyId = 9996;
  
  SE05X.deleteBinaryObject(KeyId);
  SE05X.writeRSAKey(KeyId,
                    kSE05x_RSABitLength_2048,
                    NULL,
                    0,
                    NULL,
                    0,
                    NULL,
                    0,
                    NULL,
                    0,
                    NULL,
                    0,
                    e,
                    sizeof(e),
                    d,
                    sizeof(d),
                    n,
                    sizeof(n),
                    kSE05x_RSAKeyFormat_RAW,
                    false,
                    kSE05x_KeyPart_Pair,
                    NULL);

  byte sha224[64] = {0};
  byte emsa[256] = {0};
  size_t sha224Len = 64;
  size_t emsaLen = 256;
  byte signature[256] = {0};
  size_t signatureLen = 0;

  for(int i = 0; i < 10; i++){
    Serial.println("");
    Serial.print("Test ");
    Serial.println((i+1));

    // print the input
    Serial.print("Input is:                     ");
    printBufferHex(&msg[i][0], MSG_LEN);

    //calculate the input SHA224
    sha224Len = 64;
    SE05X.beginSHA224();
    SE05X.updateSHA224(&msg[i][0], MSG_LEN);
    SE05X.endSHA224(sha224, &sha224Len);

    Serial.print("Input SHA224 is:              ");
    printBufferHex(sha224, sha224Len);

    emsaLen = 256;
    SE05X.emsa_pss_encode(sha224, sha224Len, emsa, &emsaLen, kSE05x_RSASignatureAlgo_SHA224_PKCS1_PSS, kSE05x_RSABitLength_2048,saltVal,sizeof(saltVal));
    Serial.print("emsa is:                     ");
    printBufferHex(emsa, emsaLen);

    // calculate the signature
    signatureLen = 0;
    SE05X.SignRSA(KeyId, emsa, emsaLen, signature, sizeof(signature), &signatureLen);

    // print the signature
    Serial.print("Signature using KeyId ");
    Serial.print(KeyId);
    Serial.print(" is: ");
    printBufferHex(signature, signatureLen);
    Serial.println();
    
    // To make the signature verifcation + the signature comparison fail, uncomment the next line:
    //signature[0] = 0x00;
    if(signatureLen == S_LEN){
      if(memcmp(&s[i][0],signature,signatureLen) == 0){
        Serial.println("Generated Signature matches test vector - passed");
      }else{
        Serial.println("Generated Signature does not match test vector - failed");
      }
    }else{
      Serial.println("Generated Signature does not match test vector - failed");
    }


    // To make the signature verifcation fail, uncomment the next line:
    //signature[0] = 0x00;

    // validate the signature
    if (SE05X.VerifyRSASSA_PSS(KeyId, sha224, sha224Len, signature, signatureLen)){
      Serial.println("Verified signature successfully :D");
    }
    else
    {
      Serial.println("oh no! failed to verify signature :(");
    }
  }

  SE05X.deleteBinaryObject(KeyId);
}


void loop() {

}
