#include <SE05X.h>

// CAVS 11.1
const char currentTest[] = "FIPS186-3 - SigVerPSS_186-3 RSASSA-PSS: Mod Size 2048 with SHA-1(Salt len: 20)";

#define SHA1_LENGTH                 20
#define SHA224_LENGTH               28
#define SHA256_LENGTH               32
#define SHA384_LENGTH               48
#define SHA512_LENGTH               64

#define E_LEN                       4
#define N_LEN                       256
#define D_LEN                       256

#define S_LEN                       N_LEN
#define MSG_LEN                     128
#define HASH_LEN                    SHA1_LENGTH
#define SALT_LEN                    20

// RSA Modulus (n)
const byte n[] = {0xc4, 0xb9, 0xea, 0x11, 0xf2, 0x1c, 0xd9, 0x3c, 0x01, 0xf5, 0x6c, 0x42, 0x19,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 0xff, 0x73}; // Length: 256 bytes

// Public Exponent (e)
const byte e[6][4] = {
    {0x00, 0x64, 0x5c, 0x29},
    {0x00, 0x59, 0x3d, 0x67},
    {0x00, 0x59, 0x3d, 0x67},
    {0x00, 0x59, 0x3d, 0x67},
    {0x00, 0x59, 0x3d, 0x67},
    {0x00, 0x59, 0x3d, 0x67}
}; // 6 vectors, each of max length 4 bytes

// Private Exponent (d)
const byte d[6][256] = {
    {0x4b, 0x67, 0xab, 0x77, 0x47, 0x5f, 0x47, 0x07, 0xc2, 0x37, 0x5c, 0x5b, 0xde,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 0xa0, 0x5f},
    {0x4b, 0x67, 0xab, 0x77, 0x47, 0x5f, 0x47, 0x07, 0xc2, 0x37, 0x5c, 0x5b, 0xde,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 0xa0, 0x5f},
    {0x4b, 0x67, 0xab, 0x77, 0x47, 0x5f, 0x47, 0x07, 0xc2, 0x37, 0x5c, 0x5b, 0xde,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 0xa0, 0x5f},
    {0x4b, 0x67, 0xab, 0x77, 0x47, 0x5f, 0x47, 0x07, 0xc2, 0x37, 0x5c, 0x5b, 0xde,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 0xa0, 0x5f},
    {0x4b, 0x67, 0xab, 0x77, 0x47, 0x5f, 0x47, 0x07, 0xc2, 0x37, 0x5c, 0x5b, 0xde,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 0xa0, 0x5f},
    {0x4b, 0x67, 0xab, 0x77, 0x47, 0x5f, 0x47, 0x07, 0xc2, 0x37, 0x5c, 0x5b, 0xde,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 0xa0, 0x5f}
}; // 6 vectors, each of max length 256 bytes

// Messages (msg)
const byte msg[6][128] = {
    {0x6c, 0x0e, 0x15, 0xa9, 0x9f, 0x99, 0x48, 0xd4, 0x19, 0x80, 0xd7, 0xa3, 0x7a,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 0xef, 0xdc},
    {0x06, 0x42, 0x06, 0x83, 0x1c, 0xd4, 0x15, 0x42, 0x5c, 0xda, 0xeb, 0x49, 0xee,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 0x21, 0xd5},
    {0x62, 0x4e, 0xf4, 0x31, 0xa1, 0xc8, 0x1e, 0x27, 0x9c, 0x7f, 0x3e, 0x37, 0x60,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 0xea, 0x1b},
    {0x7a, 0x88, 0x4d, 0x5e, 0x7e, 0xdc, 0x74, 0xc1, 0x0c, 0x44, 0x41, 0x8e, 0x47,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 0x72, 0xe8},
    {0x63, 0x05, 0xa7, 0xc4, 0x51, 0x2d, 0x7d, 0x90, 0x3e, 0xae, 0x65, 0xdc, 0x8e,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 0x7b, 0x0f},
    {0x1c, 0x9c, 0x81, 0x54, 0x46, 0x61, 0xaa, 0xb0, 0xec, 0x7f, 0x62, 0x96, 0x57,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 0x87, 0x01}
}; // 6 vectors, each of max length 128 bytes

// Signatures (s)
const byte s[6][256] = {
    {0x57, 0x3c, 0xbe, 0xd4, 0x50, 0xf9, 0x45, 0xf5, 0x64, 0x97, 0x27, 0x3f, 0xc3,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 0x38, 0xb1},
    {0x38, 0x5b, 0x55, 0x1f, 0xca, 0x5e, 0x32, 0xd9, 0xe3, 0xdd, 0xb5, 0xdc, 0xa3,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 0xa1, 0x0c},
    {0x31, 0x62, 0xcc, 0x1b, 0xb7, 0x42, 0xed, 0xb6, 0xbb, 0x18, 0x21, 0x1d, 0xc8,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 0xe1, 0x9e},
    {0x81, 0x03, 0xb5, 0x64, 0x89, 0x93, 0x73, 0x66, 0x24, 0x55, 0x6e, 0x99, 0x4e,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 0xd5, 0xd2},
    {0x40, 0xe1, 0xaf, 0xa3, 0x89, 0x5d, 0x93, 0x8a, 0x97, 0x38, 0x79, 0x15, 0x78,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 0xd2, 0x19},
    {0x7a, 0x5d, 0xa6, 0x03, 0xb9, 0xe8, 0xaf, 0x2f, 0xe8, 0x78, 0x7a, 0xbf, 0x94,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 0xe3, 0x14}
}; // 6 vectors, each of max length 256 bytes

// Salt Value (SaltVal)
uint8_t saltVal[6][20] = {
    {0x86, 0xf3, 0x50, 0xb8, 0xb7, 0x05, 0x69, 0xc2, 0xdd, 0x09, 0x39, 0xff, 0x5d, 0x23, 0x64, 0x53, 0x1f, 0xe3, 0x49, 0x75},
    {0x86, 0xf3, 0x50, 0xb8, 0xb7, 0x05, 0x69, 0xc2, 0xdd, 0x09, 0x39, 0xff, 0x5d, 0x23, 0x64, 0x53, 0x1f, 0xe3, 0x49, 0x75},
    {0x86, 0xf3, 0x50, 0xb8, 0xb7, 0x05, 0x69, 0xc2, 0xdd, 0x09, 0x39, 0xff, 0x5d, 0x23, 0x64, 0x53, 0x1f, 0xe3, 0x49, 0x75},
    {0x86, 0xf3, 0x50, 0xb8, 0xb7, 0x05, 0x69, 0xc2, 0xdd, 0x09, 0x39, 0xff, 0x5d, 0x23, 0x64, 0x53, 0x1f, 0xe3, 0x49, 0x75},
    {0x86, 0xf3, 0x50, 0xb8, 0xb7, 0x05, 0x69, 0xc2, 0xdd, 0x09, 0x39, 0xff, 0x5d, 0x23, 0x64, 0x53, 0x1f, 0xe3, 0x49, 0x75},
    {0x86, 0xf3, 0x50, 0xb8, 0xb7, 0x05, 0x69, 0xc2, 0xdd, 0x09, 0x39, 0xff, 0x5d, 0x23, 0x64, 0x53, 0x1f, 0xe3, 0x49, 0x75}
}; // 6 vectors, each of max length 20 bytes

// Expected results
bool result[] = { 0, 0, 0, 1, 0, 0 };
const int num_vectors = 6; // Number of test vectors

void printBufferHex(const byte input[], size_t inputLength)
{
  for (size_t i = 0; i < inputLength; i++) {
    Serial.print(input[i] >> 4, HEX);
    Serial.print(input[i] & 0x0f, HEX);
    Serial.print(",");
  }
  Serial.println();
}

void setup() {
  Serial.begin(9600);
  while (!Serial);

  if (!SE05X.begin()) {
    Serial.println("Failed to communicate with SE05X!");
    while (1);
  }

  Serial.println(currentTest);

  byte hash[HASH_LEN] = {0};
  size_t hashLen = HASH_LEN;
  byte emsa[N_LEN] = {0};
  size_t emsaLen = N_LEN;
  byte signature[N_LEN] = {0};
  size_t signatureLen = 0;

  const int KeyId = 9996;
  for(int i = 0; i < num_vectors; i++){

    SE05X.deleteBinaryObject(KeyId);
    SE05X.writeRSAKey(KeyId,
                      kSE05x_RSABitLength_2048,
                      NULL,
                      0,
                      NULL,
                      0,
                      NULL,
                      0,
                      NULL,
                      0,
                      NULL,
                      0,
                      &e[i][0],
                      E_LEN,
                      &d[i][0],
                      D_LEN,
                      n,
                      N_LEN,
                      kSE05x_RSAKeyFormat_RAW,
                      false,
                      kSE05x_KeyPart_Pair,
                      NULL);

    Serial.println("");
    Serial.print("Test ");
    Serial.println((i+1));

    // print the input
    Serial.print("Input is:                     ");
    printBufferHex(&msg[i][0], MSG_LEN);

    //calculate the input hash
    hashLen = HASH_LEN;
    SE05X.beginSHA1();
    SE05X.updateSHA1(&msg[i][0], MSG_LEN);
    SE05X.endSHA1(hash, &hashLen);

    Serial.print("Input SHA1 is:              ");
    printBufferHex(hash, hashLen);

    emsaLen = S_LEN;
    SE05X.emsa_pss_encode(hash, hashLen, emsa, &emsaLen, kSE05x_RSASignatureAlgo_SHA1_PKCS1_PSS, kSE05x_RSABitLength_2048, &saltVal[i][0], SALT_LEN);
    Serial.print("emsa is:                     ");
    printBufferHex(emsa, emsaLen);

    // calculate the signature
    signatureLen = 0;
    SE05X.SignRSA(KeyId, emsa, emsaLen, signature, sizeof(signature), &signatureLen);

    // print the signature
    Serial.print("Signature using KeyId ");
    Serial.print(KeyId);
    Serial.print(" is: ");
    printBufferHex(signature, signatureLen);
    Serial.println();
    
    // To make the signature verifcation + the signature comparison fail, uncomment the next line:
    //signature[0] = 0x00;
    if(signatureLen == S_LEN){
      if(memcmp(&s[i][0],signature,signatureLen) == 0){
        Serial.println("SE050 Generated Signature matches test vector");
      }else{
        Serial.println("SE050 Generated Signature does not match test vector");
        Serial.print("Signature from test vector: ");
        printBufferHex(&s[i][0], S_LEN);
      }
    }else{
      Serial.println("SE050 Generated Signature does not match test vector");
      Serial.print("Signature from test vector: ");
      printBufferHex(&s[i][0], S_LEN);
    }


    // To make the signature verifcation fail, uncomment the next line:
    //signature[0] = 0x00;

    // validate the signature
    if (SE05X.VerifyRSASSA_PSS(KeyId, hash, hashLen, &s[i][0], S_LEN)){
      Serial.println("test vector Verified");
      if(result[i]){
        Serial.println("---TEST PASSED---");
      }else{
        Serial.println("---TEST FAILED---");
      }
    }
    else
    {
      Serial.println("failed to verify test vector");
      if(!result[i]){
        Serial.println("---TEST PASSED---");
      }else{
        Serial.println("---TEST FAILED---");
      }
    }
  }

  SE05X.deleteBinaryObject(KeyId);
}


void loop() {

}
