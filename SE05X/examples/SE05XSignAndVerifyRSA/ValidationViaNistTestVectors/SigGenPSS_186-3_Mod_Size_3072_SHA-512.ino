#include <SE05X.h>

// CAVS 11.4
const char currentTest[] = "FIPS186-3 - SigGenPSS_186-3 RSASSA-PSS: Mod Size 3072 with SHA-512(Salt len: 62)";
const byte n[] = {0xa7, 0xa1, 0x88, 0x2a, 0x7f, 0xb8, 0x96, 0x78, 0x60, 0x34, 0xd0, 0x7f, 0xb1,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 0xde, 0x8b}; // Length: 384 bytes
const byte e[] = {0x00, 0x14, 0x15, 0xa7}; // Length: 4 bytes
const byte d[] = {0x07, 0x3a, 0x5f, 0xc4, 0xcd, 0x64, 0x2f, 0x61, 0x13, 0xdf, 0xfc, 0x4f, 0x84,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 0x96, 0x0b}; // Length: 384 bytes
byte saltVal[] = {0x2d, 0x0c, 0x49, 0xb2, 0x07, 0x89, 0xf3, 0x95, 0x02, 0xee, 0xfd, 0x09, 0x2a,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 0xe7, 0x83}; // Length: 62 bytes
// Messages (msg)
const byte msg[10][128] = {
  {0x44, 0x24, 0x0c, 0xe5, 0x19, 0xf0, 0x02, 0x39, 0xbd, 0x66, 0xba, 0x03, 0xc8,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 0x79, 0x58},
  {0x06, 0xd5, 0x53, 0x4b, 0x77, 0x69, 0x25, 0x6e, 0x8c, 0xf6, 0x5c, 0x6c, 0xe5,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 0xca, 0xae},
  {0x75, 0x6c, 0x51, 0xba, 0xe6, 0x1d, 0x75, 0xe8, 0xcf, 0x44, 0x93, 0x0e, 0x17,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 0xf4, 0xca},
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  {0xdc, 0xc2, 0x71, 0xb1, 0xbb, 0x2e, 0x50, 0xeb, 0xc2, 0x33, 0x30, 0xbe, 0x36,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 0xb8, 0x26}
}; // 10 vectors, each of max length 128 bytes
#define MSG_LEN 128

// Signatures (s)
const byte s[10][384] = {
  {0x8f, 0x47, 0xab, 0xc2, 0x32, 0x6e, 0x22, 0xcf, 0x62, 0x40, 0x45, 0x08, 0xb4,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 0x12, 0x64},
  {0x91, 0x3f, 0xc1, 0x18, 0xd5, 0xac, 0x1e, 0xdf, 0xfb, 0x4b, 0x8f, 0xcf, 0xa4,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 0xc6, 0xa6},
  {0x73, 0x51, 0x86, 0xeb, 0xf0, 0x8d, 0x50, 0x51, 0x61, 0xa8, 0xba, 0xb3, 0x67,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 0x4e, 0xeb},
  {0x60, 0x3f, 0xf6, 0x3f, 0xf6, 0x38, 0xf1, 0xad, 0x41, 0x0e, 0x26, 0x6d, 0x82,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 0x9c, 0xad},
  {0x87, 0x8b, 0x9a, 0x44, 0x39, 0x21, 0xbc, 0x7d, 0x72, 0x0e, 0x3e, 0x28, 0x8e,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 0x84, 0x8c},
  {0x26, 0x57, 0x49, 0xf7, 0xaf, 0xb1, 0xe1, 0xd1, 0x64, 0x92, 0xee, 0xbc, 0xee,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 0x8e, 0xb3},
  {0x84, 0xa2, 0x1a, 0x5c, 0xc0, 0x60, 0xd1, 0x41, 0xba, 0x9c, 0xae, 0xca, 0x77,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 0x4c, 0x0f},
  {0x86, 0xec, 0xe9, 0x32, 0x1f, 0xaf, 0x13, 0x87, 0xde, 0x6a, 0xfa, 0x7b, 0x1e,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 0x6f, 0x14},
  {0x57, 0xd8, 0x27, 0x59, 0x3a, 0xd0, 0x9f, 0x00, 0x00, 0x5f, 0xf1, 0xba, 0x45,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 0x02, 0x65},
  {0x0a, 0xc9, 0x38, 0xab, 0x04, 0xbf, 0x4e, 0xfa, 0x58, 0x7e, 0x34, 0x14, 0x34,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 0xf4, 0x86}
}; // 10 vectors, each of max length 384 bytes
#define S_LEN 384

void printBufferHex(const byte input[], size_t inputLength)
{
  for (size_t i = 0; i < inputLength; i++) {
    Serial.print(input[i] >> 4, HEX);
    Serial.print(input[i] & 0x0f, HEX);
    Serial.print(",");
  }
  Serial.println();
}

void setup() {
  Serial.begin(9600);
  while (!Serial);

  if (!SE05X.begin()) {
    Serial.println("Failed to communicate with SE05X!");
    while (1);
  }

  Serial.println(currentTest);
  const int KeyId = 9996;
  
  SE05X.deleteBinaryObject(KeyId);
  SE05X.writeRSAKey(KeyId,
                    kSE05x_RSABitLength_3072,
                    NULL,
                    0,
                    NULL,
                    0,
                    NULL,
                    0,
                    NULL,
                    0,
                    NULL,
                    0,
                    e,
                    sizeof(e),
                    d,
                    sizeof(d),
                    n,
                    sizeof(n),
                    kSE05x_RSAKeyFormat_RAW,
                    false,
                    kSE05x_KeyPart_Pair,
                    NULL);

  byte sha512[64] = {0};
  byte emsa[384] = {0};
  size_t sha512Len = 64;
  size_t emsaLen = 384;
  byte signature[384] = {0};
  size_t signatureLen = 0;

  for(int i = 0; i < 10; i++){
    Serial.println("");
    Serial.print("Test ");
    Serial.println((i+1));

    // print the input
    Serial.print("Input is:                     ");
    printBufferHex(&msg[i][0], MSG_LEN);

    //calculate the input SHA512
    sha512Len = 64;
    SE05X.beginSHA512();
    SE05X.updateSHA512(&msg[i][0], MSG_LEN);
    SE05X.endSHA512(sha512, &sha512Len);

    Serial.print("Input SHA512 is:              ");
    printBufferHex(sha512, sha512Len);

    emsaLen = 384;
    SE05X.emsa_pss_encode(sha512, sha512Len, emsa, &emsaLen, kSE05x_RSASignatureAlgo_SHA512_PKCS1_PSS, kSE05x_RSABitLength_3072,saltVal,sizeof(saltVal));
    Serial.print("emsa is:                     ");
    printBufferHex(emsa, emsaLen);

    // calculate the signature
    signatureLen = 0;
    SE05X.SignRSA(KeyId, emsa, emsaLen, signature, sizeof(signature), &signatureLen);

    // print the signature
    Serial.print("Signature using KeyId ");
    Serial.print(KeyId);
    Serial.print(" is: ");
    printBufferHex(signature, signatureLen);
    Serial.println();
    
    // To make the signature verifcation + the signature comparison fail, uncomment the next line:
    //signature[0] = 0x00;
    if(signatureLen == S_LEN){
      if(memcmp(&s[i][0],signature,signatureLen) == 0){
        Serial.println("Generated Signature matches test vector - passed");
      }else{
        Serial.println("Generated Signature does not match test vector - failed");
      }
    }else{
      Serial.println("Generated Signature does not match test vector - failed");
    }


    // To make the signature verifcation fail, uncomment the next line:
    //signature[0] = 0x00;

    // validate the signature
    if (SE05X.VerifyRSASSA_PSS(KeyId, sha512, sha512Len, signature, signatureLen)){
      Serial.println("Verified signature successfully :D");
    }
    else
    {
      Serial.println("oh no! failed to verify signature :(");
    }
  }

  SE05X.deleteBinaryObject(KeyId);
}


void loop() {

}
