#include <SE05X.h>

// CAVS 11.4
const char currentTest[] = "FIPS186-3 - SigGenPSS_186-3 RSASSA-PSS: Mod Size 3072 with SHA-384(Salt len: 48)";
const byte n[] = {0xa7, 0xa1, 0x88, 0x2a, 0x7f, 0xb8, 0x96, 0x78, 0x60, 0x34, 0xd0, 0x7f, 0xb1,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 0xde, 0x8b}; // Length: 384 bytes
const byte e[] = {0x00, 0x14, 0x15, 0xa7}; // Length: 4 bytes
const byte d[] = {0x07, 0x3a, 0x5f, 0xc4, 0xcd, 0x64, 0x2f, 0x61, 0x13, 0xdf, 0xfc, 0x4f, 0x84,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 0x96, 0x0b}; // Length: 384 bytes
byte saltVal[] = {0x61, 0xa7, 0x62, 0xf8, 0x96, 0x8d, 0x5f, 0x36, 0x7e, 0x2d, 0xbc, 0xac, 0xb4,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 0x14, 0x52}; // Length: 48 bytes
// Messages (msg)
const byte msg[10][128] = {
  {0x92, 0x21, 0xf0, 0xfe, 0x91, 0x15, 0x84, 0x35, 0x54, 0xd5, 0x68, 0x5d, 0x9f,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 0xf2, 0xc2},
  {0x75, 0x2a, 0x99, 0x16, 0xf4, 0x49, 0xae, 0xbf, 0x81, 0x4c, 0xe5, 0x9c, 0xa6,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 0xec, 0x58},
  {0x04, 0x03, 0xef, 0x21, 0x99, 0x38, 0xb8, 0xcd, 0xbf, 0x85, 0xd3, 0xb8, 0x8c,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 0x3b, 0xcf},
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  {0xa0, 0x5e, 0x57, 0x82, 0xa9, 0x6e, 0xe6, 0xd6, 0xf1, 0x0b, 0xe8, 0x83, 0x0d,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 0x02, 0x99}
}; // 10 vectors, each of max length 128 bytes
#define MSG_LEN 128

// Signatures (s)
const byte s[10][384] = {
  {0x96, 0x87, 0x11, 0x5b, 0xe4, 0x78, 0xe4, 0xb6, 0x42, 0xcd, 0x36, 0x93, 0x92,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 0x86, 0x98},
  {0x66, 0x46, 0xa8, 0x8e, 0xe4, 0xb8, 0x45, 0xda, 0x49, 0x31, 0x27, 0x4c, 0x23,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 0x9e, 0xc4},
  {0x0a, 0x21, 0x75, 0x03, 0xfc, 0x48, 0x70, 0x48, 0x12, 0x64, 0xd8, 0x30, 0x82,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 0x1d, 0x78},
  {0x6e, 0xc2, 0x2b, 0xd5, 0x8c, 0x32, 0xd4, 0x13, 0x74, 0xc0, 0x17, 0xa7, 0x70,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 0x0f, 0xba},
  {0x62, 0xa5, 0x05, 0xb3, 0xf3, 0xad, 0xda, 0x45, 0xc6, 0xba, 0xdb, 0x61, 0xb4,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 0x3f, 0x74},
  {0x1f, 0x06, 0x8b, 0xd0, 0x83, 0xa2, 0x65, 0x34, 0x04, 0x0f, 0x41, 0xc1, 0x38,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 0xcc, 0x8b},
  {0x18, 0xcb, 0x47, 0xbb, 0xf8, 0x0b, 0xad, 0x51, 0x00, 0x64, 0x24, 0x83, 0x04,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 0x20, 0x6e},
  {0x80, 0xba, 0xa6, 0x63, 0x87, 0x76, 0x15, 0xc2, 0xe7, 0xca, 0x9d, 0xd8, 0x99,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 0xfb, 0x00},
  {0x26, 0x11, 0x80, 0x71, 0x7e, 0xdd, 0x90, 0x5b, 0x64, 0x7b, 0xc8, 0x69, 0xf5,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 0x45, 0x9e},
  {0x87, 0xd8, 0x02, 0x75, 0xdf, 0x7b, 0x19, 0x6b, 0x7e, 0x1d, 0x0a, 0x41, 0x14,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 0x27, 0x91}
}; // 10 vectors, each of max length 384 bytes
#define S_LEN 384

void printBufferHex(const byte input[], size_t inputLength)
{
  for (size_t i = 0; i < inputLength; i++) {
    Serial.print(input[i] >> 4, HEX);
    Serial.print(input[i] & 0x0f, HEX);
    Serial.print(",");
  }
  Serial.println();
}

void setup() {
  Serial.begin(9600);
  while (!Serial);

  if (!SE05X.begin()) {
    Serial.println("Failed to communicate with SE05X!");
    while (1);
  }

  Serial.println(currentTest);
  const int KeyId = 9996;
  
  SE05X.deleteBinaryObject(KeyId);
  SE05X.writeRSAKey(KeyId,
                    kSE05x_RSABitLength_3072,
                    NULL,
                    0,
                    NULL,
                    0,
                    NULL,
                    0,
                    NULL,
                    0,
                    NULL,
                    0,
                    e,
                    sizeof(e),
                    d,
                    sizeof(d),
                    n,
                    sizeof(n),
                    kSE05x_RSAKeyFormat_RAW,
                    false,
                    kSE05x_KeyPart_Pair,
                    NULL);

  byte sha384[64] = {0};
  byte emsa[384] = {0};
  size_t sha384Len = 64;
  size_t emsaLen = 384;
  byte signature[384] = {0};
  size_t signatureLen = 0;

  for(int i = 0; i < 10; i++){
    Serial.println("");
    Serial.print("Test ");
    Serial.println((i+1));

    // print the input
    Serial.print("Input is:                     ");
    printBufferHex(&msg[i][0], MSG_LEN);

    //calculate the input SHA384
    sha384Len = 64;
    SE05X.beginSHA384();
    SE05X.updateSHA384(&msg[i][0], MSG_LEN);
    SE05X.endSHA384(sha384, &sha384Len);

    Serial.print("Input SHA384 is:              ");
    printBufferHex(sha384, sha384Len);

    emsaLen = 384;
    SE05X.emsa_pss_encode(sha384, sha384Len, emsa, &emsaLen, kSE05x_RSASignatureAlgo_SHA384_PKCS1_PSS, kSE05x_RSABitLength_3072,saltVal,sizeof(saltVal));
    Serial.print("emsa is:                     ");
    printBufferHex(emsa, emsaLen);

    // calculate the signature
    signatureLen = 0;
    SE05X.SignRSA(KeyId, emsa, emsaLen, signature, sizeof(signature), &signatureLen);

    // print the signature
    Serial.print("Signature using KeyId ");
    Serial.print(KeyId);
    Serial.print(" is: ");
    printBufferHex(signature, signatureLen);
    Serial.println();
    
    // To make the signature verifcation + the signature comparison fail, uncomment the next line:
    //signature[0] = 0x00;
    if(signatureLen == S_LEN){
      if(memcmp(&s[i][0],signature,signatureLen) == 0){
        Serial.println("Generated Signature matches test vector - passed");
      }else{
        Serial.println("Generated Signature does not match test vector - failed");
      }
    }else{
      Serial.println("Generated Signature does not match test vector - failed");
    }


    // To make the signature verifcation fail, uncomment the next line:
    //signature[0] = 0x00;

    // validate the signature
    if (SE05X.VerifyRSASSA_PSS(KeyId, sha384, sha384Len, signature, signatureLen)){
      Serial.println("Verified signature successfully :D");
    }
    else
    {
      Serial.println("oh no! failed to verify signature :(");
    }
  }

  SE05X.deleteBinaryObject(KeyId);
}


void loop() {

}
