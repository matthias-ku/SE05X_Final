#include <SE05X.h>

// CAVS 11.1
const char currentTest[] = "FIPS186-3 - SigVerPSS_186-3 RSASSA-PSS: Mod Size 1024 with SHA-256(Salt len: 20)";

#define SHA1_LENGTH                 20
#define SHA224_LENGTH               28
#define SHA256_LENGTH               32
#define SHA384_LENGTH               48
#define SHA512_LENGTH               64

#define E_LEN                       4
#define N_LEN                       128
#define D_LEN                       128

#define S_LEN                       N_LEN
#define MSG_LEN                     128
#define HASH_LEN                    SHA256_LENGTH
#define SALT_LEN                    20


// RSA Modulus (n)
const byte n[] = {0xbf, 0x15, 0xc7, 0xa3, 0x44, 0xdb, 0x52, 0xc3, 0xda, 0x4c, 0x73, 0xbb, 0xe1,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 0x41, 0x2b}; // Length: 128 bytes

// Public Exponent (e)
const byte e[6][4] = {
    {0x00, 0x18, 0x3a, 0x77},
    {0x00, 0x18, 0x3a, 0x77},
    {0x00, 0x67, 0x10, 0x9f},
    {0x00, 0x18, 0x3a, 0x77},
    {0x00, 0x18, 0x3a, 0x77},
    {0x00, 0x18, 0x3a, 0x77}
}; // 6 vectors, each of max length 4 bytes

// Private Exponent (d)
const byte d[6][128] = {
    {0x27, 0xd4, 0x64, 0x33, 0xe4, 0xa9, 0x6f, 0x10, 0x89, 0xc9, 0xda, 0x5e, 0x63,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 0x8e, 0x07},
    {0x27, 0xd4, 0x64, 0x33, 0xe4, 0xa9, 0x6f, 0x10, 0x89, 0xc9, 0xda, 0x5e, 0x63,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 0x8e, 0x07},
    {0x27, 0xd4, 0x64, 0x33, 0xe4, 0xa9, 0x6f, 0x10, 0x89, 0xc9, 0xda, 0x5e, 0x63,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 0x8e, 0x07},
    {0x27, 0xd4, 0x64, 0x33, 0xe4, 0xa9, 0x6f, 0x10, 0x89, 0xc9, 0xda, 0x5e, 0x63,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 0x8e, 0x07},
    {0x27, 0xd4, 0x64, 0x33, 0xe4, 0xa9, 0x6f, 0x10, 0x89, 0xc9, 0xda, 0x5e, 0x63,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 0x8e, 0x07},
    {0x27, 0xd4, 0x64, 0x33, 0xe4, 0xa9, 0x6f, 0x10, 0x89, 0xc9, 0xda, 0x5e, 0x63,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 0x8e, 0x07}
}; // 6 vectors, each of max length 128 bytes

// Messages (msg)
const byte msg[6][128] = {
    {0x14, 0xcc, 0xac, 0xa3, 0xe4, 0xe3, 0x13, 0xa9, 0x60, 0x02, 0x3c, 0xe1, 0xea,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 0x01, 0xc3},
    {0x0b, 0x95, 0x96, 0x27, 0x64, 0xca, 0x74, 0x54, 0xc8, 0x21, 0x2a, 0x44, 0x07,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 0x9d, 0xfe},
    {0xe5, 0x49, 0x4b, 0xe7, 0x9a, 0xa1, 0x19, 0x36, 0xc2, 0x26, 0xd2, 0x6f, 0x26,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 0xc4, 0x02},
    {0x36, 0x20, 0x22, 0x0d, 0xeb, 0x21, 0x01, 0x07, 0x75, 0x55, 0x29, 0x82, 0x67,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 0xbe, 0x6e},
    {0x75, 0xd4, 0x62, 0x56, 0x8e, 0xdb, 0x86, 0x7e, 0x99, 0x6e, 0xf0, 0x19, 0x7d,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 0x44, 0x63},
    {0x37, 0x2c, 0x9d, 0x4b, 0x73, 0xd3, 0xd7, 0x52, 0x7d, 0x99, 0x18, 0x17, 0xda,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 0xbb, 0x45}
}; // 6 vectors, each of max length 128 bytes

// Signatures (s)
const byte s[6][128] = {
    {0x93, 0xe0, 0xea, 0xb6, 0xad, 0x77, 0x4d, 0x35, 0xfb, 0xf9, 0x4f, 0x22, 0x26,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 0x2c, 0x05},
    {0x72, 0x87, 0xa0, 0xb4, 0xdb, 0x04, 0xc8, 0xc7, 0x95, 0x01, 0x8c, 0xf8, 0x18,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 0x03, 0x1d},
    {0x98, 0x3e, 0x58, 0xdd, 0x64, 0xd1, 0xdc, 0x36, 0x9a, 0x71, 0x48, 0x5a, 0x49,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 0xc8, 0x4b},
    {0x3e, 0x9d, 0x52, 0x8a, 0x7b, 0xdb, 0xb9, 0xd1, 0x08, 0x33, 0x84, 0xe6, 0x74,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 0x1f, 0xeb},
    {0x97, 0x82, 0x8f, 0x3a, 0x8b, 0x86, 0x4a, 0x95, 0xc1, 0x9b, 0x61, 0x7a, 0xaa,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 0x1c, 0x88},
    {0x7e, 0xa2, 0x7b, 0xfe, 0x42, 0x25, 0x07, 0xd9, 0xf4, 0x0f, 0x52, 0x00, 0xba,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 0x1c, 0x6e}
}; // 6 vectors, each of max length 128 bytes

// Salt Value (SaltVal)
uint8_t saltVal[6][20] = {
    {0x50, 0x73, 0x72, 0xaf, 0xff, 0xeb, 0xc2, 0xd6, 0x7c, 0xd7, 0x14, 0xe3, 0x8e, 0x36, 0x77, 0x76, 0xe3, 0x4b, 0x37, 0x7a},
    {0x50, 0x73, 0x72, 0xaf, 0xff, 0xeb, 0xc2, 0xd6, 0x7c, 0xd7, 0x14, 0xe3, 0x8e, 0x36, 0x77, 0x76, 0xe3, 0x4b, 0x37, 0x7a},
    {0x50, 0x73, 0x72, 0xaf, 0xff, 0xeb, 0xc2, 0xd6, 0x7c, 0xd7, 0x14, 0xe3, 0x8e, 0x36, 0x77, 0x76, 0xe3, 0x4b, 0x37, 0x7a},
    {0x50, 0x73, 0x72, 0xaf, 0xff, 0xeb, 0xc2, 0xd6, 0x7c, 0xd7, 0x14, 0xe3, 0x8e, 0x36, 0x77, 0x76, 0xe3, 0x4b, 0x37, 0x7a},
    {0x50, 0x73, 0x72, 0xaf, 0xff, 0xeb, 0xc2, 0xd6, 0x7c, 0xd7, 0x14, 0xe3, 0x8e, 0x36, 0x77, 0x76, 0xe3, 0x4b, 0x37, 0x7a},
    {0x50, 0x73, 0x72, 0xaf, 0xff, 0xeb, 0xc2, 0xd6, 0x7c, 0xd7, 0x14, 0xe3, 0x8e, 0x36, 0x77, 0x76, 0xe3, 0x4b, 0x37, 0x7a}
}; // 6 vectors, each of max length 20 bytes

// Expected results
bool result[] = { 0, 1, 0, 0, 0, 0 };

const int num_vectors = 6; // Number of test vectors

void printBufferHex(const byte input[], size_t inputLength)
{
  for (size_t i = 0; i < inputLength; i++) {
    Serial.print(input[i] >> 4, HEX);
    Serial.print(input[i] & 0x0f, HEX);
    Serial.print(",");
  }
  Serial.println();
}

void setup() {
  Serial.begin(9600);
  while (!Serial);

  if (!SE05X.begin()) {
    Serial.println("Failed to communicate with SE05X!");
    while (1);
  }

  Serial.println(currentTest);

  byte hash[HASH_LEN] = {0};
  size_t hashLen = HASH_LEN;
  byte emsa[N_LEN] = {0};
  size_t emsaLen = N_LEN;
  byte signature[N_LEN] = {0};
  size_t signatureLen = 0;

  const int KeyId = 9996;
  for(int i = 0; i < num_vectors; i++){

    SE05X.deleteBinaryObject(KeyId);
    SE05X.writeRSAKey(KeyId,
                      kSE05x_RSABitLength_1024,
                      NULL,
                      0,
                      NULL,
                      0,
                      NULL,
                      0,
                      NULL,
                      0,
                      NULL,
                      0,
                      &e[i][0],
                      E_LEN,
                      &d[i][0],
                      D_LEN,
                      n,
                      N_LEN,
                      kSE05x_RSAKeyFormat_RAW,
                      false,
                      kSE05x_KeyPart_Pair,
                      NULL);

    Serial.println("");
    Serial.print("Test ");
    Serial.println((i+1));

    // print the input
    Serial.print("Input is:                     ");
    printBufferHex(&msg[i][0], MSG_LEN);

    //calculate the input hash
    hashLen = HASH_LEN;
    SE05X.beginSHA256();
    SE05X.updateSHA256(&msg[i][0], MSG_LEN);
    SE05X.endSHA256(hash, &hashLen);

    Serial.print("Input SHA256 is:              ");
    printBufferHex(hash, hashLen);

    emsaLen = S_LEN;
    SE05X.emsa_pss_encode(hash, hashLen, emsa, &emsaLen, kSE05x_RSASignatureAlgo_SHA256_PKCS1_PSS, kSE05x_RSABitLength_1024, &saltVal[i][0], SALT_LEN);
    Serial.print("emsa is:                     ");
    printBufferHex(emsa, emsaLen);

    // calculate the signature
    signatureLen = 0;
    SE05X.SignRSA(KeyId, emsa, emsaLen, signature, sizeof(signature), &signatureLen);

    // print the signature
    Serial.print("Signature using KeyId ");
    Serial.print(KeyId);
    Serial.print(" is: ");
    printBufferHex(signature, signatureLen);
    Serial.println();
    
    // To make the signature verifcation + the signature comparison fail, uncomment the next line:
    //signature[0] = 0x00;
    if(signatureLen == S_LEN){
      if(memcmp(&s[i][0],signature,signatureLen) == 0){
        Serial.println("SE050 Generated Signature matches test vector");
      }else{
        Serial.println("SE050 Generated Signature does not match test vector");
        Serial.print("Signature from test vector: ");
        printBufferHex(&s[i][0], S_LEN);
      }
    }else{
      Serial.println("SE050 Generated Signature does not match test vector");
      Serial.print("Signature from test vector: ");
      printBufferHex(&s[i][0], S_LEN);
    }


    // To make the signature verifcation fail, uncomment the next line:
    //signature[0] = 0x00;

    // validate the signature
    if (SE05X.VerifyRSASSA_PSS(KeyId, hash, hashLen, &s[i][0], S_LEN)){
      Serial.println("test vector Verified");
      if(result[i]){
        Serial.println("---TEST PASSED---");
      }else{
        Serial.println("---TEST FAILED---");
      }
    }
    else
    {
      Serial.println("failed to verify test vector");
      if(!result[i]){
        Serial.println("---TEST PASSED---");
      }else{
        Serial.println("---TEST FAILED---");
      }
    }
  }

  SE05X.deleteBinaryObject(KeyId);
}


void loop() {

}
