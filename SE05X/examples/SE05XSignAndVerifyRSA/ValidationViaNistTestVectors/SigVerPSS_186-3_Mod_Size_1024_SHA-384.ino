#include <SE05X.h>

// CAVS 11.1
const char currentTest[] = "FIPS186-3 - SigVerPSS_186-3 RSASSA-PSS: Mod Size 1024 with SHA-384(Salt len: 20)";

#define SHA1_LENGTH                 20
#define SHA224_LENGTH               28
#define SHA256_LENGTH               32
#define SHA384_LENGTH               48
#define SHA512_LENGTH               64

#define E_LEN                       4
#define N_LEN                       128
#define D_LEN                       128

#define S_LEN                       N_LEN
#define MSG_LEN                     128
#define HASH_LEN                    SHA384_LENGTH
#define SALT_LEN                    20


// RSA Modulus (n)
const byte n[] = {0x8b, 0x71, 0xc2, 0xbc, 0xb3, 0x24, 0xa3, 0xfc, 0x23, 0xd2, 0x92, 0xfb, 0x4f,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 0x0e, 0x3f}; // Length: 128 bytes

// Public Exponent (e)
const byte e[6][4] = {
    {0x00, 0x35, 0xc6, 0x61},
    {0x00, 0x35, 0xc6, 0x61},
    {0x00, 0x35, 0xc6, 0x61},
    {0x00, 0x35, 0xc6, 0x61},
    {0x00, 0x35, 0xc6, 0x61},
    {0x00, 0xc7, 0x8d, 0x0b}
}; // 6 vectors, each of max length 4 bytes

// Private Exponent (d)
const byte d[6][128] = {
    {0x3e, 0x3e, 0x93, 0x86, 0xd7, 0x7f, 0x5a, 0x66, 0x9d, 0xa5, 0x42, 0x48, 0x26,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 0x34, 0x01},
    {0x3e, 0x3e, 0x93, 0x86, 0xd7, 0x7f, 0x5a, 0x66, 0x9d, 0xa5, 0x42, 0x48, 0x26,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 0x34, 0x01},
    {0x3e, 0x3e, 0x93, 0x86, 0xd7, 0x7f, 0x5a, 0x66, 0x9d, 0xa5, 0x42, 0x48, 0x26,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 0x34, 0x01},
    {0x3e, 0x3e, 0x93, 0x86, 0xd7, 0x7f, 0x5a, 0x66, 0x9d, 0xa5, 0x42, 0x48, 0x26,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 0x34, 0x01},
    {0x3e, 0x3e, 0x93, 0x86, 0xd7, 0x7f, 0x5a, 0x66, 0x9d, 0xa5, 0x42, 0x48, 0x26,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 0x34, 0x01},
    {0x3e, 0x3e, 0x93, 0x86, 0xd7, 0x7f, 0x5a, 0x66, 0x9d, 0xa5, 0x42, 0x48, 0x26,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 0x34, 0x01}
}; // 6 vectors, each of max length 128 bytes

// Messages (msg)
const byte msg[6][128] = {
    {0x78, 0xb8, 0xe3, 0x4e, 0x3d, 0x10, 0x26, 0xe8, 0x81, 0x48, 0xaf, 0xf5, 0xa0,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 0x6c, 0x93},
    {0x8a, 0xe6, 0x8a, 0xd4, 0x06, 0x31, 0x98, 0x1d, 0x0c, 0xb6, 0x84, 0x28, 0xc6,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 0xc6, 0x0d},
    {0xaa, 0xb8, 0x8f, 0xf7, 0x28, 0xc8, 0xf8, 0x29, 0x84, 0x1a, 0x14, 0xe5, 0x61,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 0x74, 0xd5},
    {0x5e, 0xc0, 0x47, 0x9f, 0x00, 0x10, 0xf6, 0xf1, 0x2a, 0x70, 0x7a, 0xb5, 0x2b,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 0xf7, 0x99},
    {0x3d, 0xe8, 0x62, 0xf4, 0xef, 0xd8, 0xbd, 0xa0, 0xf2, 0xf8, 0x25, 0x4f, 0x73,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 0xdf, 0x13},
    {0xbf, 0x08, 0x7c, 0xe3, 0x58, 0x2a, 0x94, 0x62, 0xc3, 0x70, 0x6a, 0x2e, 0xb7,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 0xe8, 0xdd}
}; // 6 vectors, each of max length 128 bytes

// Signatures (s)
const byte s[6][128] = {
    {0x69, 0x7f, 0x74, 0x22, 0xaa, 0x7b, 0xb4, 0x53, 0xc6, 0xb7, 0xe5, 0xc3, 0xc1,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 0xb0, 0xaf},
    {0x7c, 0x17, 0xbf, 0x8a, 0xae, 0xaf, 0xb9, 0xc9, 0x79, 0x66, 0xd9, 0x05, 0x20,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 0x25, 0x39},
    {0x65, 0x72, 0x96, 0xe9, 0x02, 0x33, 0x1b, 0x80, 0x30, 0xa7, 0x29, 0x20, 0xc6,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 0x17, 0xdd},
    {0x72, 0x02, 0xf1, 0xed, 0x02, 0xd8, 0x5d, 0x82, 0xb5, 0x74, 0xb0, 0x6f, 0xa3,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 0x02, 0x8e},
    {0x26, 0x06, 0x8d, 0x35, 0xb7, 0x7e, 0xd4, 0x68, 0x48, 0xc6, 0x00, 0x6f, 0xa7,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 0xfc, 0x09},
    {0x17, 0xcb, 0xca, 0xab, 0x77, 0x9f, 0xdd, 0x6a, 0xea, 0xc8, 0xf0, 0xb9, 0x0f,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 0x6d, 0x0a}
}; // 6 vectors, each of max length 128 bytes

// Salt Value (SaltVal)
uint8_t saltVal[6][20] = {
    {0xfa, 0x78, 0x5c, 0x07, 0xaa, 0xc7, 0x93, 0x3a, 0xd3, 0x4b, 0x46, 0x9f, 0x6a, 0x78, 0x2d, 0xe1, 0xfd, 0xf2, 0x6b, 0x67},
    {0xfa, 0x78, 0x5c, 0x07, 0xaa, 0xc7, 0x93, 0x3a, 0xd3, 0x4b, 0x46, 0x9f, 0x6a, 0x78, 0x2d, 0xe1, 0xfd, 0xf2, 0x6b, 0x67},
    {0xfa, 0x78, 0x5c, 0x07, 0xaa, 0xc7, 0x93, 0x3a, 0xd3, 0x4b, 0x46, 0x9f, 0x6a, 0x78, 0x2d, 0xe1, 0xfd, 0xf2, 0x6b, 0x67},
    {0xfa, 0x78, 0x5c, 0x07, 0xaa, 0xc7, 0x93, 0x3a, 0xd3, 0x4b, 0x46, 0x9f, 0x6a, 0x78, 0x2d, 0xe1, 0xfd, 0xf2, 0x6b, 0x67},
    {0xfa, 0x78, 0x5c, 0x07, 0xaa, 0xc7, 0x93, 0x3a, 0xd3, 0x4b, 0x46, 0x9f, 0x6a, 0x78, 0x2d, 0xe1, 0xfd, 0xf2, 0x6b, 0x67},
    {0xfa, 0x78, 0x5c, 0x07, 0xaa, 0xc7, 0x93, 0x3a, 0xd3, 0x4b, 0x46, 0x9f, 0x6a, 0x78, 0x2d, 0xe1, 0xfd, 0xf2, 0x6b, 0x67}
}; // 6 vectors, each of max length 20 bytes

// Expected results
bool result[] = { 0, 0, 1, 0, 0, 0 };

const int num_vectors = 6; // Number of test vectors

void printBufferHex(const byte input[], size_t inputLength)
{
  for (size_t i = 0; i < inputLength; i++) {
    Serial.print(input[i] >> 4, HEX);
    Serial.print(input[i] & 0x0f, HEX);
    Serial.print(",");
  }
  Serial.println();
}

void setup() {
  Serial.begin(9600);
  while (!Serial);

  if (!SE05X.begin()) {
    Serial.println("Failed to communicate with SE05X!");
    while (1);
  }

  Serial.println(currentTest);

  byte hash[HASH_LEN] = {0};
  size_t hashLen = HASH_LEN;
  byte emsa[N_LEN] = {0};
  size_t emsaLen = N_LEN;
  byte signature[N_LEN] = {0};
  size_t signatureLen = 0;

  const int KeyId = 9996;
  for(int i = 0; i < num_vectors; i++){

    SE05X.deleteBinaryObject(KeyId);
    SE05X.writeRSAKey(KeyId,
                      kSE05x_RSABitLength_1024,
                      NULL,
                      0,
                      NULL,
                      0,
                      NULL,
                      0,
                      NULL,
                      0,
                      NULL,
                      0,
                      &e[i][0],
                      E_LEN,
                      &d[i][0],
                      D_LEN,
                      n,
                      N_LEN,
                      kSE05x_RSAKeyFormat_RAW,
                      false,
                      kSE05x_KeyPart_Pair,
                      NULL);

    Serial.println("");
    Serial.print("Test ");
    Serial.println((i+1));

    // print the input
    Serial.print("Input is:                     ");
    printBufferHex(&msg[i][0], MSG_LEN);

    //calculate the input hash
    hashLen = HASH_LEN;
    SE05X.beginSHA384();
    SE05X.updateSHA384(&msg[i][0], MSG_LEN);
    SE05X.endSHA384(hash, &hashLen);

    Serial.print("Input SHA384 is:              ");
    printBufferHex(hash, hashLen);

    emsaLen = S_LEN;
    SE05X.emsa_pss_encode(hash, hashLen, emsa, &emsaLen, kSE05x_RSASignatureAlgo_SHA384_PKCS1_PSS, kSE05x_RSABitLength_1024, &saltVal[i][0], SALT_LEN);
    Serial.print("emsa is:                     ");
    printBufferHex(emsa, emsaLen);

    // calculate the signature
    signatureLen = 0;
    SE05X.SignRSA(KeyId, emsa, emsaLen, signature, sizeof(signature), &signatureLen);

    // print the signature
    Serial.print("Signature using KeyId ");
    Serial.print(KeyId);
    Serial.print(" is: ");
    printBufferHex(signature, signatureLen);
    Serial.println();
    
    // To make the signature verifcation + the signature comparison fail, uncomment the next line:
    //signature[0] = 0x00;
    if(signatureLen == S_LEN){
      if(memcmp(&s[i][0],signature,signatureLen) == 0){
        Serial.println("SE050 Generated Signature matches test vector");
      }else{
        Serial.println("SE050 Generated Signature does not match test vector");
        Serial.print("Signature from test vector: ");
        printBufferHex(&s[i][0], S_LEN);
      }
    }else{
      Serial.println("SE050 Generated Signature does not match test vector");
      Serial.print("Signature from test vector: ");
      printBufferHex(&s[i][0], S_LEN);
    }


    // To make the signature verifcation fail, uncomment the next line:
    //signature[0] = 0x00;

    // validate the signature
    if (SE05X.VerifyRSASSA_PSS(KeyId, hash, hashLen, &s[i][0], S_LEN)){
      Serial.println("test vector Verified");
      if(result[i]){
        Serial.println("---TEST PASSED---");
      }else{
        Serial.println("---TEST FAILED---");
      }
    }
    else
    {
      Serial.println("failed to verify test vector");
      if(!result[i]){
        Serial.println("---TEST PASSED---");
      }else{
        Serial.println("---TEST FAILED---");
      }
    }
  }

  SE05X.deleteBinaryObject(KeyId);
}


void loop() {

}
