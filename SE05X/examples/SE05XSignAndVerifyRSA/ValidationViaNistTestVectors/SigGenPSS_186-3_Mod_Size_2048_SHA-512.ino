#include <SE05X.h>

// CAVS 11.4
const char currentTest[] = "FIPS186-3 - SigGenPSS_186-3 RSASSA-PSS: Mod Size 2048 with SHA-512(Salt len: 30)";
const byte n[] = {0xc5, 0x06, 0x2b, 0x58, 0xd8, 0x53, 0x9c, 0x76, 0x5e, 0x1e, 0x5d, 0xba, 0xf1,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 0x05, 0xef}; // Length: 256 bytes
const byte e[] = {0x00, 0x86, 0xc9, 0x4f}; // Length: 4 bytes
const byte d[] = {0x49, 0xe5, 0x78, 0x6b, 0xb4, 0xd3, 0x32, 0xf9, 0x45, 0x86, 0x32, 0x7b, 0xde,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 0x06, 0x9f}; // Length: 256 bytes
byte saltVal[] = {0xaa, 0x10, 0xfe, 0xc3, 0xf8, 0x3b, 0x7a, 0x97, 0xe0, 0x92, 0x87, 0x7a, 0x5b, 0xf9, 0x08, 0x12, 0x83, 0xf5, 0x02, 0xa0, 0xa4, 0x6b, 0x50, 0xe3, 0x95, 0xab, 0x98, 0x3a, 0x49, 0xac}; // Length: 30 bytes

// Messages (msg)
const byte msg[10][128] = {
  {0x5f, 0x0f, 0xe2, 0xaf, 0xa6, 0x1b, 0x62, 0x8c, 0x43, 0xea, 0x3b, 0x6b, 0xa6,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 0xc3, 0x80},
  {0x9e, 0x88, 0x0c, 0xe5, 0x9f, 0x54, 0x7d, 0x59, 0x2c, 0x30, 0x9c, 0x22, 0xa2,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 0xdc, 0x7c},
  {0xa6, 0x13, 0x3c, 0xa4, 0x36, 0xd3, 0xf2, 0xe0, 0xa6, 0x56, 0x2f, 0x13, 0x89,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 0xba, 0xa9},
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  {0x6e, 0x87, 0x21, 0x4f, 0xc1, 0xa8, 0xb0, 0x11, 0x6f, 0x04, 0xa4, 0x5a, 0x67,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 0x70, 0x0b}
}; // 10 vectors, each of max length 128 bytes
#define MSG_LEN 128

// Signatures (s)
const byte s[10][256] = {
  {0x5e, 0x07, 0x12, 0xbb, 0x36, 0x3e, 0x50, 0x34, 0xef, 0x6b, 0x23, 0xc1, 0x19,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 0x04, 0x94},
  {0x8c, 0x4f, 0x81, 0x9e, 0x68, 0x20, 0x81, 0xbb, 0x16, 0xdd, 0xd4, 0x59, 0x66,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 0xcd, 0x00},
  {0x20, 0xce, 0xee, 0x0f, 0xd6, 0x20, 0x16, 0x0e, 0xf6, 0xa4, 0x09, 0x66, 0xfa,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 0xe2, 0x79},
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  {0x80, 0x2d, 0xb0, 0x67, 0xa8, 0xd9, 0x09, 0x67, 0xc2, 0x86, 0x0c, 0x90, 0x76,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 0xb6, 0xaa}
}; // 10 vectors, each of max length 256 bytes
#define S_LEN 256

void printBufferHex(const byte input[], size_t inputLength)
{
  for (size_t i = 0; i < inputLength; i++) {
    Serial.print(input[i] >> 4, HEX);
    Serial.print(input[i] & 0x0f, HEX);
    Serial.print(",");
  }
  Serial.println();
}

void setup() {
  Serial.begin(9600);
  while (!Serial);

  if (!SE05X.begin()) {
    Serial.println("Failed to communicate with SE05X!");
    while (1);
  }

  Serial.println(currentTest);
  const int KeyId = 9996;
  
  SE05X.deleteBinaryObject(KeyId);
  SE05X.writeRSAKey(KeyId,
                    kSE05x_RSABitLength_2048,
                    NULL,
                    0,
                    NULL,
                    0,
                    NULL,
                    0,
                    NULL,
                    0,
                    NULL,
                    0,
                    e,
                    sizeof(e),
                    d,
                    sizeof(d),
                    n,
                    sizeof(n),
                    kSE05x_RSAKeyFormat_RAW,
                    false,
                    kSE05x_KeyPart_Pair,
                    NULL);

  byte sha512[64] = {0};
  byte emsa[256] = {0};
  size_t sha512Len = 64;
  size_t emsaLen = 256;
  byte signature[256] = {0};
  size_t signatureLen = 0;

  for(int i = 0; i < 10; i++){
    Serial.println("");
    Serial.print("Test ");
    Serial.println((i+1));

    // print the input
    Serial.print("Input is:                     ");
    printBufferHex(&msg[i][0], MSG_LEN);

    //calculate the input SHA512
    sha512Len = 64;
    SE05X.beginSHA512();
    SE05X.updateSHA512(&msg[i][0], MSG_LEN);
    SE05X.endSHA512(sha512, &sha512Len);

    Serial.print("Input SHA512 is:              ");
    printBufferHex(sha512, sha512Len);

    emsaLen = 256;
    SE05X.emsa_pss_encode(sha512, sha512Len, emsa, &emsaLen, kSE05x_RSASignatureAlgo_SHA512_PKCS1_PSS, kSE05x_RSABitLength_2048,saltVal,sizeof(saltVal));
    Serial.print("emsa is:                     ");
    printBufferHex(emsa, emsaLen);

    // calculate the signature
    signatureLen = 0;
    SE05X.SignRSA(KeyId, emsa, emsaLen, signature, sizeof(signature), &signatureLen);

    // print the signature
    Serial.print("Signature using KeyId ");
    Serial.print(KeyId);
    Serial.print(" is: ");
    printBufferHex(signature, signatureLen);
    Serial.println();
    
    // To make the signature verifcation + the signature comparison fail, uncomment the next line:
    //signature[0] = 0x00;
    if(signatureLen == S_LEN){
      if(memcmp(&s[i][0],signature,signatureLen) == 0){
        Serial.println("Generated Signature matches test vector - passed");
      }else{
        Serial.println("Generated Signature does not match test vector - failed");
      }
    }else{
      Serial.println("Generated Signature does not match test vector - failed");
    }


    // To make the signature verifcation fail, uncomment the next line:
    //signature[0] = 0x00;

    // validate the signature
    if (SE05X.VerifyRSASSA_PSS(KeyId, sha512, sha512Len, signature, signatureLen)){
      Serial.println("Verified signature successfully :D");
    }
    else
    {
      Serial.println("oh no! failed to verify signature :(");
    }
  }

  SE05X.deleteBinaryObject(KeyId);
}


void loop() {

}
