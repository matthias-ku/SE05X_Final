#include <SE05X.h>

// CAVS 11.1
const char currentTest[] = "FIPS186-3 - SigVerPSS_186-3 RSASSA-PSS: Mod Size 2048 with SHA-384(Salt len: 48)";

#define SHA1_LENGTH                 20
#define SHA224_LENGTH               28
#define SHA256_LENGTH               32
#define SHA384_LENGTH               48
#define SHA512_LENGTH               64

#define E_LEN                       4
#define N_LEN                       256
#define D_LEN                       256

#define S_LEN                       N_LEN
#define MSG_LEN                     128
#define HASH_LEN                    SHA384_LENGTH
#define SALT_LEN                    48

// RSA Modulus (n)
const byte n[] = {0xcb, 0x59, 0xaa, 0xe3, 0x08, 0x83, 0xdb, 0x67, 0x8e, 0xa7, 0xb2, 0xa5, 0xe7,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 0xc0, 0xfd}; // Length: 256 bytes

// Public Exponent (e)
const byte e[6][4] = {
    {0x00, 0xcb, 0xb3, 0x43},
    {0x00, 0x24, 0xf1, 0xbf},
    {0x00, 0x24, 0xf1, 0xbf},
    {0x00, 0x24, 0xf1, 0xbf},
    {0x00, 0x24, 0xf1, 0xbf},
    {0x00, 0x24, 0xf1, 0xbf}
}; // 6 vectors, each of max length 4 bytes

// Private Exponent (d)
const byte d[6][256] = {
    {0x50, 0xcc, 0x6f, 0x7d, 0xd9, 0x97, 0x82, 0xce, 0x59, 0x43, 0xd7, 0x19, 0xec,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 0xa8, 0xc5},
    {0x50, 0xcc, 0x6f, 0x7d, 0xd9, 0x97, 0x82, 0xce, 0x59, 0x43, 0xd7, 0x19, 0xec,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 0xa8, 0xc5},
    {0x50, 0xcc, 0x6f, 0x7d, 0xd9, 0x97, 0x82, 0xce, 0x59, 0x43, 0xd7, 0x19, 0xec,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 0xa8, 0xc5},
    {0x50, 0xcc, 0x6f, 0x7d, 0xd9, 0x97, 0x82, 0xce, 0x59, 0x43, 0xd7, 0x19, 0xec,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 0xa8, 0xc5},
    {0x50, 0xcc, 0x6f, 0x7d, 0xd9, 0x97, 0x82, 0xce, 0x59, 0x43, 0xd7, 0x19, 0xec,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 0xa8, 0xc5},
    {0x50, 0xcc, 0x6f, 0x7d, 0xd9, 0x97, 0x82, 0xce, 0x59, 0x43, 0xd7, 0x19, 0xec,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 0xa8, 0xc5}
}; // 6 vectors, each of max length 256 bytes

// Messages (msg)
const byte msg[6][128] = {
    {0x32, 0x9b, 0x42, 0x57, 0xec, 0xe3, 0x4e, 0xcc, 0x01, 0x85, 0x03, 0x1b, 0x0b,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 0x8d, 0x54},
    {0x3c, 0xbc, 0x49, 0xd7, 0x3a, 0xdd, 0xbe, 0x28, 0x75, 0xdd, 0xe7, 0x79, 0x68,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 0xf8, 0xbd},
    {0x59, 0x63, 0x29, 0x17, 0xbc, 0xef, 0x9e, 0xaa, 0x6e, 0xdb, 0x1b, 0xb6, 0x01,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 0x8a, 0x4d},
    {0xb9, 0x40, 0x36, 0x22, 0xa6, 0x32, 0x79, 0x4f, 0x7c, 0xd7, 0x4f, 0xbb, 0xa9,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 0xbe, 0xd7},
    {0xf9, 0x91, 0xa4, 0x0a, 0x6c, 0x3c, 0xda, 0x01, 0xf1, 0xa2, 0xfe, 0xd0, 0x1c,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 0xd3, 0x71},
    {0xa9, 0x5e, 0xce, 0x43, 0x41, 0x21, 0x26, 0x9f, 0x4b, 0xf0, 0x36, 0x39, 0x5e,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 0x9e, 0x87}
}; // 6 vectors, each of max length 128 bytes

// Signatures (s)
const byte s[6][256] = {
    {0xbc, 0x7b, 0x06, 0x31, 0xf9, 0x2c, 0x7d, 0xfb, 0x0e, 0x3e, 0x86, 0x94, 0x65,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 0x1a, 0x41},
    {0x37, 0xc9, 0xca, 0x33, 0x3a, 0xde, 0x42, 0x3c, 0x46, 0x41, 0x9e, 0xa1, 0x6c,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 0xda, 0x71},
    {0x77, 0xa6, 0x9f, 0x4f, 0xbd, 0x94, 0x56, 0xeb, 0x8c, 0xb9, 0x73, 0xe2, 0x62,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 0x2e, 0x0b},
    {0x81, 0x51, 0x1a, 0x0c, 0x2e, 0xb3, 0x7d, 0x5c, 0x6f, 0xe2, 0xc2, 0x14, 0xc5,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 0xd9, 0xac},
    {0x6b, 0x42, 0x51, 0x4e, 0x88, 0xd9, 0x30, 0x79, 0xd1, 0x58, 0x33, 0x68, 0x97,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 0x17, 0xb1},
    {0xc8, 0x78, 0xb4, 0xb1, 0x45, 0x26, 0xef, 0xdf, 0xdb, 0x99, 0xf7, 0x28, 0x7c,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 0xea, 0xf0}
}; // 6 vectors, each of max length 256 bytes

// Salt Value (SaltVal)
uint8_t saltVal[6][48] = {
    {0x20, 0x18, 0xc6, 0x66, 0x3a, 0x97, 0x23, 0x04, 0x86, 0x80, 0x3e, 0x6f, 0x50,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 0xc6, 0x1a},
    {0x20, 0x18, 0xc6, 0x66, 0x3a, 0x97, 0x23, 0x04, 0x86, 0x80, 0x3e, 0x6f, 0x50,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 0xc6, 0x1a},
    {0x20, 0x18, 0xc6, 0x66, 0x3a, 0x97, 0x23, 0x04, 0x86, 0x80, 0x3e, 0x6f, 0x50,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 0xc6, 0x1a},
    {0x20, 0x18, 0xc6, 0x66, 0x3a, 0x97, 0x23, 0x04, 0x86, 0x80, 0x3e, 0x6f, 0x50,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 0xc6, 0x1a},
    {0x20, 0x18, 0xc6, 0x66, 0x3a, 0x97, 0x23, 0x04, 0x86, 0x80, 0x3e, 0x6f, 0x50,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 0xc6, 0x1a},
    {0x20, 0x18, 0xc6, 0x66, 0x3a, 0x97, 0x23, 0x04, 0x86, 0x80, 0x3e, 0x6f, 0x50,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 0xc6, 0x1a}
}; // 6 vectors, each of max length 48 bytes

// Expected results
bool result[] = { 0, 0, 0, 0, 1, 0 };
const int num_vectors = 6; // Number of test vectors

void printBufferHex(const byte input[], size_t inputLength)
{
  for (size_t i = 0; i < inputLength; i++) {
    Serial.print(input[i] >> 4, HEX);
    Serial.print(input[i] & 0x0f, HEX);
    Serial.print(",");
  }
  Serial.println();
}

void setup() {
  Serial.begin(9600);
  while (!Serial);

  if (!SE05X.begin()) {
    Serial.println("Failed to communicate with SE05X!");
    while (1);
  }

  Serial.println(currentTest);

  byte hash[HASH_LEN] = {0};
  size_t hashLen = HASH_LEN;
  byte emsa[N_LEN] = {0};
  size_t emsaLen = N_LEN;
  byte signature[N_LEN] = {0};
  size_t signatureLen = 0;

  const int KeyId = 9996;
  for(int i = 0; i < num_vectors; i++){

    SE05X.deleteBinaryObject(KeyId);
    SE05X.writeRSAKey(KeyId,
                      kSE05x_RSABitLength_2048,
                      NULL,
                      0,
                      NULL,
                      0,
                      NULL,
                      0,
                      NULL,
                      0,
                      NULL,
                      0,
                      &e[i][0],
                      E_LEN,
                      &d[i][0],
                      D_LEN,
                      n,
                      N_LEN,
                      kSE05x_RSAKeyFormat_RAW,
                      false,
                      kSE05x_KeyPart_Pair,
                      NULL);

    Serial.println("");
    Serial.print("Test ");
    Serial.println((i+1));

    // print the input
    Serial.print("Input is:                     ");
    printBufferHex(&msg[i][0], MSG_LEN);

    //calculate the input hash
    hashLen = HASH_LEN;
    SE05X.beginSHA384();
    SE05X.updateSHA384(&msg[i][0], MSG_LEN);
    SE05X.endSHA384(hash, &hashLen);

    Serial.print("Input SHA384 is:              ");
    printBufferHex(hash, hashLen);

    emsaLen = S_LEN;
    SE05X.emsa_pss_encode(hash, hashLen, emsa, &emsaLen, kSE05x_RSASignatureAlgo_SHA384_PKCS1_PSS, kSE05x_RSABitLength_2048, &saltVal[i][0], SALT_LEN);
    Serial.print("emsa is:                     ");
    printBufferHex(emsa, emsaLen);

    // calculate the signature
    signatureLen = 0;
    SE05X.SignRSA(KeyId, emsa, emsaLen, signature, sizeof(signature), &signatureLen);

    // print the signature
    Serial.print("Signature using KeyId ");
    Serial.print(KeyId);
    Serial.print(" is: ");
    printBufferHex(signature, signatureLen);
    Serial.println();
    
    // To make the signature verifcation + the signature comparison fail, uncomment the next line:
    //signature[0] = 0x00;
    if(signatureLen == S_LEN){
      if(memcmp(&s[i][0],signature,signatureLen) == 0){
        Serial.println("SE050 Generated Signature matches test vector");
      }else{
        Serial.println("SE050 Generated Signature does not match test vector");
        Serial.print("Signature from test vector: ");
        printBufferHex(&s[i][0], S_LEN);
      }
    }else{
      Serial.println("SE050 Generated Signature does not match test vector");
      Serial.print("Signature from test vector: ");
      printBufferHex(&s[i][0], S_LEN);
    }


    // To make the signature verifcation fail, uncomment the next line:
    //signature[0] = 0x00;

    // validate the signature
    if (SE05X.VerifyRSASSA_PSS(KeyId, hash, hashLen, &s[i][0], S_LEN)){
      Serial.println("test vector Verified");
      if(result[i]){
        Serial.println("---TEST PASSED---");
      }else{
        Serial.println("---TEST FAILED---");
      }
    }
    else
    {
      Serial.println("failed to verify test vector");
      if(!result[i]){
        Serial.println("---TEST PASSED---");
      }else{
        Serial.println("---TEST FAILED---");
      }
    }
  }

  SE05X.deleteBinaryObject(KeyId);
}


void loop() {

}
