#include <SE05X.h>

// CAVS 11.1
const char currentTest[] = "FIPS186-3 - SigVerPSS_186-3 RSASSA-PSS: Mod Size 2048 with SHA-224(Salt len: 28)";

#define SHA1_LENGTH                 20
#define SHA224_LENGTH               28
#define SHA256_LENGTH               32
#define SHA384_LENGTH               48
#define SHA512_LENGTH               64

#define E_LEN                       4
#define N_LEN                       256
#define D_LEN                       256

#define S_LEN                       N_LEN
#define MSG_LEN                     128
#define HASH_LEN                    SHA224_LENGTH
#define SALT_LEN                    28

// RSA Modulus (n)
const byte n[] = {0xac, 0xfd, 0xfb, 0x1d, 0xcb, 0x14, 0x59, 0xb4, 0x89, 0xcd, 0x4a, 0x8c, 0x9f,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 0xd7, 0x11}; // Length: 256 bytes

// Public Exponent (e)
const byte e[6][4] = {
    {0x00, 0xb2, 0x9b, 0xc5},
    {0x00, 0xb2, 0x9b, 0xc5},
    {0x00, 0xea, 0xf9, 0x89},
    {0x00, 0xb2, 0x9b, 0xc5},
    {0x00, 0xb2, 0x9b, 0xc5},
    {0x00, 0xb2, 0x9b, 0xc5}
}; // 6 vectors, each of max length 4 bytes

// Private Exponent (d)
const byte d[6][256] = {
    {0x29, 0xd8, 0x3f, 0x1a, 0x03, 0x2c, 0x6a, 0x17, 0x02, 0xd2, 0x5e, 0xb4, 0x7e,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 0xd6, 0x01},
    {0x29, 0xd8, 0x3f, 0x1a, 0x03, 0x2c, 0x6a, 0x17, 0x02, 0xd2, 0x5e, 0xb4, 0x7e,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 0xd6, 0x01},
    {0x29, 0xd8, 0x3f, 0x1a, 0x03, 0x2c, 0x6a, 0x17, 0x02, 0xd2, 0x5e, 0xb4, 0x7e,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 0xd6, 0x01},
    {0x29, 0xd8, 0x3f, 0x1a, 0x03, 0x2c, 0x6a, 0x17, 0x02, 0xd2, 0x5e, 0xb4, 0x7e,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 0xd6, 0x01},
    {0x29, 0xd8, 0x3f, 0x1a, 0x03, 0x2c, 0x6a, 0x17, 0x02, 0xd2, 0x5e, 0xb4, 0x7e,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 0xd6, 0x01},
    {0x29, 0xd8, 0x3f, 0x1a, 0x03, 0x2c, 0x6a, 0x17, 0x02, 0xd2, 0x5e, 0xb4, 0x7e,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 0xd6, 0x01}
}; // 6 vectors, each of max length 256 bytes

// Messages (msg)
const byte msg[6][128] = {
    {0x7c, 0xed, 0x8a, 0x54, 0xc8, 0xe3, 0x5e, 0xf5, 0xc8, 0x7d, 0x03, 0xee, 0x63,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 0xfa, 0x18},
    {0xc9, 0xa1, 0x21, 0xfa, 0x15, 0xbf, 0xfe, 0xfb, 0x86, 0x4f, 0xe3, 0xcf, 0xc2,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 0x4e, 0x6c},
    {0xcd, 0x69, 0xac, 0x8d, 0x1c, 0x46, 0xf5, 0x4d, 0x46, 0xcc, 0x9a, 0xff, 0x98,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 0x53, 0x17},
    {0x23, 0x70, 0x8e, 0x05, 0x5e, 0x89, 0x18, 0x26, 0xf8, 0x01, 0x1b, 0x1f, 0x48,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 0x49, 0xef},
    {0x0a, 0xf6, 0x36, 0x5d, 0x60, 0x65, 0xdf, 0xc4, 0x47, 0x95, 0xd8, 0x7a, 0x81,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 0x29, 0x00},
    {0x4c, 0xde, 0x2a, 0x6d, 0x9e, 0xcf, 0xde, 0xfa, 0x3c, 0x63, 0x1c, 0x95, 0xaa,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 0xbc, 0x4f}
}; // 6 vectors, each of max length 128 bytes

// Signatures (s)
const byte s[6][256] = {
    {0x8c, 0x07, 0x4b, 0xae, 0x48, 0x45, 0x48, 0x75, 0xae, 0xfa, 0x2b, 0x7e, 0xa0,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 0x45, 0xd7},
    {0x7d, 0x08, 0x1b, 0x0e, 0x38, 0xd7, 0x32, 0x56, 0x47, 0x63, 0x58, 0xc0, 0x13,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 0x12, 0x44},
    {0x57, 0x25, 0xc1, 0xac, 0x60, 0xb2, 0xd6, 0x10, 0x97, 0x7f, 0xae, 0x6c, 0x52,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 0x3f, 0x53},
    {0xa8, 0xcb, 0xf3, 0x4f, 0xfe, 0xfb, 0xa9, 0x16, 0xab, 0xf4, 0x96, 0x1a, 0x6a,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 0xc0, 0x93},
    {0x3b, 0x32, 0xda, 0xb5, 0x65, 0xd2, 0xf0, 0xa5, 0xac, 0x26, 0x7b, 0xa8, 0xfd,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 0x83, 0x5b},
    {0x41, 0x51, 0xdb, 0xee, 0x3d, 0x48, 0x3d, 0x20, 0xb5, 0x7b, 0x51, 0xd8, 0x0b,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 0x90, 0x81}
}; // 6 vectors, each of max length 256 bytes

// Salt Value (SaltVal)
uint8_t saltVal[6][28] = {
    {0xbb, 0x86, 0x90, 0x61, 0x94, 0xb3, 0x1f, 0xb6, 0xd2, 0x89, 0x31, 0xfe, 0xbe, 0xb8, 0x0d, 0x76, 0x74, 0x7e, 0x42, 0x7e, 0xa1, 0x62, 0x8e, 0xf0, 0x8c, 0x25, 0xff, 0xb0},
    {0xbb, 0x86, 0x90, 0x61, 0x94, 0xb3, 0x1f, 0xb6, 0xd2, 0x89, 0x31, 0xfe, 0xbe, 0xb8, 0x0d, 0x76, 0x74, 0x7e, 0x42, 0x7e, 0xa1, 0x62, 0x8e, 0xf0, 0x8c, 0x25, 0xff, 0xb0},
    {0xbb, 0x86, 0x90, 0x61, 0x94, 0xb3, 0x1f, 0xb6, 0xd2, 0x89, 0x31, 0xfe, 0xbe, 0xb8, 0x0d, 0x76, 0x74, 0x7e, 0x42, 0x7e, 0xa1, 0x62, 0x8e, 0xf0, 0x8c, 0x25, 0xff, 0xb0},
    {0xbb, 0x86, 0x90, 0x61, 0x94, 0xb3, 0x1f, 0xb6, 0xd2, 0x89, 0x31, 0xfe, 0xbe, 0xb8, 0x0d, 0x76, 0x74, 0x7e, 0x42, 0x7e, 0xa1, 0x62, 0x8e, 0xf0, 0x8c, 0x25, 0xff, 0xb0},
    {0xbb, 0x86, 0x90, 0x61, 0x94, 0xb3, 0x1f, 0xb6, 0xd2, 0x89, 0x31, 0xfe, 0xbe, 0xb8, 0x0d, 0x76, 0x74, 0x7e, 0x42, 0x7e, 0xa1, 0x62, 0x8e, 0xf0, 0x8c, 0x25, 0xff, 0xb0},
    {0xbb, 0x86, 0x90, 0x61, 0x94, 0xb3, 0x1f, 0xb6, 0xd2, 0x89, 0x31, 0xfe, 0xbe, 0xb8, 0x0d, 0x76, 0x74, 0x7e, 0x42, 0x7e, 0xa1, 0x62, 0x8e, 0xf0, 0x8c, 0x25, 0xff, 0xb0}
}; // 6 vectors, each of max length 28 bytes

// Expected results
bool result[] = { 1, 0, 0, 0, 0, 0 };
const int num_vectors = 6; // Number of test vectors

void printBufferHex(const byte input[], size_t inputLength)
{
  for (size_t i = 0; i < inputLength; i++) {
    Serial.print(input[i] >> 4, HEX);
    Serial.print(input[i] & 0x0f, HEX);
    Serial.print(",");
  }
  Serial.println();
}

void setup() {
  Serial.begin(9600);
  while (!Serial);

  if (!SE05X.begin()) {
    Serial.println("Failed to communicate with SE05X!");
    while (1);
  }

  Serial.println(currentTest);

  byte hash[HASH_LEN] = {0};
  size_t hashLen = HASH_LEN;
  byte emsa[N_LEN] = {0};
  size_t emsaLen = N_LEN;
  byte signature[N_LEN] = {0};
  size_t signatureLen = 0;

  const int KeyId = 9996;
  for(int i = 0; i < num_vectors; i++){

    SE05X.deleteBinaryObject(KeyId);
    SE05X.writeRSAKey(KeyId,
                      kSE05x_RSABitLength_2048,
                      NULL,
                      0,
                      NULL,
                      0,
                      NULL,
                      0,
                      NULL,
                      0,
                      NULL,
                      0,
                      &e[i][0],
                      E_LEN,
                      &d[i][0],
                      D_LEN,
                      n,
                      N_LEN,
                      kSE05x_RSAKeyFormat_RAW,
                      false,
                      kSE05x_KeyPart_Pair,
                      NULL);

    Serial.println("");
    Serial.print("Test ");
    Serial.println((i+1));

    // print the input
    Serial.print("Input is:                     ");
    printBufferHex(&msg[i][0], MSG_LEN);

    //calculate the input hash
    hashLen = HASH_LEN;
    SE05X.beginSHA224();
    SE05X.updateSHA224(&msg[i][0], MSG_LEN);
    SE05X.endSHA224(hash, &hashLen);

    Serial.print("Input SHA224 is:              ");
    printBufferHex(hash, hashLen);

    emsaLen = S_LEN;
    SE05X.emsa_pss_encode(hash, hashLen, emsa, &emsaLen, kSE05x_RSASignatureAlgo_SHA224_PKCS1_PSS, kSE05x_RSABitLength_2048, &saltVal[i][0], SALT_LEN);
    Serial.print("emsa is:                     ");
    printBufferHex(emsa, emsaLen);

    // calculate the signature
    signatureLen = 0;
    SE05X.SignRSA(KeyId, emsa, emsaLen, signature, sizeof(signature), &signatureLen);

    // print the signature
    Serial.print("Signature using KeyId ");
    Serial.print(KeyId);
    Serial.print(" is: ");
    printBufferHex(signature, signatureLen);
    Serial.println();
    
    // To make the signature verifcation + the signature comparison fail, uncomment the next line:
    //signature[0] = 0x00;
    if(signatureLen == S_LEN){
      if(memcmp(&s[i][0],signature,signatureLen) == 0){
        Serial.println("SE050 Generated Signature matches test vector");
      }else{
        Serial.println("SE050 Generated Signature does not match test vector");
        Serial.print("Signature from test vector: ");
        printBufferHex(&s[i][0], S_LEN);
      }
    }else{
      Serial.println("SE050 Generated Signature does not match test vector");
      Serial.print("Signature from test vector: ");
      printBufferHex(&s[i][0], S_LEN);
    }


    // To make the signature verifcation fail, uncomment the next line:
    //signature[0] = 0x00;

    // validate the signature
    if (SE05X.VerifyRSASSA_PSS(KeyId, hash, hashLen, &s[i][0], S_LEN)){
      Serial.println("test vector Verified");
      if(result[i]){
        Serial.println("---TEST PASSED---");
      }else{
        Serial.println("---TEST FAILED---");
      }
    }
    else
    {
      Serial.println("failed to verify test vector");
      if(!result[i]){
        Serial.println("---TEST PASSED---");
      }else{
        Serial.println("---TEST FAILED---");
      }
    }
  }

  SE05X.deleteBinaryObject(KeyId);
}


void loop() {

}
