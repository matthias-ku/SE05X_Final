#include <SE05X.h>

// CAVS 11.4
const char currentTest[] = "FIPS186-3 - SigGenPSS_186-3 RSASSA-PSS: Mod Size 2048 with SHA-384(Salt len: 25)";
const byte n[] = {0xc5, 0x06, 0x2b, 0x58, 0xd8, 0x53, 0x9c, 0x76, 0x5e, 0x1e, 0x5d, 0xba, 0xf1,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 0x05, 0xef}; // Length: 256 bytes
const byte e[] = {0x00, 0x86, 0xc9, 0x4f}; // Length: 4 bytes
const byte d[] = {0x49, 0xe5, 0x78, 0x6b, 0xb4, 0xd3, 0x32, 0xf9, 0x45, 0x86, 0x32, 0x7b, 0xde,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 0x06, 0x9f}; // Length: 256 bytes
byte saltVal[] = {0xb7, 0x50, 0x58, 0x76, 0x71, 0xaf, 0xd7, 0x68, 0x86, 0xe8, 0xff, 0xb7, 0x86, 0x5e, 0x78, 0xf7, 0x06, 0x64, 0x1b, 0x2e, 0x42, 0x51, 0xb4, 0x87, 0x06}; // Length: 25 bytes

// Messages (msg)
const byte msg[10][128] = {
  {0x83, 0x3a, 0xa2, 0xb1, 0xdc, 0xc7, 0x76, 0x07, 0xa4, 0x4e, 0x80, 0x4e, 0xe7,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 0xf1, 0x3e},
  {0x89, 0x25, 0xb8, 0x7e, 0x9d, 0x1d, 0x73, 0x9d, 0x8f, 0x97, 0x54, 0x50, 0xb7,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 0xeb, 0x1d},
  {0xd0, 0xeb, 0x46, 0x23, 0xee, 0xdb, 0xd9, 0x7e, 0xe0, 0x36, 0x72, 0xf8, 0xe4,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 0x30, 0x7e},
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  {0x88, 0x2c, 0x97, 0xfa, 0xd7, 0x63, 0xca, 0x23, 0x5b, 0x16, 0x2f, 0xba, 0x88,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 0xeb, 0xc6}
}; // 10 vectors, each of max length 128 bytes
#define MSG_LEN 128

// Signatures (s)
const byte s[10][256] = {
  {0x2c, 0xa3, 0x7a, 0x3d, 0x6a, 0xbd, 0x28, 0xc1, 0xea, 0xf9, 0xbd, 0xe5, 0xe7,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 0x26, 0xd2},
  {0x43, 0xef, 0x93, 0xd1, 0x4e, 0x89, 0xb0, 0x5d, 0x5e, 0x0d, 0xb2, 0xdb, 0xd5,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 0x71, 0xb7},
  {0x21, 0x3e, 0xa3, 0xfb, 0x11, 0xcd, 0xd7, 0x1b, 0xd5, 0xb8, 0x39, 0xde, 0x8a,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 0xe3, 0xfa},
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  {0x0c, 0x48, 0x50, 0xb8, 0x15, 0x16, 0x9c, 0xda, 0x5c, 0x11, 0xf7, 0x7b, 0xee,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 0xfe, 0xc6}
}; // 10 vectors, each of max length 256 bytes
#define S_LEN 256

void printBufferHex(const byte input[], size_t inputLength)
{
  for (size_t i = 0; i < inputLength; i++) {
    Serial.print(input[i] >> 4, HEX);
    Serial.print(input[i] & 0x0f, HEX);
    Serial.print(",");
  }
  Serial.println();
}

void setup() {
  Serial.begin(9600);
  while (!Serial);

  if (!SE05X.begin()) {
    Serial.println("Failed to communicate with SE05X!");
    while (1);
  }

  Serial.println(currentTest);
  const int KeyId = 9996;
  
  SE05X.deleteBinaryObject(KeyId);
  SE05X.writeRSAKey(KeyId,
                    kSE05x_RSABitLength_2048,
                    NULL,
                    0,
                    NULL,
                    0,
                    NULL,
                    0,
                    NULL,
                    0,
                    NULL,
                    0,
                    e,
                    sizeof(e),
                    d,
                    sizeof(d),
                    n,
                    sizeof(n),
                    kSE05x_RSAKeyFormat_RAW,
                    false,
                    kSE05x_KeyPart_Pair,
                    NULL);

  byte sha384[64] = {0};
  byte emsa[256] = {0};
  size_t sha384Len = 64;
  size_t emsaLen = 256;
  byte signature[256] = {0};
  size_t signatureLen = 0;

  for(int i = 0; i < 10; i++){
    Serial.println("");
    Serial.print("Test ");
    Serial.println((i+1));

    // print the input
    Serial.print("Input is:                     ");
    printBufferHex(&msg[i][0], MSG_LEN);

    //calculate the input SHA384
    sha384Len = 64;
    SE05X.beginSHA384();
    SE05X.updateSHA384(&msg[i][0], MSG_LEN);
    SE05X.endSHA384(sha384, &sha384Len);

    Serial.print("Input SHA384 is:              ");
    printBufferHex(sha384, sha384Len);

    emsaLen = 256;
    SE05X.emsa_pss_encode(sha384, sha384Len, emsa, &emsaLen, kSE05x_RSASignatureAlgo_SHA384_PKCS1_PSS, kSE05x_RSABitLength_2048,saltVal,sizeof(saltVal));
    Serial.print("emsa is:                     ");
    printBufferHex(emsa, emsaLen);

    // calculate the signature
    signatureLen = 0;
    SE05X.SignRSA(KeyId, emsa, emsaLen, signature, sizeof(signature), &signatureLen);

    // print the signature
    Serial.print("Signature using KeyId ");
    Serial.print(KeyId);
    Serial.print(" is: ");
    printBufferHex(signature, signatureLen);
    Serial.println();
    
    // To make the signature verifcation + the signature comparison fail, uncomment the next line:
    //signature[0] = 0x00;
    if(signatureLen == S_LEN){
      if(memcmp(&s[i][0],signature,signatureLen) == 0){
        Serial.println("Generated Signature matches test vector - passed");
      }else{
        Serial.println("Generated Signature does not match test vector - failed");
      }
    }else{
      Serial.println("Generated Signature does not match test vector - failed");
    }


    // To make the signature verifcation fail, uncomment the next line:
    //signature[0] = 0x00;

    // validate the signature
    if (SE05X.VerifyRSASSA_PSS(KeyId, sha384, sha384Len, signature, signatureLen)){
      Serial.println("Verified signature successfully :D");
    }
    else
    {
      Serial.println("oh no! failed to verify signature :(");
    }
  }

  SE05X.deleteBinaryObject(KeyId);
}


void loop() {

}
