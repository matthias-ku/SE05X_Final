#include <SE05X.h>

// CAVS 11.1
const char currentTest[] = "FIPS186-3 - SigVerPSS_186-3 RSASSA-PSS: Mod Size 2048 with SHA-256(Salt len: 32)";

#define SHA1_LENGTH                 20
#define SHA224_LENGTH               28
#define SHA256_LENGTH               32
#define SHA384_LENGTH               48
#define SHA512_LENGTH               64

#define E_LEN                       4
#define N_LEN                       256
#define D_LEN                       256

#define S_LEN                       N_LEN
#define MSG_LEN                     128
#define HASH_LEN                    SHA256_LENGTH
#define SALT_LEN                    32

// RSA Modulus (n)
const byte n[] = {0xa4, 0x7d, 0x04, 0xe7, 0xca, 0xcd, 0xba, 0x4e, 0xa2, 0x6e, 0xca, 0x8a, 0x4c,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 0x4d, 0x8b}; // Length: 256 bytes

// Public Exponent (e)
const byte e[6][4] = {
    {0x00, 0x10, 0xe4, 0x3f},
    {0x00, 0x10, 0xe4, 0x3f},
    {0x00, 0x10, 0xe4, 0x3f},
    {0x00, 0x10, 0xe4, 0x3f},
    {0x00, 0x10, 0xe4, 0x3f},
    {0x00, 0x3c, 0x6c, 0xd1}
}; // 6 vectors, each of max length 4 bytes

// Private Exponent (d)
const byte d[6][256] = {
    {0x11, 0xa0, 0xdd, 0x28, 0x5f, 0x66, 0x47, 0x1a, 0x8d, 0xa3, 0x0b, 0xcb, 0x8c,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 0xbd, 0x67},
    {0x11, 0xa0, 0xdd, 0x28, 0x5f, 0x66, 0x47, 0x1a, 0x8d, 0xa3, 0x0b, 0xcb, 0x8c,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 0xbd, 0x67},
    {0x11, 0xa0, 0xdd, 0x28, 0x5f, 0x66, 0x47, 0x1a, 0x8d, 0xa3, 0x0b, 0xcb, 0x8c,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 0xbd, 0x67},
    {0x11, 0xa0, 0xdd, 0x28, 0x5f, 0x66, 0x47, 0x1a, 0x8d, 0xa3, 0x0b, 0xcb, 0x8c,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 0xbd, 0x67},
    {0x11, 0xa0, 0xdd, 0x28, 0x5f, 0x66, 0x47, 0x1a, 0x8d, 0xa3, 0x0b, 0xcb, 0x8c,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 0xbd, 0x67},
    {0x11, 0xa0, 0xdd, 0x28, 0x5f, 0x66, 0x47, 0x1a, 0x8d, 0xa3, 0x0b, 0xcb, 0x8c,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 0xbd, 0x67}
}; // 6 vectors, each of max length 256 bytes

// Messages (msg)
const byte msg[6][128] = {
    {0x75, 0x18, 0xc8, 0x5b, 0x67, 0xe7, 0xae, 0xf7, 0xf2, 0x6b, 0xf0, 0x06, 0x89,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 0x88, 0x44},
    {0xe0, 0x02, 0x37, 0x7a, 0xff, 0xb0, 0x4f, 0x0f, 0xe4, 0x59, 0x8d, 0xe9, 0xd9,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 0x90, 0xa6},
    {0xa3, 0xbf, 0x44, 0xca, 0xe8, 0xaa, 0x83, 0x47, 0xfd, 0x07, 0xd8, 0x4a, 0x33,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 0xc2, 0xd9},
    {0xe1, 0xc4, 0x6c, 0x30, 0x9b, 0x63, 0x66, 0xfb, 0x4d, 0x56, 0xac, 0x08, 0xc9,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 0x93, 0xe7},
    {0x92, 0x5d, 0x59, 0xf9, 0x53, 0xcb, 0x3f, 0xfb, 0x6d, 0x5a, 0x3a, 0x55, 0xc0,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 0xe8, 0x4e},
    {0x08, 0xd3, 0xac, 0x24, 0xa5, 0x95, 0xda, 0x81, 0x1c, 0xc9, 0xbb, 0xa7, 0x88,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 0x34, 0xcd}
}; // 6 vectors, each of max length 128 bytes

// Signatures (s)
const byte s[6][256] = {
    {0x99, 0x2d, 0x48, 0xb2, 0x1b, 0xb3, 0xd2, 0x21, 0x9b, 0x44, 0xe8, 0xfc, 0xc8,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 0x8e, 0x5d},
    {0x4f, 0x9b, 0x42, 0x5c, 0x20, 0x58, 0x46, 0x0e, 0x4a, 0xb2, 0xf5, 0xc9, 0x63,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 0x22, 0x2d},
    {0x87, 0x7f, 0x20, 0xee, 0xd6, 0x0f, 0x8c, 0xe2, 0x86, 0x10, 0x8a, 0x5d, 0xde,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 0xb6, 0xbe},
    {0x8e, 0xd1, 0xf2, 0x8f, 0xd1, 0x6d, 0x45, 0xd4, 0x16, 0xa2, 0x15, 0x54, 0xe1,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 0xc5, 0xf4},
    {0x62, 0xb0, 0x7f, 0x6d, 0x1b, 0x8f, 0x13, 0x65, 0x1d, 0x7f, 0x22, 0xce, 0x2c,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 0x01, 0xc6},
    {0x72, 0xea, 0x7d, 0x66, 0x9a, 0xc6, 0x99, 0xa1, 0x49, 0xc1, 0x3a, 0xa1, 0x68,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 0x1a, 0x59}
}; // 6 vectors, each of max length 256 bytes

// Salt Value (SaltVal)
uint8_t saltVal[6][32] = {
    {0xd6, 0x6f, 0x72, 0xf1, 0x0b, 0x69, 0x00, 0x1a, 0x5b, 0x59, 0xcf, 0x10, 0x92, 0xad, 0x27, 0x4d, 0x50, 0x56, 0xc4, 0xe9, 0x5c, 0xcc, 0xcf, 0xbe, 0x3b, 0x53, 0x0d, 0xcb, 0x02, 0x7e, 0x57, 0xd6},
    {0xd6, 0x6f, 0x72, 0xf1, 0x0b, 0x69, 0x00, 0x1a, 0x5b, 0x59, 0xcf, 0x10, 0x92, 0xad, 0x27, 0x4d, 0x50, 0x56, 0xc4, 0xe9, 0x5c, 0xcc, 0xcf, 0xbe, 0x3b, 0x53, 0x0d, 0xcb, 0x02, 0x7e, 0x57, 0xd6},
    {0xd6, 0x6f, 0x72, 0xf1, 0x0b, 0x69, 0x00, 0x1a, 0x5b, 0x59, 0xcf, 0x10, 0x92, 0xad, 0x27, 0x4d, 0x50, 0x56, 0xc4, 0xe9, 0x5c, 0xcc, 0xcf, 0xbe, 0x3b, 0x53, 0x0d, 0xcb, 0x02, 0x7e, 0x57, 0xd6},
    {0xd6, 0x6f, 0x72, 0xf1, 0x0b, 0x69, 0x00, 0x1a, 0x5b, 0x59, 0xcf, 0x10, 0x92, 0xad, 0x27, 0x4d, 0x50, 0x56, 0xc4, 0xe9, 0x5c, 0xcc, 0xcf, 0xbe, 0x3b, 0x53, 0x0d, 0xcb, 0x02, 0x7e, 0x57, 0xd6},
    {0xd6, 0x6f, 0x72, 0xf1, 0x0b, 0x69, 0x00, 0x1a, 0x5b, 0x59, 0xcf, 0x10, 0x92, 0xad, 0x27, 0x4d, 0x50, 0x56, 0xc4, 0xe9, 0x5c, 0xcc, 0xcf, 0xbe, 0x3b, 0x53, 0x0d, 0xcb, 0x02, 0x7e, 0x57, 0xd6},
    {0xd6, 0x6f, 0x72, 0xf1, 0x0b, 0x69, 0x00, 0x1a, 0x5b, 0x59, 0xcf, 0x10, 0x92, 0xad, 0x27, 0x4d, 0x50, 0x56, 0xc4, 0xe9, 0x5c, 0xcc, 0xcf, 0xbe, 0x3b, 0x53, 0x0d, 0xcb, 0x02, 0x7e, 0x57, 0xd6}
}; // 6 vectors, each of max length 32 bytes

// Expected results
bool result[] = { 0, 1, 0, 0, 0, 0 };
const int num_vectors = 6; // Number of test vectors

void printBufferHex(const byte input[], size_t inputLength)
{
  for (size_t i = 0; i < inputLength; i++) {
    Serial.print(input[i] >> 4, HEX);
    Serial.print(input[i] & 0x0f, HEX);
    Serial.print(",");
  }
  Serial.println();
}

void setup() {
  Serial.begin(9600);
  while (!Serial);

  if (!SE05X.begin()) {
    Serial.println("Failed to communicate with SE05X!");
    while (1);
  }

  Serial.println(currentTest);

  byte hash[HASH_LEN] = {0};
  size_t hashLen = HASH_LEN;
  byte emsa[N_LEN] = {0};
  size_t emsaLen = N_LEN;
  byte signature[N_LEN] = {0};
  size_t signatureLen = 0;

  const int KeyId = 9996;
  for(int i = 0; i < num_vectors; i++){

    SE05X.deleteBinaryObject(KeyId);
    SE05X.writeRSAKey(KeyId,
                      kSE05x_RSABitLength_2048,
                      NULL,
                      0,
                      NULL,
                      0,
                      NULL,
                      0,
                      NULL,
                      0,
                      NULL,
                      0,
                      &e[i][0],
                      E_LEN,
                      &d[i][0],
                      D_LEN,
                      n,
                      N_LEN,
                      kSE05x_RSAKeyFormat_RAW,
                      false,
                      kSE05x_KeyPart_Pair,
                      NULL);

    Serial.println("");
    Serial.print("Test ");
    Serial.println((i+1));

    // print the input
    Serial.print("Input is:                     ");
    printBufferHex(&msg[i][0], MSG_LEN);

    //calculate the input hash
    hashLen = HASH_LEN;
    SE05X.beginSHA256();
    SE05X.updateSHA256(&msg[i][0], MSG_LEN);
    SE05X.endSHA256(hash, &hashLen);

    Serial.print("Input SHA256 is:              ");
    printBufferHex(hash, hashLen);

    emsaLen = S_LEN;
    SE05X.emsa_pss_encode(hash, hashLen, emsa, &emsaLen, kSE05x_RSASignatureAlgo_SHA256_PKCS1_PSS, kSE05x_RSABitLength_2048, &saltVal[i][0], SALT_LEN);
    Serial.print("emsa is:                     ");
    printBufferHex(emsa, emsaLen);

    // calculate the signature
    signatureLen = 0;
    SE05X.SignRSA(KeyId, emsa, emsaLen, signature, sizeof(signature), &signatureLen);

    // print the signature
    Serial.print("Signature using KeyId ");
    Serial.print(KeyId);
    Serial.print(" is: ");
    printBufferHex(signature, signatureLen);
    Serial.println();
    
    // To make the signature verifcation + the signature comparison fail, uncomment the next line:
    //signature[0] = 0x00;
    if(signatureLen == S_LEN){
      if(memcmp(&s[i][0],signature,signatureLen) == 0){
        Serial.println("SE050 Generated Signature matches test vector");
      }else{
        Serial.println("SE050 Generated Signature does not match test vector");
        Serial.print("Signature from test vector: ");
        printBufferHex(&s[i][0], S_LEN);
      }
    }else{
      Serial.println("SE050 Generated Signature does not match test vector");
      Serial.print("Signature from test vector: ");
      printBufferHex(&s[i][0], S_LEN);
    }


    // To make the signature verifcation fail, uncomment the next line:
    //signature[0] = 0x00;

    // validate the signature
    if (SE05X.VerifyRSASSA_PSS(KeyId, hash, hashLen, &s[i][0], S_LEN)){
      Serial.println("test vector Verified");
      if(result[i]){
        Serial.println("---TEST PASSED---");
      }else{
        Serial.println("---TEST FAILED---");
      }
    }
    else
    {
      Serial.println("failed to verify test vector");
      if(!result[i]){
        Serial.println("---TEST PASSED---");
      }else{
        Serial.println("---TEST FAILED---");
      }
    }
  }

  SE05X.deleteBinaryObject(KeyId);
}


void loop() {

}
