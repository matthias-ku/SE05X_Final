#include <SE05X.h>

// CAVS 11.1
const char currentTest[] = "FIPS186-3 - SigVerPSS_186-3 RSASSA-PSS: Mod Size 1024 with SHA-224(Salt len: 20)";

#define SHA1_LENGTH                 20
#define SHA224_LENGTH               28
#define SHA256_LENGTH               32
#define SHA384_LENGTH               48
#define SHA512_LENGTH               64

#define E_LEN                       4
#define N_LEN                       128
#define D_LEN                       128

#define S_LEN                       N_LEN
#define MSG_LEN                     128
#define HASH_LEN                    SHA224_LENGTH
#define SALT_LEN                    20



// RSA Modulus (n)
const byte n[] = {0xf6, 0x50, 0xd9, 0xf3, 0x61, 0xcf, 0x9c, 0xf7, 0xc1, 0xe9, 0x9b, 0x02, 0x8f,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 0x6f, 0xa3}; // Length: 128 bytes

// Public Exponent (e)
const byte e[6][4] = {
    {0x00, 0x6a, 0x3d, 0xb1},
    {0x00, 0x6a, 0x3d, 0xb1},
    {0x00, 0x6a, 0x3d, 0xb1},
    {0x00, 0xe8, 0x87, 0xc5},
    {0x00, 0x6a, 0x3d, 0xb1},
    {0x00, 0x6a, 0x3d, 0xb1}
}; // 6 vectors, each of max length 4 bytes

// Private Exponent (d)
const byte d[6][128] = {
    {0x2d, 0x0b, 0xb5, 0xf6, 0x12, 0xb4, 0x35, 0xb0, 0xe6, 0xa5, 0x8d, 0xc0, 0x7d,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 0x47, 0xf1},
    {0x2d, 0x0b, 0xb5, 0xf6, 0x12, 0xb4, 0x35, 0xb0, 0xe6, 0xa5, 0x8d, 0xc0, 0x7d,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 0x47, 0xf1},
    {0x2d, 0x0b, 0xb5, 0xf6, 0x12, 0xb4, 0x35, 0xb0, 0xe6, 0xa5, 0x8d, 0xc0, 0x7d,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 0x47, 0xf1},
    {0x2d, 0x0b, 0xb5, 0xf6, 0x12, 0xb4, 0x35, 0xb0, 0xe6, 0xa5, 0x8d, 0xc0, 0x7d,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 0x47, 0xf1},
    {0x2d, 0x0b, 0xb5, 0xf6, 0x12, 0xb4, 0x35, 0xb0, 0xe6, 0xa5, 0x8d, 0xc0, 0x7d,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 0x47, 0xf1},
    {0x2d, 0x0b, 0xb5, 0xf6, 0x12, 0xb4, 0x35, 0xb0, 0xe6, 0xa5, 0x8d, 0xc0, 0x7d,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 0x47, 0xf1}
}; // 6 vectors, each of max length 128 bytes

// Messages (msg)
const byte msg[6][128] = {
    {0xf0, 0xb8, 0x3b, 0x8f, 0xac, 0xf6, 0x69, 0x8d, 0x56, 0x4b, 0xad, 0x33, 0x4f,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 0xe5, 0x99},
    {0xa4, 0xce, 0xb8, 0x1c, 0x34, 0x12, 0x37, 0xfa, 0xcd, 0xf5, 0xc8, 0xda, 0xb1,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 0x94, 0x30},
    {0xad, 0xa7, 0xd6, 0xe4, 0x17, 0xda, 0x2c, 0x55, 0xab, 0xa7, 0x68, 0xf6, 0x0d,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 0xe8, 0xf7},
    {0x68, 0xa5, 0x31, 0x31, 0xf6, 0x49, 0x9d, 0x29, 0x98, 0x01, 0xd8, 0x8d, 0x6d,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 0xeb, 0xa9},
    {0xc7, 0x28, 0x84, 0x69, 0x80, 0xd2, 0x46, 0x1d, 0xb2, 0x93, 0x43, 0xac, 0xba,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 0x09, 0x50},
    {0xb3, 0xe5, 0x12, 0xb4, 0xff, 0x75, 0x3f, 0xcf, 0x01, 0xb6, 0xe6, 0xd8, 0x30,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 0xdc, 0x15}
}; // 6 vectors, each of max length 128 bytes

// Signatures (s)
const byte s[6][128] = {
    {0x6b, 0x5a, 0x09, 0x4e, 0x74, 0xc5, 0xc3, 0x4c, 0xef, 0xfa, 0xa5, 0x1d, 0xbb,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 0xe4, 0x60},
    {0x1d, 0xb2, 0x47, 0xc2, 0x71, 0xa1, 0x1b, 0x2d, 0x41, 0x20, 0x5d, 0x1a, 0xba,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 0xa2, 0x86},
    {0x46, 0x8a, 0x0a, 0x4d, 0x98, 0x87, 0xdc, 0x8d, 0xe8, 0x66, 0x72, 0xbf, 0x58,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 0x89, 0xd4},
    {0x03, 0x99, 0x94, 0x76, 0x73, 0x09, 0x32, 0xd4, 0x6e, 0xaa, 0x52, 0x05, 0xf4,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 0xea, 0xfb},
    {0x46, 0xac, 0xca, 0x57, 0x82, 0xd2, 0x16, 0xe2, 0xf3, 0xd6, 0xf8, 0x74, 0xa3,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 0x2e, 0xfb},
    {0x54, 0x32, 0x92, 0x3b, 0x53, 0xdc, 0x8a, 0xd5, 0xdf, 0x6a, 0x5d, 0xb2, 0xb0,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 0x2e, 0xf6}
}; // 6 vectors, each of max length 128 bytes

// Salt Value (SaltVal)
uint8_t saltVal[6][20] = {
    {0x23, 0x93, 0x18, 0x3e, 0x18, 0x58, 0x1e, 0x69, 0x24, 0xcd, 0x38, 0xf2, 0x41, 0x92, 0xd1, 0xac, 0xc1, 0x45, 0x63, 0x3a},
    {0x23, 0x93, 0x18, 0x3e, 0x18, 0x58, 0x1e, 0x69, 0x24, 0xcd, 0x38, 0xf2, 0x41, 0x92, 0xd1, 0xac, 0xc1, 0x45, 0x63, 0x3a},
    {0x23, 0x93, 0x18, 0x3e, 0x18, 0x58, 0x1e, 0x69, 0x24, 0xcd, 0x38, 0xf2, 0x41, 0x92, 0xd1, 0xac, 0xc1, 0x45, 0x63, 0x3a},
    {0x23, 0x93, 0x18, 0x3e, 0x18, 0x58, 0x1e, 0x69, 0x24, 0xcd, 0x38, 0xf2, 0x41, 0x92, 0xd1, 0xac, 0xc1, 0x45, 0x63, 0x3a},
    {0x23, 0x93, 0x18, 0x3e, 0x18, 0x58, 0x1e, 0x69, 0x24, 0xcd, 0x38, 0xf2, 0x41, 0x92, 0xd1, 0xac, 0xc1, 0x45, 0x63, 0x3a},
    {0x23, 0x93, 0x18, 0x3e, 0x18, 0x58, 0x1e, 0x69, 0x24, 0xcd, 0x38, 0xf2, 0x41, 0x92, 0xd1, 0xac, 0xc1, 0x45, 0x63, 0x3a}
}; // 6 vectors, each of max length 20 bytes

// Expected results
bool result[] = { 0, 0, 0, 0, 1, 0 };

const int num_vectors = 6; // Number of test vectors

void printBufferHex(const byte input[], size_t inputLength)
{
  for (size_t i = 0; i < inputLength; i++) {
    Serial.print(input[i] >> 4, HEX);
    Serial.print(input[i] & 0x0f, HEX);
    Serial.print(",");
  }
  Serial.println();
}

void setup() {
  Serial.begin(9600);
  while (!Serial);

  if (!SE05X.begin()) {
    Serial.println("Failed to communicate with SE05X!");
    while (1);
  }

  Serial.println(currentTest);

  byte hash[HASH_LEN] = {0};
  size_t hashLen = HASH_LEN;
  byte emsa[N_LEN] = {0};
  size_t emsaLen = N_LEN;
  byte signature[N_LEN] = {0};
  size_t signatureLen = 0;

  const int KeyId = 9996;
  for(int i = 0; i < num_vectors; i++){

    SE05X.deleteBinaryObject(KeyId);
    SE05X.writeRSAKey(KeyId,
                      kSE05x_RSABitLength_1024,
                      NULL,
                      0,
                      NULL,
                      0,
                      NULL,
                      0,
                      NULL,
                      0,
                      NULL,
                      0,
                      &e[i][0],
                      E_LEN,
                      &d[i][0],
                      D_LEN,
                      n,
                      N_LEN,
                      kSE05x_RSAKeyFormat_RAW,
                      false,
                      kSE05x_KeyPart_Pair,
                      NULL);

    Serial.println("");
    Serial.print("Test ");
    Serial.println((i+1));

    // print the input
    Serial.print("Input is:                     ");
    printBufferHex(&msg[i][0], MSG_LEN);

    //calculate the input hash
    hashLen = HASH_LEN;
    SE05X.beginSHA224();
    SE05X.updateSHA224(&msg[i][0], MSG_LEN);
    SE05X.endSHA224(hash, &hashLen);

    Serial.print("Input SHA224 is:              ");
    printBufferHex(hash, hashLen);

    emsaLen = S_LEN;
    SE05X.emsa_pss_encode(hash, hashLen, emsa, &emsaLen, kSE05x_RSASignatureAlgo_SHA224_PKCS1_PSS, kSE05x_RSABitLength_1024, &saltVal[i][0], SALT_LEN);
    Serial.print("emsa is:                     ");
    printBufferHex(emsa, emsaLen);

    // calculate the signature
    signatureLen = 0;
    SE05X.SignRSA(KeyId, emsa, emsaLen, signature, sizeof(signature), &signatureLen);

    // print the signature
    Serial.print("Signature using KeyId ");
    Serial.print(KeyId);
    Serial.print(" is: ");
    printBufferHex(signature, signatureLen);
    Serial.println();
    
    // To make the signature verifcation + the signature comparison fail, uncomment the next line:
    //signature[0] = 0x00;
    if(signatureLen == S_LEN){
      if(memcmp(&s[i][0],signature,signatureLen) == 0){
        Serial.println("SE050 Generated Signature matches test vector");
      }else{
        Serial.println("SE050 Generated Signature does not match test vector");
        Serial.print("Signature from test vector: ");
        printBufferHex(&s[i][0], S_LEN);
      }
    }else{
      Serial.println("SE050 Generated Signature does not match test vector");
      Serial.print("Signature from test vector: ");
      printBufferHex(&s[i][0], S_LEN);
    }


    // To make the signature verifcation fail, uncomment the next line:
    //signature[0] = 0x00;

    // validate the signature
    if (SE05X.VerifyRSASSA_PSS(KeyId, hash, hashLen, &s[i][0], S_LEN)){
      Serial.println("test vector Verified");
      if(result[i]){
        Serial.println("---TEST PASSED---");
      }else{
        Serial.println("---TEST FAILED---");
      }
    }
    else
    {
      Serial.println("failed to verify test vector");
      if(!result[i]){
        Serial.println("---TEST PASSED---");
      }else{
        Serial.println("---TEST FAILED---");
      }
    }
  }

  SE05X.deleteBinaryObject(KeyId);
}


void loop() {

}