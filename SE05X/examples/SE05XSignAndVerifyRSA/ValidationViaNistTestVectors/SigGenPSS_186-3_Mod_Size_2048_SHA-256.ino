#include <SE05X.h>

// CAVS 11.4
const char currentTest[] = "FIPS186-3 - SigGenPSS_186-3 RSASSA-PSS: Mod Size 2048 with SHA-256(Salt len: 20)";
const byte n[] = {0xc5, 0x06, 0x2b, 0x58, 0xd8, 0x53, 0x9c, 0x76, 0x5e, 0x1e, 0x5d, 0xba, 0xf1,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 0x05, 0xef}; // Length: 256 bytes
const byte e[] = {0x00, 0x86, 0xc9, 0x4f}; // Length: 4 bytes
const byte d[] = {0x49, 0xe5, 0x78, 0x6b, 0xb4, 0xd3, 0x32, 0xf9, 0x45, 0x86, 0x32, 0x7b, 0xde,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 0x06, 0x9f}; // Length: 256 bytes
byte saltVal[] = {0xe1, 0x25, 0x6f, 0xc1, 0xee, 0xef, 0x81, 0x77, 0x3f, 0xdd, 0x54, 0x65, 0x7e, 0x40, 0x07, 0xfd, 0xe6, 0xbc, 0xb9, 0xb1}; // Length: 20 bytes

// Messages (msg)
const byte msg[10][128] = {
  {0xdf, 0xc2, 0x26, 0x04, 0xb9, 0x5d, 0x15, 0x32, 0x80, 0x59, 0x74, 0x5c, 0x6c,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 0xd4, 0x1f},
  {0xfd, 0x6a, 0x06, 0x3e, 0x61, 0xc2, 0xb3, 0x54, 0xfe, 0x8c, 0xb3, 0x7a, 0x5f,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 0xb0, 0xa5},
  {0x7e, 0x66, 0x90, 0x20, 0x3c, 0xb0, 0x68, 0xb8, 0x53, 0x0c, 0xb1, 0xff, 0x4e,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 0x70, 0xe5},
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  {0x33, 0xba, 0x93, 0x2a, 0xaf, 0x38, 0x84, 0x58, 0x63, 0x9f, 0x06, 0xeb, 0x9d,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 0xf8, 0xa0}
}; // 10 vectors, each of max length 128 bytes
#define MSG_LEN 128

// Signatures (s)
const byte s[10][256] = {
  {0x8b, 0x46, 0xf2, 0xc8, 0x89, 0xd8, 0x19, 0xf8, 0x60, 0xaf, 0x0a, 0x6c, 0x4c,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 0x2b, 0xcc},
  {0x49, 0x2b, 0x6f, 0x68, 0x84, 0xdf, 0x46, 0x1f, 0xe1, 0x05, 0x16, 0xb6, 0xb8,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 0x08, 0x33},
  {0x50, 0x9a, 0x01, 0xbb, 0x03, 0x60, 0xd1, 0x16, 0x0e, 0xd3, 0xff, 0x33, 0x43,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 0x01, 0xf1},
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  {0x28, 0x91, 0xcb, 0xe2, 0x3c, 0xcf, 0x10, 0xc3, 0x96, 0xef, 0x76, 0xa5, 0x84,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 0x80, 0x38}
}; // 10 vectors, each of max length 256 bytes
#define S_LEN 256

void printBufferHex(const byte input[], size_t inputLength)
{
  for (size_t i = 0; i < inputLength; i++) {
    Serial.print(input[i] >> 4, HEX);
    Serial.print(input[i] & 0x0f, HEX);
    Serial.print(",");
  }
  Serial.println();
}

void setup() {
  Serial.begin(9600);
  while (!Serial);

  if (!SE05X.begin()) {
    Serial.println("Failed to communicate with SE05X!");
    while (1);
  }

  Serial.println(currentTest);
  const int KeyId = 9996;
  
  SE05X.deleteBinaryObject(KeyId);
  SE05X.writeRSAKey(KeyId,
                    kSE05x_RSABitLength_2048,
                    NULL,
                    0,
                    NULL,
                    0,
                    NULL,
                    0,
                    NULL,
                    0,
                    NULL,
                    0,
                    e,
                    sizeof(e),
                    d,
                    sizeof(d),
                    n,
                    sizeof(n),
                    kSE05x_RSAKeyFormat_RAW,
                    false,
                    kSE05x_KeyPart_Pair,
                    NULL);

  byte sha256[64] = {0};
  byte emsa[256] = {0};
  size_t sha256Len = 64;
  size_t emsaLen = 256;
  byte signature[256] = {0};
  size_t signatureLen = 0;

  for(int i = 0; i < 10; i++){
    Serial.println("");
    Serial.print("Test ");
    Serial.println((i+1));

    // print the input
    Serial.print("Input is:                     ");
    printBufferHex(&msg[i][0], MSG_LEN);

    //calculate the input SHA256
    sha256Len = 64;
    SE05X.beginSHA256();
    SE05X.updateSHA256(&msg[i][0], MSG_LEN);
    SE05X.endSHA256(sha256, &sha256Len);

    Serial.print("Input SHA256 is:              ");
    printBufferHex(sha256, sha256Len);

    emsaLen = 256;
    SE05X.emsa_pss_encode(sha256, sha256Len, emsa, &emsaLen, kSE05x_RSASignatureAlgo_SHA256_PKCS1_PSS, kSE05x_RSABitLength_2048,saltVal,sizeof(saltVal));
    Serial.print("emsa is:                     ");
    printBufferHex(emsa, emsaLen);

    // calculate the signature
    signatureLen = 0;
    SE05X.SignRSA(KeyId, emsa, emsaLen, signature, sizeof(signature), &signatureLen);

    // print the signature
    Serial.print("Signature using KeyId ");
    Serial.print(KeyId);
    Serial.print(" is: ");
    printBufferHex(signature, signatureLen);
    Serial.println();
    
    // To make the signature verifcation + the signature comparison fail, uncomment the next line:
    //signature[0] = 0x00;
    if(signatureLen == S_LEN){
      if(memcmp(&s[i][0],signature,signatureLen) == 0){
        Serial.println("Generated Signature matches test vector - passed");
      }else{
        Serial.println("Generated Signature does not match test vector - failed");
      }
    }else{
      Serial.println("Generated Signature does not match test vector - failed");
    }


    // To make the signature verifcation fail, uncomment the next line:
    //signature[0] = 0x00;

    // validate the signature
    if (SE05X.VerifyRSASSA_PSS(KeyId, sha256, sha256Len, signature, signatureLen)){
      Serial.println("Verified signature successfully :D");
    }
    else
    {
      Serial.println("oh no! failed to verify signature :(");
    }
  }

  SE05X.deleteBinaryObject(KeyId);
}


void loop() {

}
