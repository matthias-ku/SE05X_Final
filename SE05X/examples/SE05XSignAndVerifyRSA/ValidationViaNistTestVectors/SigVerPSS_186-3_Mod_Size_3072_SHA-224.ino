#include <SE05X.h>

// CAVS 11.1
const char currentTest[] = "FIPS186-3 - SigVerPSS_186-3 RSASSA-PSS: Mod Size 3072 with SHA-224(Salt len: 0)";

#define SHA1_LENGTH                 20
#define SHA224_LENGTH               28
#define SHA256_LENGTH               32
#define SHA384_LENGTH               48
#define SHA512_LENGTH               64

#define E_LEN                       4
#define N_LEN                       384
#define D_LEN                       384

#define S_LEN                       N_LEN
#define MSG_LEN                     128
#define HASH_LEN                    SHA224_LENGTH
#define SALT_LEN                    0 //Empty salt

// RSA Modulus (n)
const byte n[] = {0x98, 0x81, 0xb3, 0xfb, 0x6c, 0x99, 0xa1, 0x15, 0xda, 0x60, 0xad, 0xe6, 0xd1,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 0xa0, 0x03}; // Length: 384 bytes

// Public Exponent (e)
const byte e[6][4] = {
    {0x00, 0x16, 0xb2, 0x65},
    {0x00, 0xa4, 0xbd, 0x05},
    {0x00, 0x16, 0xb2, 0x65},
    {0x00, 0x16, 0xb2, 0x65},
    {0x00, 0x16, 0xb2, 0x65},
    {0x00, 0x16, 0xb2, 0x65}
}; // 6 vectors, each of max length 4 bytes

// Private Exponent (d)
const byte d[6][384] = {
    {0x04, 0xb1, 0x4b, 0xa5, 0x08, 0x02, 0xdf, 0x9f, 0x7c, 0xf0, 0x6c, 0x29, 0x98,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 0x54, 0x25},
    {0x04, 0xb1, 0x4b, 0xa5, 0x08, 0x02, 0xdf, 0x9f, 0x7c, 0xf0, 0x6c, 0x29, 0x98,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 0x54, 0x25},
    {0x04, 0xb1, 0x4b, 0xa5, 0x08, 0x02, 0xdf, 0x9f, 0x7c, 0xf0, 0x6c, 0x29, 0x98,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 0x54, 0x25},
    {0x04, 0xb1, 0x4b, 0xa5, 0x08, 0x02, 0xdf, 0x9f, 0x7c, 0xf0, 0x6c, 0x29, 0x98,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 0x54, 0x25},
    {0x04, 0xb1, 0x4b, 0xa5, 0x08, 0x02, 0xdf, 0x9f, 0x7c, 0xf0, 0x6c, 0x29, 0x98,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 0x54, 0x25},
    {0x04, 0xb1, 0x4b, 0xa5, 0x08, 0x02, 0xdf, 0x9f, 0x7c, 0xf0, 0x6c, 0x29, 0x98,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 0x54, 0x25}
}; // 6 vectors, each of max length 384 bytes

// Messages (msg)
const byte msg[6][128] = {
    {0xc9, 0x44, 0x73, 0xf3, 0x7b, 0x3e, 0x8f, 0xbb, 0x10, 0xfb, 0x2c, 0xb1, 0x05,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 0x22, 0x74},
    {0xbd, 0x14, 0x49, 0xb4, 0x45, 0x48, 0x88, 0x9e, 0xcd, 0x19, 0x1d, 0x0a, 0x43,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 0x3f, 0x30},
    {0x10, 0x57, 0x41, 0x33, 0x7c, 0xb1, 0x92, 0x62, 0xc7, 0x8a, 0x1b, 0xcb, 0xc0,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 0x36, 0xeb},
    {0x6a, 0xc3, 0x1a, 0xcf, 0xb4, 0x6b, 0xc4, 0x2f, 0xbd, 0x13, 0xc3, 0x8f, 0xc2,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 0xda, 0x4d},
    {0x68, 0xb5, 0x9f, 0x9d, 0xe0, 0x14, 0x6f, 0xa3, 0xa9, 0x64, 0xbf, 0x39, 0x9c,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 0x48, 0x8a},
    {0x97, 0x9e, 0x87, 0xfd, 0x76, 0x2d, 0x8f, 0x04, 0x45, 0x53, 0xa5, 0x6d, 0x47,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 0xf1, 0x81}
}; // 6 vectors, each of max length 128 bytes

// Signatures (s)
const byte s[6][384] = {
    {0x7b, 0x2b, 0xa5, 0xd8, 0x47, 0xb8, 0x71, 0x18, 0xe2, 0xc0, 0x9a, 0xd0, 0x23,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 0x25, 0x76},
    {0x22, 0xc2, 0xfb, 0x87, 0x42, 0xe3, 0x25, 0xe8, 0xe5, 0x9f, 0x44, 0x9a, 0xd6,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 0xbb, 0xc2},
    {0x96, 0xed, 0x14, 0x22, 0xc5, 0xac, 0xf2, 0x19, 0x98, 0x99, 0x3a, 0x4d, 0x30,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 0x7e, 0x59},
    {0x12, 0x2c, 0xad, 0xf5, 0x1e, 0x1f, 0x09, 0x84, 0x90, 0x7c, 0x38, 0x20, 0x90,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 0xb1, 0x3f},
    {0x0f, 0x49, 0x85, 0x11, 0x33, 0xf7, 0x26, 0x70, 0xc3, 0xaa, 0xc8, 0x57, 0xde,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 0xec, 0xdd},
    {0x5a, 0x48, 0xfe, 0x3d, 0xbc, 0xfd, 0xf6, 0xb9, 0x95, 0xf8, 0x49, 0xd7, 0x75,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 0x1c, 0xc0}
}; // 6 vectors, each of max length 384 bytes

// Salt Value (SaltVal)
uint8_t saltVal[6][1] = {
    {0x00},
    {0x00},
    {0x00},
    {0x00},
    {0x00},
    {0x00}
}; // 6 vectors, each of max length 1 bytes

// Expected results
bool result[] = { 0, 0, 0, 0, 1, 0 };
const int num_vectors = 6; // Number of test vectors

void printBufferHex(const byte input[], size_t inputLength)
{
  for (size_t i = 0; i < inputLength; i++) {
    Serial.print(input[i] >> 4, HEX);
    Serial.print(input[i] & 0x0f, HEX);
    Serial.print(",");
  }
  Serial.println();
}

void setup() {
  Serial.begin(9600);
  while (!Serial);

  if (!SE05X.begin()) {
    Serial.println("Failed to communicate with SE05X!");
    while (1);
  }

  Serial.println(currentTest);

  byte hash[HASH_LEN] = {0};
  size_t hashLen = HASH_LEN;
  byte emsa[N_LEN] = {0};
  size_t emsaLen = N_LEN;
  byte signature[N_LEN] = {0};
  size_t signatureLen = 0;

  const int KeyId = 9996;
  for(int i = 0; i < num_vectors; i++){

    SE05X.deleteBinaryObject(KeyId);
    SE05X.writeRSAKey(KeyId,
                      kSE05x_RSABitLength_3072,
                      NULL,
                      0,
                      NULL,
                      0,
                      NULL,
                      0,
                      NULL,
                      0,
                      NULL,
                      0,
                      &e[i][0],
                      E_LEN,
                      &d[i][0],
                      D_LEN,
                      n,
                      N_LEN,
                      kSE05x_RSAKeyFormat_RAW,
                      false,
                      kSE05x_KeyPart_Pair,
                      NULL);

    Serial.println("");
    Serial.print("Test ");
    Serial.println((i+1));

    // print the input
    Serial.print("Input is:                     ");
    printBufferHex(&msg[i][0], MSG_LEN);

    //calculate the input hash
    hashLen = HASH_LEN;
    SE05X.beginSHA224();
    SE05X.updateSHA224(&msg[i][0], MSG_LEN);
    SE05X.endSHA224(hash, &hashLen);

    Serial.print("Input SHA224 is:              ");
    printBufferHex(hash, hashLen);

    emsaLen = S_LEN;
    if(SALT_LEN == 0 && saltVal[i][0] == 0){
      SE05X.emsa_pss_encode(hash, hashLen, emsa, &emsaLen, kSE05x_RSASignatureAlgo_SHA224_PKCS1_PSS, kSE05x_RSABitLength_3072, NULL, SALT_LEN);
    }else{
      SE05X.emsa_pss_encode(hash, hashLen, emsa, &emsaLen, kSE05x_RSASignatureAlgo_SHA224_PKCS1_PSS, kSE05x_RSABitLength_3072, &saltVal[i][0], SALT_LEN);
    }
    Serial.print("emsa is:                     ");
    printBufferHex(emsa, emsaLen);

    // calculate the signature
    signatureLen = 0;
    SE05X.SignRSA(KeyId, emsa, emsaLen, signature, sizeof(signature), &signatureLen);

    // print the signature
    Serial.print("Signature using KeyId ");
    Serial.print(KeyId);
    Serial.print(" is: ");
    printBufferHex(signature, signatureLen);
    Serial.println();
    
    // To make the signature verifcation + the signature comparison fail, uncomment the next line:
    //signature[0] = 0x00;
    if(signatureLen == S_LEN){
      if(memcmp(&s[i][0],signature,signatureLen) == 0){
        Serial.println("SE050 Generated Signature matches test vector");
      }else{
        Serial.println("SE050 Generated Signature does not match test vector");
        Serial.print("Signature from test vector: ");
        printBufferHex(&s[i][0], S_LEN);
      }
    }else{
      Serial.println("SE050 Generated Signature does not match test vector");
      Serial.print("Signature from test vector: ");
      printBufferHex(&s[i][0], S_LEN);
    }


    // To make the signature verifcation fail, uncomment the next line:
    //signature[0] = 0x00;

    // validate the signature
    if (SE05X.VerifyRSASSA_PSS(KeyId, hash, hashLen, &s[i][0], S_LEN)){
      Serial.println("test vector Verified");
      if(result[i]){
        Serial.println("---TEST PASSED---");
      }else{
        Serial.println("---TEST FAILED---");
      }
    }
    else
    {
      Serial.println("failed to verify test vector");
      if(!result[i]){
        Serial.println("---TEST PASSED---");
      }else{
        Serial.println("---TEST FAILED---");
      }
    }
  }

  SE05X.deleteBinaryObject(KeyId);
}


void loop() {

}
