#include <SE05X.h>

// CAVS 11.4
const char currentTest[] = "FIPS186-2 - SigGen PKCS#1 RSASSA-PSS: Mod Size 2048 with SHA-1 SHA-224 SHA-256 SHA-384 SHA-512";

#define SHA1_LENGTH                 20
#define SHA224_LENGTH               28
#define SHA256_LENGTH               32
#define SHA384_LENGTH               48
#define SHA512_LENGTH               64

#define E_LEN                       4
#define N_LEN                       256
#define D_LEN                       256

#define S_LEN                       N_LEN
#define MSG_LEN                     128
#define SALT_LEN                    20

// Hashing algorithm (sha_alg)
SE05x_RSASignatureAlgo_t sha_alg[] = {kSE05x_RSASignatureAlgo_SHA1_PKCS1_PSS, kSE05x_RSASignatureAlgo_SHA1_PKCS1_PSS, kSE05x_RSASignatureAlgo_SHA1_PKCS1_PSS, kSE05x_RSASignatureAlgo_SHA1_PKCS1_PSS, kSE05x_RSASignatureAlgo_SHA1_PKCS1_PSS, kSE05x_RSASignatureAlgo_SHA1_PKCS1_PSS, kSE05x_RSASignatureAlgo_SHA1_PKCS1_PSS, kSE05x_RSASignatureAlgo_SHA1_PKCS1_PSS, kSE05x_RSASignatureAlgo_SHA1_PKCS1_PSS, kSE05x_RSASignatureAlgo_SHA1_PKCS1_PSS,
     kSE05x_RSASignatureAlgo_SHA224_PKCS1_PSS, kSE05x_RSASignatureAlgo_SHA224_PKCS1_PSS, kSE05x_RSASignatureAlgo_SHA224_PKCS1_PSS, kSE05x_RSASignatureAlgo_SHA224_PKCS1_PSS, kSE05x_RSASignatureAlgo_SHA224_PKCS1_PSS, kSE05x_RSASignatureAlgo_SHA224_PKCS1_PSS, kSE05x_RSASignatureAlgo_SHA224_PKCS1_PSS, kSE05x_RSASignatureAlgo_SHA224_PKCS1_PSS, kSE05x_RSASignatureAlgo_SHA224_PKCS1_PSS, kSE05x_RSASignatureAlgo_SHA224_PKCS1_PSS, 
     kSE05x_RSASignatureAlgo_SHA256_PKCS1_PSS, kSE05x_RSASignatureAlgo_SHA256_PKCS1_PSS, kSE05x_RSASignatureAlgo_SHA256_PKCS1_PSS, kSE05x_RSASignatureAlgo_SHA256_PKCS1_PSS, kSE05x_RSASignatureAlgo_SHA256_PKCS1_PSS, kSE05x_RSASignatureAlgo_SHA256_PKCS1_PSS, kSE05x_RSASignatureAlgo_SHA256_PKCS1_PSS, kSE05x_RSASignatureAlgo_SHA256_PKCS1_PSS, kSE05x_RSASignatureAlgo_SHA256_PKCS1_PSS, kSE05x_RSASignatureAlgo_SHA256_PKCS1_PSS, 
     kSE05x_RSASignatureAlgo_SHA384_PKCS1_PSS, kSE05x_RSASignatureAlgo_SHA384_PKCS1_PSS, kSE05x_RSASignatureAlgo_SHA384_PKCS1_PSS, kSE05x_RSASignatureAlgo_SHA384_PKCS1_PSS, kSE05x_RSASignatureAlgo_SHA384_PKCS1_PSS, kSE05x_RSASignatureAlgo_SHA384_PKCS1_PSS, kSE05x_RSASignatureAlgo_SHA384_PKCS1_PSS, kSE05x_RSASignatureAlgo_SHA384_PKCS1_PSS, kSE05x_RSASignatureAlgo_SHA384_PKCS1_PSS, kSE05x_RSASignatureAlgo_SHA384_PKCS1_PSS, 
     kSE05x_RSASignatureAlgo_SHA512_PKCS1_PSS, kSE05x_RSASignatureAlgo_SHA512_PKCS1_PSS, kSE05x_RSASignatureAlgo_SHA512_PKCS1_PSS, kSE05x_RSASignatureAlgo_SHA512_PKCS1_PSS, kSE05x_RSASignatureAlgo_SHA512_PKCS1_PSS, kSE05x_RSASignatureAlgo_SHA512_PKCS1_PSS, kSE05x_RSASignatureAlgo_SHA512_PKCS1_PSS, kSE05x_RSASignatureAlgo_SHA512_PKCS1_PSS, kSE05x_RSASignatureAlgo_SHA512_PKCS1_PSS, kSE05x_RSASignatureAlgo_SHA512_PKCS1_PSS};
// Length: 50 values

// RSA Modulus (n)
const byte n[256] = {0xd9, 0x5b, 0x71, 0xc9, 0xdf, 0xee, 0x45, 0x3b, 0xa1, 0xb1, 0xa7, 0xde, 0x2c,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 0x37, 0xa9}; // 1 vectors, each of max length 256 bytes

// Public Exponent (e)
const byte e[4] = {0x00, 0x01, 0x00, 0x01}; // 1 vectors, each of max length 4 bytes

// Private Exponent (d)
const byte d[256] = {0x2f, 0x21, 0xb0, 0x1b, 0xe9, 0x4d, 0xde, 0x7f, 0x5e, 0xc1, 0x8a, 0x38, 0x17,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 0x9e, 0xfd}; // 1 vectors, each of max length 256 bytes

// Messages (msg)
const byte msg[50][128] = {
    {0xfc, 0x6a, 0x11, 0xf9, 0x97, 0xf1, 0xb3, 0xa8, 0x0e, 0x41, 0xe7, 0xe5, 0x09,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 0x7a, 0x72},
    {0xd3, 0xb2, 0xe3, 0x51, 0xb2, 0x81, 0x70, 0xfd, 0xf4, 0x28, 0x71, 0x59, 0x0d,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 0xbe, 0x61},
    {0x5a, 0xa5, 0x10, 0xd8, 0x94, 0x96, 0x98, 0x6d, 0x91, 0xac, 0x79, 0xa6, 0x91,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 0xfe, 0x8f},
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    {0x6c, 0x6a, 0x3e, 0x8c, 0xb1, 0xc7, 0xe9, 0x85, 0x15, 0xe8, 0xd9, 0xfe, 0x14,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 0x8b, 0xc8}
}; // 50 vectors, each of max length 128 bytes

// Signatures (s)
const byte s[50][256] = {
    {0x2c, 0x05, 0x0a, 0x7c, 0xb3, 0x8e, 0xd1, 0x22, 0x59, 0x2a, 0x8f, 0x5c, 0x9c,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 0x89, 0xab},
    {0x1a, 0x7a, 0x00, 0x5e, 0x75, 0x67, 0x13, 0x2e, 0x9b, 0xbd, 0xbf, 0x09, 0x5d,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 0xbd, 0x64},
    {0x56, 0x95, 0xa9, 0x11, 0xed, 0x82, 0x74, 0xc0, 0x61, 0x84, 0xf4, 0x66, 0x6a,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 0xd5, 0x43},
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    {0xca, 0x83, 0x4e, 0xd7, 0x58, 0xd9, 0x83, 0x50, 0x51, 0x08, 0x41, 0x65, 0x51,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 0x35, 0x82}
}; // 50 vectors, each of max length 256 bytes

// Salt Value (SaltVal)
uint8_t saltVal[50][20] = {
    {0x6f, 0x28, 0x41, 0x16, 0x6a, 0x64, 0x47, 0x1d, 0x4f, 0x0b, 0x8e, 0xd0, 0xdb, 0xb7, 0xdb, 0x32, 0x16, 0x1d, 0xa1, 0x3b},
    {0x6f, 0x28, 0x41, 0x16, 0x6a, 0x64, 0x47, 0x1d, 0x4f, 0x0b, 0x8e, 0xd0, 0xdb, 0xb7, 0xdb, 0x32, 0x16, 0x1d, 0xa1, 0x3b},
    {0x6f, 0x28, 0x41, 0x16, 0x6a, 0x64, 0x47, 0x1d, 0x4f, 0x0b, 0x8e, 0xd0, 0xdb, 0xb7, 0xdb, 0x32, 0x16, 0x1d, 0xa1, 0x3b},
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    {0x6f, 0x28, 0x41, 0x16, 0x6a, 0x64, 0x47, 0x1d, 0x4f, 0x0b, 0x8e, 0xd0, 0xdb, 0xb7, 0xdb, 0x32, 0x16, 0x1d, 0xa1, 0x3b}
}; // 50 vectors, each of max length 20 bytes

const int num_vectors = 50; // Number of test vectors

void printBufferHex(const byte input[], size_t inputLength)
{
  for (size_t i = 0; i < inputLength; i++) {
    Serial.print(input[i] >> 4, HEX);
    Serial.print(input[i] & 0x0f, HEX);
    Serial.print(",");
  }
  Serial.println();
}

void setup() {
  Serial.begin(9600);
  while (!Serial);

  if (!SE05X.begin()) {
    Serial.println("Failed to communicate with SE05X!");
    while (1);
  }

  Serial.println(currentTest);

  byte hash[SHA512_LENGTH] = {0};
  size_t hashLen = SHA512_LENGTH;
  byte emsa[N_LEN] = {0};
  size_t emsaLen = N_LEN;
  byte passedTests = 0;
  byte verifiedSignatures = 0;
  byte signature[S_LEN] = {0};
  size_t signatureLen = 0;

  const int KeyId = 9996;

  SE05X.deleteBinaryObject(KeyId);
  SE05X.writeRSAKey(KeyId,
                    kSE05x_RSABitLength_2048,
                    NULL,
                    0,
                    NULL,
                    0,
                    NULL,
                    0,
                    NULL,
                    0,
                    NULL,
                    0,
                    e,
                    E_LEN,
                    d,
                    D_LEN,
                    n,
                    N_LEN,
                    kSE05x_RSAKeyFormat_RAW,
                    false,
                    kSE05x_KeyPart_Pair,
                    NULL);
  
  for(int i = 0; i < num_vectors; i++){

    Serial.println("");
    Serial.print("Test ");
    Serial.println((i+1));
    

    // print the input
    Serial.print("Input is:                     ");
    printBufferHex(&msg[i][0], MSG_LEN);

    //calculate the input hash
    switch (sha_alg[i])
    {
    case kSE05x_RSASignatureAlgo_SHA1_PKCS1_PSS:
      hashLen = SHA1_LENGTH;
      SE05X.beginSHA1();
      SE05X.updateSHA1(&msg[i][0], MSG_LEN);
      SE05X.endSHA1(hash, &hashLen);
      Serial.print("Input SHA1 is:              ");
      printBufferHex(hash, hashLen);
      break;
    case kSE05x_RSASignatureAlgo_SHA224_PKCS1_PSS:
      hashLen = SHA224_LENGTH;
      SE05X.beginSHA224();
      SE05X.updateSHA224(&msg[i][0], MSG_LEN);
      SE05X.endSHA224(hash, &hashLen);
      Serial.print("Input SHA224 is:              ");
      printBufferHex(hash, hashLen);
      break;
    case kSE05x_RSASignatureAlgo_SHA256_PKCS1_PSS:
      hashLen = SHA256_LENGTH;
      SE05X.beginSHA256();
      SE05X.updateSHA256(&msg[i][0], MSG_LEN);
      SE05X.endSHA256(hash, &hashLen);
      Serial.print("Input SHA256 is:              ");
      printBufferHex(hash, hashLen);
      break;
    case kSE05x_RSASignatureAlgo_SHA384_PKCS1_PSS:
      hashLen = SHA384_LENGTH;
      SE05X.beginSHA384();
      SE05X.updateSHA384(&msg[i][0], MSG_LEN);
      SE05X.endSHA384(hash, &hashLen);
      Serial.print("Input SHA384 is:              ");
      printBufferHex(hash, hashLen);
      break;
    case kSE05x_RSASignatureAlgo_SHA512_PKCS1_PSS:
      hashLen = SHA512_LENGTH;
      SE05X.beginSHA512();
      SE05X.updateSHA512(&msg[i][0], MSG_LEN);
      SE05X.endSHA512(hash, &hashLen);
      Serial.print("Input SHA512 is:              ");
      printBufferHex(hash, hashLen);
      break;
    default:
      break;
    }
    
    emsaLen = S_LEN;
    SE05X.emsa_pss_encode(hash, hashLen, emsa, &emsaLen, sha_alg[i], kSE05x_RSABitLength_2048, &saltVal[i][0], SALT_LEN);

    Serial.print("emsa is:                     ");
    printBufferHex(emsa, emsaLen);

    // calculate the signature
    signatureLen = 0;
    SE05X.SignRSA(KeyId, emsa, emsaLen, signature, sizeof(signature), &signatureLen);

    // print the signature
    Serial.print("Signature using KeyId ");
    Serial.print(KeyId);
    Serial.print(" is: ");
    printBufferHex(signature, signatureLen);
    Serial.println();
    
    // To make the signature verifcation + the signature comparison fail, uncomment the next line:
    //signature[0] = 0x00;
    if(signatureLen == S_LEN){
      if(memcmp(&s[i][0],signature,signatureLen) == 0){
        Serial.println("Generated Signature matches test vector - passed");
        passedTests++;
      }else{
        Serial.println("Generated Signature does not match test vector - failed");
        Serial.print("Signature from test vector: ");
      printBufferHex(&s[i][0], S_LEN);
      }
    }else{
      Serial.println("Generated Signature does not match test vector - failed");
      Serial.print("Signature from test vector: ");
      printBufferHex(&s[i][0], S_LEN);
    }
    
    // To make the signature verifcation fail, uncomment the next line:
    //&s[i][0] = 0x00;

    // validate the signature
    if (SE05X.VerifyRSASSA_PSS(KeyId, hash, hashLen, &s[i][0], S_LEN)){
      Serial.println("test vector Verified");
      verifiedSignatures++;
    }
    else
    {
      Serial.println("failed to verify test vector");
    }
  }
  
  Serial.print("Tests Passed:");
  Serial.println(passedTests);
  Serial.print("Verifed Signatures:");
  Serial.println(verifiedSignatures);
  SE05X.deleteBinaryObject(KeyId);
}


void loop() {

}
