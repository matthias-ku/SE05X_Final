#include <SE05X.h>

// CAVS 11.1
const char currentTest[] = "FIPS186-3 - SigVerPSS_186-3 RSASSA-PSS: Mod Size 3072 with SHA-512(Salt len: 0)";

#define SHA1_LENGTH                 20
#define SHA224_LENGTH               28
#define SHA256_LENGTH               32
#define SHA384_LENGTH               48
#define SHA512_LENGTH               64

#define E_LEN                       4
#define N_LEN                       384
#define D_LEN                       384

#define S_LEN                       N_LEN
#define MSG_LEN                     128
#define HASH_LEN                    SHA512_LENGTH
#define SALT_LEN                    0

// RSA Modulus (n)
const byte n[] = {0x99, 0xa5, 0xc8, 0xd0, 0x94, 0xa5, 0xf9, 0x17, 0x03, 0x46, 0x67, 0xa0, 0x40,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 0x02, 0x85}; // Length: 384 bytes

// Public Exponent (e)
const byte e[6][4] = {
    {0x00, 0x08, 0xa6, 0x49},
    {0x00, 0x08, 0xa6, 0x49},
    {0x00, 0x08, 0xa6, 0x49},
    {0x00, 0x08, 0xa6, 0x49},
    {0x00, 0xa4, 0x5b, 0x6b},
    {0x00, 0x08, 0xa6, 0x49}
}; // 6 vectors, each of max length 4 bytes

// Private Exponent (d)
const byte d[6][384] = {
    {0x03, 0xb1, 0x90, 0x5b, 0x88, 0x3e, 0xa9, 0xd3, 0x2a, 0x37, 0x96, 0x4c, 0xf2,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 0x8a, 0xe9},
    {0x03, 0xb1, 0x90, 0x5b, 0x88, 0x3e, 0xa9, 0xd3, 0x2a, 0x37, 0x96, 0x4c, 0xf2,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 0x8a, 0xe9},
    {0x03, 0xb1, 0x90, 0x5b, 0x88, 0x3e, 0xa9, 0xd3, 0x2a, 0x37, 0x96, 0x4c, 0xf2,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 0x8a, 0xe9},
    {0x03, 0xb1, 0x90, 0x5b, 0x88, 0x3e, 0xa9, 0xd3, 0x2a, 0x37, 0x96, 0x4c, 0xf2,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 0x8a, 0xe9},
    {0x03, 0xb1, 0x90, 0x5b, 0x88, 0x3e, 0xa9, 0xd3, 0x2a, 0x37, 0x96, 0x4c, 0xf2,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 0x8a, 0xe9},
    {0x03, 0xb1, 0x90, 0x5b, 0x88, 0x3e, 0xa9, 0xd3, 0x2a, 0x37, 0x96, 0x4c, 0xf2,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 0x8a, 0xe9}
}; // 6 vectors, each of max length 384 bytes

// Messages (msg)
const byte msg[6][128] = {
    {0x4d, 0x44, 0x66, 0x5e, 0x0e, 0x29, 0x87, 0xcf, 0x7d, 0xd1, 0xe9, 0xd6, 0x20,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 0x8e, 0x75},
    {0x1a, 0xbc, 0xa8, 0xd8, 0x1c, 0xc9, 0x8a, 0x5d, 0x50, 0x20, 0xe9, 0x50, 0x80,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 0x26, 0xca},
    {0x20, 0x85, 0xe8, 0xb9, 0x46, 0xd2, 0x05, 0x97, 0x52, 0xf8, 0xf0, 0xfe, 0xe5,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 0x90, 0x65},
    {0xcc, 0x21, 0x59, 0x3a, 0x6a, 0x0f, 0x73, 0x7e, 0x29, 0x70, 0xb7, 0xc0, 0x79,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 0x6f, 0x96},
    {0xa5, 0x89, 0xc8, 0x78, 0x8c, 0x95, 0x99, 0x61, 0xfe, 0xf9, 0x86, 0x94, 0xbb,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 0x52, 0x0f},
    {0x70, 0xa4, 0xa8, 0x98, 0x02, 0x85, 0x68, 0x69, 0x9c, 0xcd, 0x8a, 0x53, 0x28,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 0xa2, 0x73}
}; // 6 vectors, each of max length 128 bytes

// Signatures (s)
const byte s[6][384] = {
    {0x4f, 0x48, 0xe5, 0x1a, 0x04, 0x1e, 0x40, 0xa0, 0x29, 0xd5, 0x86, 0xcb, 0x7a,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 0x8f, 0x92},
    {0x85, 0xe1, 0x57, 0x65, 0xa4, 0x01, 0xc1, 0x0d, 0x86, 0xac, 0xf3, 0xa0, 0x5f,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 0x55, 0xa2},
    {0x65, 0xbd, 0x57, 0xd4, 0xa3, 0x74, 0x95, 0xd5, 0x4e, 0xec, 0x7f, 0x63, 0x21,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 0x90, 0x9e},
    {0x0a, 0xa5, 0x72, 0xa6, 0x84, 0x5b, 0x87, 0x0b, 0x89, 0x09, 0xa6, 0x83, 0xbb,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 0x6e, 0x94},
    {0x06, 0x24, 0x18, 0x75, 0x08, 0x45, 0xd3, 0x29, 0x1e, 0x63, 0x3e, 0x47, 0x40,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 0x2e, 0x26},
    {0x07, 0x88, 0x43, 0xb0, 0x4c, 0x98, 0x55, 0xe6, 0x0b, 0x09, 0x65, 0x97, 0x0e,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 0x38, 0xf0}
}; // 6 vectors, each of max length 384 bytes

// Salt Value (SaltVal)
uint8_t saltVal[6][1] = {
    {0x00},
    {0x00},
    {0x00},
    {0x00},
    {0x00},
    {0x00}
}; // 6 vectors, each of max length 1 bytes

// Expected results
bool result[] = { 0, 0, 0, 1, 0, 0 };
const int num_vectors = 6; // Number of test vectors

void printBufferHex(const byte input[], size_t inputLength)
{
  for (size_t i = 0; i < inputLength; i++) {
    Serial.print(input[i] >> 4, HEX);
    Serial.print(input[i] & 0x0f, HEX);
    Serial.print(",");
  }
  Serial.println();
}

void setup() {
  Serial.begin(9600);
  while (!Serial);

  if (!SE05X.begin()) {
    Serial.println("Failed to communicate with SE05X!");
    while (1);
  }

  Serial.println(currentTest);

  byte hash[HASH_LEN] = {0};
  size_t hashLen = HASH_LEN;
  byte emsa[N_LEN] = {0};
  size_t emsaLen = N_LEN;
  byte signature[N_LEN] = {0};
  size_t signatureLen = 0;

  const int KeyId = 9996;
  for(int i = 0; i < num_vectors; i++){

    SE05X.deleteBinaryObject(KeyId);
    SE05X.writeRSAKey(KeyId,
                      kSE05x_RSABitLength_3072,
                      NULL,
                      0,
                      NULL,
                      0,
                      NULL,
                      0,
                      NULL,
                      0,
                      NULL,
                      0,
                      &e[i][0],
                      E_LEN,
                      &d[i][0],
                      D_LEN,
                      n,
                      N_LEN,
                      kSE05x_RSAKeyFormat_RAW,
                      false,
                      kSE05x_KeyPart_Pair,
                      NULL);

    Serial.println("");
    Serial.print("Test ");
    Serial.println((i+1));

    // print the input
    Serial.print("Input is:                     ");
    printBufferHex(&msg[i][0], MSG_LEN);

    //calculate the input hash
    hashLen = HASH_LEN;
    SE05X.beginSHA512();
    SE05X.updateSHA512(&msg[i][0], MSG_LEN);
    SE05X.endSHA512(hash, &hashLen);

    Serial.print("Input SHA512 is:              ");
    printBufferHex(hash, hashLen);

    emsaLen = S_LEN;
    if(SALT_LEN == 0 && saltVal[i][0] == 0){
      SE05X.emsa_pss_encode(hash, hashLen, emsa, &emsaLen, kSE05x_RSASignatureAlgo_SHA512_PKCS1_PSS, kSE05x_RSABitLength_3072, NULL, SALT_LEN);
    }else{
      SE05X.emsa_pss_encode(hash, hashLen, emsa, &emsaLen, kSE05x_RSASignatureAlgo_SHA512_PKCS1_PSS, kSE05x_RSABitLength_3072, &saltVal[i][0], SALT_LEN);
    }
    Serial.print("emsa is:                     ");
    printBufferHex(emsa, emsaLen);

    // calculate the signature
    signatureLen = 0;
    SE05X.SignRSA(KeyId, emsa, emsaLen, signature, sizeof(signature), &signatureLen);

    // print the signature
    Serial.print("Signature using KeyId ");
    Serial.print(KeyId);
    Serial.print(" is: ");
    printBufferHex(signature, signatureLen);
    Serial.println();
    
    // To make the signature verifcation + the signature comparison fail, uncomment the next line:
    //signature[0] = 0x00;
    if(signatureLen == S_LEN){
      if(memcmp(&s[i][0],signature,signatureLen) == 0){
        Serial.println("SE050 Generated Signature matches test vector");
      }else{
        Serial.println("SE050 Generated Signature does not match test vector");
        Serial.print("Signature from test vector: ");
        printBufferHex(&s[i][0], S_LEN);
      }
    }else{
      Serial.println("SE050 Generated Signature does not match test vector");
      Serial.print("Signature from test vector: ");
      printBufferHex(&s[i][0], S_LEN);
    }


    // To make the signature verifcation fail, uncomment the next line:
    //signature[0] = 0x00;

    // validate the signature
    if (SE05X.VerifyRSASSA_PSS(KeyId, hash, hashLen, &s[i][0], S_LEN)){
      Serial.println("test vector Verified");
      if(result[i]){
        Serial.println("---TEST PASSED---");
      }else{
        Serial.println("---TEST FAILED---");
      }
    }
    else
    {
      Serial.println("failed to verify test vector");
      if(!result[i]){
        Serial.println("---TEST PASSED---");
      }else{
        Serial.println("---TEST FAILED---");
      }
    }
  }

  SE05X.deleteBinaryObject(KeyId);
}


void loop() {

}
