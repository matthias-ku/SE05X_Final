#include <SE05X.h>

// CAVS 11.1
const char currentTest[] = "FIPS186-3 - SigVerPSS_186-3 RSASSA-PSS: Mod Size 3072 with SHA-256(Salt len: 0)";

#define SHA1_LENGTH                 20
#define SHA224_LENGTH               28
#define SHA256_LENGTH               32
#define SHA384_LENGTH               48
#define SHA512_LENGTH               64

#define E_LEN                       4
#define N_LEN                       384
#define D_LEN                       384

#define S_LEN                       N_LEN
#define MSG_LEN                     128
#define HASH_LEN                    SHA256_LENGTH
#define SALT_LEN                    0 //Empty salt

// RSA Modulus (n)
const byte n[] = {0xce, 0x49, 0x24, 0xff, 0x47, 0x0f, 0xb9, 0x9d, 0x17, 0xf6, 0x65, 0x95, 0x56,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 0x60, 0x7b}; // Length: 384 bytes

// Public Exponent (e)
const byte e[6][4] = {
    {0x00, 0xfe, 0x30, 0x79},
    {0x00, 0x73, 0xb1, 0x93},
    {0x00, 0x73, 0xb1, 0x93},
    {0x00, 0x73, 0xb1, 0x93},
    {0x00, 0x73, 0xb1, 0x93},
    {0x00, 0x73, 0xb1, 0x93}
}; // 6 vectors, each of max length 4 bytes

// Private Exponent (d)
const byte d[6][384] = {
    {0x25, 0x8f, 0x08, 0x40, 0x36, 0xb7, 0xff, 0xda, 0x1d, 0x0a, 0xa0, 0x37, 0x3a,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 0xa5, 0xbb},
    {0x25, 0x8f, 0x08, 0x40, 0x36, 0xb7, 0xff, 0xda, 0x1d, 0x0a, 0xa0, 0x37, 0x3a,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 0xa5, 0xbb},
    {0x25, 0x8f, 0x08, 0x40, 0x36, 0xb7, 0xff, 0xda, 0x1d, 0x0a, 0xa0, 0x37, 0x3a,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 0xa5, 0xbb},
    {0x25, 0x8f, 0x08, 0x40, 0x36, 0xb7, 0xff, 0xda, 0x1d, 0x0a, 0xa0, 0x37, 0x3a,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 0xa5, 0xbb},
    {0x25, 0x8f, 0x08, 0x40, 0x36, 0xb7, 0xff, 0xda, 0x1d, 0x0a, 0xa0, 0x37, 0x3a,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 0xa5, 0xbb},
    {0x25, 0x8f, 0x08, 0x40, 0x36, 0xb7, 0xff, 0xda, 0x1d, 0x0a, 0xa0, 0x37, 0x3a,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 0xa5, 0xbb}
}; // 6 vectors, each of max length 384 bytes

// Messages (msg)
const byte msg[6][128] = {
    {0xe4, 0x9f, 0x58, 0x5e, 0xec, 0xcf, 0x2b, 0xf7, 0x26, 0x56, 0x41, 0xfb, 0x8c,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 0x55, 0x7f},
    {0x46, 0x21, 0xb1, 0x7c, 0xd9, 0xf5, 0xb6, 0x23, 0xfe, 0x73, 0xb5, 0xfe, 0x28,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 0xe7, 0x9c},
    {0x08, 0x97, 0xd4, 0x0e, 0x7c, 0x0f, 0x2d, 0xfc, 0x07, 0xb0, 0xc7, 0xfd, 0xda,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 0x4d, 0x23},
    {0x78, 0x67, 0xb6, 0x5e, 0xd9, 0x82, 0xed, 0x6c, 0xdd, 0x2d, 0x06, 0x11, 0x57,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 0x48, 0xd4},
    {0x4d, 0x36, 0xeb, 0x2c, 0x3a, 0xd2, 0x33, 0x43, 0x69, 0x23, 0xe5, 0x80, 0xfa,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 0xfc, 0xb2},
    {0xe2, 0xa9, 0x2b, 0x14, 0x3c, 0x8a, 0x00, 0x6c, 0xee, 0x8a, 0xfe, 0xbb, 0x66,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 0x20, 0x48}
}; // 6 vectors, each of max length 128 bytes

// Signatures (s)
const byte s[6][384] = {
    {0x4e, 0x85, 0xf6, 0x8a, 0x5b, 0x06, 0xb0, 0x6a, 0x17, 0xd0, 0xf3, 0xf2, 0x7b,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 0x6c, 0x83},
    {0xb6, 0x0a, 0x4d, 0xd6, 0x29, 0xd6, 0x03, 0x0f, 0xe6, 0x52, 0x2f, 0x6b, 0x75,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 0x92, 0xd4},
    {0x8e, 0xbe, 0xd0, 0x02, 0xd4, 0xf5, 0x4d, 0xe5, 0x89, 0x8a, 0x5f, 0x2e, 0x69,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 0xf8, 0x48},
    {0x0a, 0x61, 0x70, 0x81, 0xdd, 0x97, 0x94, 0xc9, 0x37, 0xe4, 0xc7, 0x16, 0x3e,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 0xc6, 0xe6},
    {0x81, 0x38, 0x92, 0x2f, 0xd1, 0xa8, 0x73, 0x33, 0xf1, 0x31, 0x6e, 0x20, 0x7e,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 0x7e, 0xf1},
    {0xc8, 0x1a, 0xc3, 0x94, 0xf8, 0x2c, 0xb2, 0x7d, 0x75, 0x95, 0x07, 0x59, 0x22,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 0xb3, 0x98}
}; // 6 vectors, each of max length 384 bytes

// Salt Value (SaltVal)
uint8_t saltVal[6][1] = {
    {0x00},
    {0x00},
    {0x00},
    {0x00},
    {0x00},
    {0x00}
}; // 6 vectors, each of max length 1 bytes

// Expected results
bool result[] = { 0, 0, 1, 0, 0, 0 };
const int num_vectors = 6; // Number of test vectors

void printBufferHex(const byte input[], size_t inputLength)
{
  for (size_t i = 0; i < inputLength; i++) {
    Serial.print(input[i] >> 4, HEX);
    Serial.print(input[i] & 0x0f, HEX);
    Serial.print(",");
  }
  Serial.println();
}

void setup() {
  Serial.begin(9600);
  while (!Serial);

  if (!SE05X.begin()) {
    Serial.println("Failed to communicate with SE05X!");
    while (1);
  }

  Serial.println(currentTest);

  byte hash[HASH_LEN] = {0};
  size_t hashLen = HASH_LEN;
  byte emsa[N_LEN] = {0};
  size_t emsaLen = N_LEN;
  byte signature[N_LEN] = {0};
  size_t signatureLen = 0;

  const int KeyId = 9996;
  for(int i = 0; i < num_vectors; i++){

    SE05X.deleteBinaryObject(KeyId);
    SE05X.writeRSAKey(KeyId,
                      kSE05x_RSABitLength_3072,
                      NULL,
                      0,
                      NULL,
                      0,
                      NULL,
                      0,
                      NULL,
                      0,
                      NULL,
                      0,
                      &e[i][0],
                      E_LEN,
                      &d[i][0],
                      D_LEN,
                      n,
                      N_LEN,
                      kSE05x_RSAKeyFormat_RAW,
                      false,
                      kSE05x_KeyPart_Pair,
                      NULL);

    Serial.println("");
    Serial.print("Test ");
    Serial.println((i+1));

    // print the input
    Serial.print("Input is:                     ");
    printBufferHex(&msg[i][0], MSG_LEN);

    //calculate the input hash
    hashLen = HASH_LEN;
    SE05X.beginSHA256();
    SE05X.updateSHA256(&msg[i][0], MSG_LEN);
    SE05X.endSHA256(hash, &hashLen);

    Serial.print("Input SHA256 is:              ");
    printBufferHex(hash, hashLen);

    emsaLen = S_LEN;
    if(SALT_LEN == 0 && saltVal[i][0] == 0){
      SE05X.emsa_pss_encode(hash, hashLen, emsa, &emsaLen, kSE05x_RSASignatureAlgo_SHA256_PKCS1_PSS, kSE05x_RSABitLength_3072, NULL, SALT_LEN);
    }else{
      SE05X.emsa_pss_encode(hash, hashLen, emsa, &emsaLen, kSE05x_RSASignatureAlgo_SHA256_PKCS1_PSS, kSE05x_RSABitLength_3072, &saltVal[i][0], SALT_LEN);
    }
    Serial.print("emsa is:                     ");
    printBufferHex(emsa, emsaLen);

    // calculate the signature
    signatureLen = 0;
    SE05X.SignRSA(KeyId, emsa, emsaLen, signature, sizeof(signature), &signatureLen);

    // print the signature
    Serial.print("Signature using KeyId ");
    Serial.print(KeyId);
    Serial.print(" is: ");
    printBufferHex(signature, signatureLen);
    Serial.println();
    
    // To make the signature verifcation + the signature comparison fail, uncomment the next line:
    //signature[0] = 0x00;
    if(signatureLen == S_LEN){
      if(memcmp(&s[i][0],signature,signatureLen) == 0){
        Serial.println("SE050 Generated Signature matches test vector");
      }else{
        Serial.println("SE050 Generated Signature does not match test vector");
        Serial.print("Signature from test vector: ");
        printBufferHex(&s[i][0], S_LEN);
      }
    }else{
      Serial.println("SE050 Generated Signature does not match test vector");
      Serial.print("Signature from test vector: ");
      printBufferHex(&s[i][0], S_LEN);
    }


    // To make the signature verifcation fail, uncomment the next line:
    //signature[0] = 0x00;

    // validate the signature
    if (SE05X.VerifyRSASSA_PSS(KeyId, hash, hashLen, &s[i][0], S_LEN)){
      Serial.println("test vector Verified");
      if(result[i]){
        Serial.println("---TEST PASSED---");
      }else{
        Serial.println("---TEST FAILED---");
      }
    }
    else
    {
      Serial.println("failed to verify test vector");
      if(!result[i]){
        Serial.println("---TEST PASSED---");
      }else{
        Serial.println("---TEST FAILED---");
      }
    }
  }

  SE05X.deleteBinaryObject(KeyId);
}


void loop() {

}
