#include <SE05X.h>

// CAVS 11.1
const char currentTest[] = "FIPS186-3 - SigVerPSS_186-3 RSASSA-PSS: Mod Size 1024 with SHA-512(Salt len: 20)";

#define SHA1_LENGTH                 20
#define SHA224_LENGTH               28
#define SHA256_LENGTH               32
#define SHA384_LENGTH               48
#define SHA512_LENGTH               64

#define E_LEN                       4
#define N_LEN                       128
#define D_LEN                       128

#define S_LEN                       N_LEN
#define MSG_LEN                     128
#define HASH_LEN                    SHA512_LENGTH
#define SALT_LEN                    20


// RSA Modulus (n)
const byte n[] = {0xda, 0xb9, 0xc7, 0xd2, 0x8a, 0x2b, 0x1e, 0x49, 0x95, 0xc1, 0x2b, 0xca, 0xe3,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 0x90, 0x71}; // Length: 128 bytes

// Public Exponent (e)
const byte e[6][4] = {
    {0x00, 0x7b, 0x82, 0x67},
    {0x00, 0x7b, 0x82, 0x67},
    {0x00, 0x7b, 0x82, 0x67},
    {0x00, 0x7b, 0x82, 0x67},
    {0x00, 0x7b, 0x82, 0x67},
    {0x00, 0x54, 0x12, 0x8d}
}; // 6 vectors, each of max length 4 bytes

// Private Exponent (d)
const byte d[6][128] = {
    {0x16, 0xe1, 0x9c, 0x15, 0x3e, 0x5b, 0x0b, 0x0a, 0xaa, 0x28, 0x87, 0xb5, 0xef,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 0x04, 0x1f},
    {0x16, 0xe1, 0x9c, 0x15, 0x3e, 0x5b, 0x0b, 0x0a, 0xaa, 0x28, 0x87, 0xb5, 0xef,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 0x04, 0x1f},
    {0x16, 0xe1, 0x9c, 0x15, 0x3e, 0x5b, 0x0b, 0x0a, 0xaa, 0x28, 0x87, 0xb5, 0xef,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 0x04, 0x1f},
    {0x16, 0xe1, 0x9c, 0x15, 0x3e, 0x5b, 0x0b, 0x0a, 0xaa, 0x28, 0x87, 0xb5, 0xef,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 0x04, 0x1f},
    {0x16, 0xe1, 0x9c, 0x15, 0x3e, 0x5b, 0x0b, 0x0a, 0xaa, 0x28, 0x87, 0xb5, 0xef,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 0x04, 0x1f},
    {0x16, 0xe1, 0x9c, 0x15, 0x3e, 0x5b, 0x0b, 0x0a, 0xaa, 0x28, 0x87, 0xb5, 0xef,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 0x04, 0x1f}
}; // 6 vectors, each of max length 128 bytes

// Messages (msg)
const byte msg[6][128] = {
    {0xb8, 0x02, 0x71, 0xb3, 0xef, 0x26, 0xef, 0xb5, 0xb0, 0xca, 0x8e, 0x80, 0x9b,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 0xcb, 0x79},
    {0xca, 0x69, 0xf7, 0x3a, 0x1e, 0x17, 0x31, 0x07, 0x89, 0xa6, 0x55, 0x61, 0x63,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 0x37, 0x1d},
    {0xaa, 0xa2, 0x80, 0xf5, 0x1d, 0xfd, 0x88, 0xd1, 0xe7, 0xc7, 0xf0, 0x88, 0x34,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 0xc6, 0x6f},
    {0x51, 0x2d, 0xcd, 0xc3, 0x0e, 0x9a, 0xe2, 0xb6, 0xe4, 0x4a, 0x77, 0x3e, 0xaf,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 0x97, 0xd9},
    {0xaa, 0xe7, 0xe0, 0x1a, 0x6e, 0x1a, 0x10, 0x70, 0xfb, 0x04, 0xdb, 0xaf, 0x97,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 0x4a, 0xe5},
    {0x0c, 0x5f, 0x5f, 0xa2, 0x83, 0x97, 0x25, 0x4f, 0xc6, 0x2d, 0x7e, 0x2c, 0xb1,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 0x51, 0xce}
}; // 6 vectors, each of max length 128 bytes

// Signatures (s)
const byte s[6][128] = {
    {0x2d, 0xb6, 0x1e, 0xba, 0xca, 0x89, 0xec, 0xde, 0x29, 0xa2, 0x89, 0x5f, 0x21,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 0x0a, 0x70},
    {0xb8, 0x45, 0x9c, 0x62, 0xf5, 0xdc, 0x84, 0x8a, 0x47, 0xe7, 0x38, 0x37, 0xc3,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 0xf5, 0x8b},
    {0x57, 0x0c, 0x0e, 0xec, 0xf6, 0x11, 0xc3, 0x44, 0x33, 0xdf, 0x2f, 0x79, 0xb6,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 0x5c, 0x14},
    {0xb1, 0x9f, 0x58, 0xf4, 0x37, 0x4c, 0xc0, 0x21, 0x35, 0xeb, 0x3a, 0xae, 0x53,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 0x6c, 0xb6},
    {0x29, 0x35, 0xb1, 0x5f, 0xc9, 0xd8, 0xf8, 0xda, 0xcf, 0x91, 0x2f, 0x82, 0x8c,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 0x67, 0xc9},
    {0x25, 0x96, 0xaa, 0xbc, 0x29, 0x78, 0xbd, 0x62, 0xda, 0x57, 0xc4, 0x86, 0x17,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 0x0e, 0x0e}
}; // 6 vectors, each of max length 128 bytes

// Salt Value (SaltVal)
uint8_t saltVal[6][20] = {
    {0xd4, 0x4b, 0xee, 0x9e, 0xb3, 0x35, 0xdc, 0x0f, 0xee, 0x17, 0xbb, 0x22, 0xe8, 0xdc, 0x9c, 0x35, 0xce, 0x06, 0xc5, 0x04},
    {0xd4, 0x4b, 0xee, 0x9e, 0xb3, 0x35, 0xdc, 0x0f, 0xee, 0x17, 0xbb, 0x22, 0xe8, 0xdc, 0x9c, 0x35, 0xce, 0x06, 0xc5, 0x04},
    {0xd4, 0x4b, 0xee, 0x9e, 0xb3, 0x35, 0xdc, 0x0f, 0xee, 0x17, 0xbb, 0x22, 0xe8, 0xdc, 0x9c, 0x35, 0xce, 0x06, 0xc5, 0x04},
    {0xd4, 0x4b, 0xee, 0x9e, 0xb3, 0x35, 0xdc, 0x0f, 0xee, 0x17, 0xbb, 0x22, 0xe8, 0xdc, 0x9c, 0x35, 0xce, 0x06, 0xc5, 0x04},
    {0xd4, 0x4b, 0xee, 0x9e, 0xb3, 0x35, 0xdc, 0x0f, 0xee, 0x17, 0xbb, 0x22, 0xe8, 0xdc, 0x9c, 0x35, 0xce, 0x06, 0xc5, 0x04},
    {0xd4, 0x4b, 0xee, 0x9e, 0xb3, 0x35, 0xdc, 0x0f, 0xee, 0x17, 0xbb, 0x22, 0xe8, 0xdc, 0x9c, 0x35, 0xce, 0x06, 0xc5, 0x04}
}; // 6 vectors, each of max length 20 bytes

// Expected results
bool result[] = { 1, 0, 0, 0, 0, 0 };

const int num_vectors = 6; // Number of test vectors

void printBufferHex(const byte input[], size_t inputLength)
{
  for (size_t i = 0; i < inputLength; i++) {
    Serial.print(input[i] >> 4, HEX);
    Serial.print(input[i] & 0x0f, HEX);
    Serial.print(",");
  }
  Serial.println();
}

void setup() {
  Serial.begin(9600);
  while (!Serial);

  if (!SE05X.begin()) {
    Serial.println("Failed to communicate with SE05X!");
    while (1);
  }

  Serial.println(currentTest);

  byte hash[HASH_LEN] = {0};
  size_t hashLen = HASH_LEN;
  byte emsa[N_LEN] = {0};
  size_t emsaLen = N_LEN;
  byte signature[N_LEN] = {0};
  size_t signatureLen = 0;

  const int KeyId = 9996;
  for(int i = 0; i < num_vectors; i++){

    SE05X.deleteBinaryObject(KeyId);
    SE05X.writeRSAKey(KeyId,
                      kSE05x_RSABitLength_1024,
                      NULL,
                      0,
                      NULL,
                      0,
                      NULL,
                      0,
                      NULL,
                      0,
                      NULL,
                      0,
                      &e[i][0],
                      E_LEN,
                      &d[i][0],
                      D_LEN,
                      n,
                      N_LEN,
                      kSE05x_RSAKeyFormat_RAW,
                      false,
                      kSE05x_KeyPart_Pair,
                      NULL);

    Serial.println("");
    Serial.print("Test ");
    Serial.println((i+1));

    // print the input
    Serial.print("Input is:                     ");
    printBufferHex(&msg[i][0], MSG_LEN);

    //calculate the input hash
    hashLen = HASH_LEN;
    SE05X.beginSHA512();
    SE05X.updateSHA512(&msg[i][0], MSG_LEN);
    SE05X.endSHA512(hash, &hashLen);

    Serial.print("Input SHA512 is:              ");
    printBufferHex(hash, hashLen);

    emsaLen = S_LEN;
    SE05X.emsa_pss_encode(hash, hashLen, emsa, &emsaLen, kSE05x_RSASignatureAlgo_SHA512_PKCS1_PSS, kSE05x_RSABitLength_1024, &saltVal[i][0], SALT_LEN);
    Serial.print("emsa is:                     ");
    printBufferHex(emsa, emsaLen);

    // calculate the signature
    signatureLen = 0;
    SE05X.SignRSA(KeyId, emsa, emsaLen, signature, sizeof(signature), &signatureLen);

    // print the signature
    Serial.print("Signature using KeyId ");
    Serial.print(KeyId);
    Serial.print(" is: ");
    printBufferHex(signature, signatureLen);
    Serial.println();
    
    // To make the signature verifcation + the signature comparison fail, uncomment the next line:
    //signature[0] = 0x00;
    if(signatureLen == S_LEN){
      if(memcmp(&s[i][0],signature,signatureLen) == 0){
        Serial.println("SE050 Generated Signature matches test vector");
      }else{
        Serial.println("SE050 Generated Signature does not match test vector");
        Serial.print("Signature from test vector: ");
        printBufferHex(&s[i][0], S_LEN);
      }
    }else{
      Serial.println("SE050 Generated Signature does not match test vector");
      Serial.print("Signature from test vector: ");
      printBufferHex(&s[i][0], S_LEN);
    }


    // To make the signature verifcation fail, uncomment the next line:
    //signature[0] = 0x00;

    // validate the signature
    if (SE05X.VerifyRSASSA_PSS(KeyId, hash, hashLen, &s[i][0], S_LEN)){
      Serial.println("test vector Verified");
      if(result[i]){
        Serial.println("---TEST PASSED---");
      }else{
        Serial.println("---TEST FAILED---");
      }
    }
    else
    {
      Serial.println("failed to verify test vector");
      if(!result[i]){
        Serial.println("---TEST PASSED---");
      }else{
        Serial.println("---TEST FAILED---");
      }
    }
  }

  SE05X.deleteBinaryObject(KeyId);
}


void loop() {

}
