#include <SE05X.h>

// CAVS 11.1
const char currentTest[] = "FIPS186-3 - SigVerPSS_186-3 RSASSA-PSS: Mod Size 2048 with SHA-512(Salt len: 64)";

#define SHA1_LENGTH                 20
#define SHA224_LENGTH               28
#define SHA256_LENGTH               32
#define SHA384_LENGTH               48
#define SHA512_LENGTH               64

#define E_LEN                       4
#define N_LEN                       256
#define D_LEN                       256

#define S_LEN                       N_LEN
#define MSG_LEN                     128
#define HASH_LEN                    SHA512_LENGTH
#define SALT_LEN                    64

// RSA Modulus (n)
const byte n[] = {0xa6, 0x77, 0x52, 0x5e, 0x1a, 0x69, 0x54, 0x6a, 0x96, 0xdc, 0x7b, 0x11, 0x23,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 0x9f, 0xcb}; // Length: 256 bytes

// Public Exponent (e)
const byte e[6][4] = {
    {0x00, 0xea, 0xc8, 0x39},
    {0x00, 0x8d, 0x88, 0x53},
    {0x00, 0x8d, 0x88, 0x53},
    {0x00, 0x8d, 0x88, 0x53},
    {0x00, 0x8d, 0x88, 0x53},
    {0x00, 0x8d, 0x88, 0x53}
}; // 6 vectors, each of max length 4 bytes

// Private Exponent (d)
const byte d[6][256] = {
    {0x30, 0x8a, 0xc0, 0x77, 0x99, 0x16, 0x68, 0x03, 0x4f, 0xe0, 0x53, 0xc0, 0xc0,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 0x30, 0x0f},
    {0x30, 0x8a, 0xc0, 0x77, 0x99, 0x16, 0x68, 0x03, 0x4f, 0xe0, 0x53, 0xc0, 0xc0,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 0x30, 0x0f},
    {0x30, 0x8a, 0xc0, 0x77, 0x99, 0x16, 0x68, 0x03, 0x4f, 0xe0, 0x53, 0xc0, 0xc0,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 0x30, 0x0f},
    {0x30, 0x8a, 0xc0, 0x77, 0x99, 0x16, 0x68, 0x03, 0x4f, 0xe0, 0x53, 0xc0, 0xc0,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 0x30, 0x0f},
    {0x30, 0x8a, 0xc0, 0x77, 0x99, 0x16, 0x68, 0x03, 0x4f, 0xe0, 0x53, 0xc0, 0xc0,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 0x30, 0x0f},
    {0x30, 0x8a, 0xc0, 0x77, 0x99, 0x16, 0x68, 0x03, 0x4f, 0xe0, 0x53, 0xc0, 0xc0,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 0x30, 0x0f}
}; // 6 vectors, each of max length 256 bytes

// Messages (msg)
const byte msg[6][128] = {
    {0x9c, 0x3d, 0x5d, 0x23, 0xd2, 0x74, 0x6d, 0x15, 0xd6, 0x16, 0xbe, 0xbf, 0x3c,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 0xb1, 0x35},
    {0x77, 0x59, 0x42, 0x0c, 0x8d, 0x1a, 0x39, 0xba, 0x0e, 0x3e, 0x16, 0x81, 0xd9,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 0x76, 0x7d},
    {0x86, 0x4f, 0x4f, 0x58, 0x90, 0xa0, 0x36, 0x53, 0xd0, 0x8d, 0xaa, 0x83, 0xd9,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 0x2d, 0x5e},
    {0x71, 0xab, 0xf8, 0x95, 0xe5, 0x6b, 0xa8, 0xf6, 0xae, 0x8d, 0x0e, 0x9e, 0x66,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 0xe4, 0x72},
    {0x4b, 0x64, 0x8d, 0xe2, 0xe3, 0x90, 0x67, 0x7c, 0xe1, 0x72, 0x71, 0x91, 0x49,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 0x2c, 0x3e},
    {0x78, 0x11, 0xa4, 0x07, 0xfe, 0x65, 0x3a, 0xd2, 0x34, 0x3d, 0x83, 0xc0, 0x49,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 0xf8, 0xec}
}; // 6 vectors, each of max length 128 bytes

// Signatures (s)
const byte s[6][256] = {
    {0x98, 0x65, 0x7f, 0xd8, 0x16, 0x39, 0x67, 0xfa, 0x7d, 0x26, 0x3b, 0xd4, 0x5b,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 0xf7, 0xbc},
    {0x91, 0xce, 0x8e, 0x92, 0x1f, 0x85, 0xde, 0x84, 0x5b, 0x9b, 0xf7, 0x50, 0x3d,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 0x82, 0x21},
    {0x24, 0x5f, 0xda, 0x2e, 0x66, 0xd2, 0xba, 0xb1, 0x02, 0xd0, 0xda, 0x40, 0x98,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 0x55, 0x74},
    {0x24, 0x3c, 0x57, 0x0c, 0xd1, 0xbd, 0x85, 0x52, 0x2e, 0x64, 0x81, 0x73, 0x61,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 0x47, 0x98},
    {0x27, 0x7f, 0xe8, 0x1a, 0x15, 0x40, 0x34, 0x1c, 0x9c, 0x04, 0xfb, 0x5d, 0x3c,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 0x12, 0x99},
    {0x3a, 0xd1, 0xf0, 0xfa, 0xa9, 0xa3, 0x65, 0x86, 0x15, 0x4a, 0x38, 0x2a, 0x1f,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 0x83, 0x1d}
}; // 6 vectors, each of max length 256 bytes

// Salt Value (SaltVal)
uint8_t saltVal[6][64] = {
    {0xe5, 0x36, 0xe4, 0x67, 0xed, 0x1f, 0x6a, 0x54, 0xea, 0x19, 0xeb, 0xc7, 0xeb,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 0x82, 0x45},
    {0xe5, 0x36, 0xe4, 0x67, 0xed, 0x1f, 0x6a, 0x54, 0xea, 0x19, 0xeb, 0xc7, 0xeb,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 0x82, 0x45},
    {0xe5, 0x36, 0xe4, 0x67, 0xed, 0x1f, 0x6a, 0x54, 0xea, 0x19, 0xeb, 0xc7, 0xeb,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 0x82, 0x45},
    {0xe5, 0x36, 0xe4, 0x67, 0xed, 0x1f, 0x6a, 0x54, 0xea, 0x19, 0xeb, 0xc7, 0xeb,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 0x82, 0x45},
    {0xe5, 0x36, 0xe4, 0x67, 0xed, 0x1f, 0x6a, 0x54, 0xea, 0x19, 0xeb, 0xc7, 0xeb,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 0x82, 0x45},
    {0xe5, 0x36, 0xe4, 0x67, 0xed, 0x1f, 0x6a, 0x54, 0xea, 0x19, 0xeb, 0xc7, 0xeb,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 0x82, 0x45}
}; // 6 vectors, each of max length 64 bytes

// Expected results
bool result[] = { 0, 0, 0, 0, 0, 1 };
const int num_vectors = 6; // Number of test vectors

void printBufferHex(const byte input[], size_t inputLength)
{
  for (size_t i = 0; i < inputLength; i++) {
    Serial.print(input[i] >> 4, HEX);
    Serial.print(input[i] & 0x0f, HEX);
    Serial.print(",");
  }
  Serial.println();
}

void setup() {
  Serial.begin(9600);
  while (!Serial);

  if (!SE05X.begin()) {
    Serial.println("Failed to communicate with SE05X!");
    while (1);
  }

  Serial.println(currentTest);

  byte hash[HASH_LEN] = {0};
  size_t hashLen = HASH_LEN;
  byte emsa[N_LEN] = {0};
  size_t emsaLen = N_LEN;
  byte signature[N_LEN] = {0};
  size_t signatureLen = 0;

  const int KeyId = 9996;
  for(int i = 0; i < num_vectors; i++){

    SE05X.deleteBinaryObject(KeyId);
    SE05X.writeRSAKey(KeyId,
                      kSE05x_RSABitLength_2048,
                      NULL,
                      0,
                      NULL,
                      0,
                      NULL,
                      0,
                      NULL,
                      0,
                      NULL,
                      0,
                      &e[i][0],
                      E_LEN,
                      &d[i][0],
                      D_LEN,
                      n,
                      N_LEN,
                      kSE05x_RSAKeyFormat_RAW,
                      false,
                      kSE05x_KeyPart_Pair,
                      NULL);

    Serial.println("");
    Serial.print("Test ");
    Serial.println((i+1));

    // print the input
    Serial.print("Input is:                     ");
    printBufferHex(&msg[i][0], MSG_LEN);

    //calculate the input hash
    hashLen = HASH_LEN;
    SE05X.beginSHA512();
    SE05X.updateSHA512(&msg[i][0], MSG_LEN);
    SE05X.endSHA512(hash, &hashLen);

    Serial.print("Input SHA512 is:              ");
    printBufferHex(hash, hashLen);

    emsaLen = S_LEN;
    SE05X.emsa_pss_encode(hash, hashLen, emsa, &emsaLen, kSE05x_RSASignatureAlgo_SHA512_PKCS1_PSS, kSE05x_RSABitLength_2048, &saltVal[i][0], SALT_LEN);
    Serial.print("emsa is:                     ");
    printBufferHex(emsa, emsaLen);

    // calculate the signature
    signatureLen = 0;
    SE05X.SignRSA(KeyId, emsa, emsaLen, signature, sizeof(signature), &signatureLen);

    // print the signature
    Serial.print("Signature using KeyId ");
    Serial.print(KeyId);
    Serial.print(" is: ");
    printBufferHex(signature, signatureLen);
    Serial.println();
    
    // To make the signature verifcation + the signature comparison fail, uncomment the next line:
    //signature[0] = 0x00;
    if(signatureLen == S_LEN){
      if(memcmp(&s[i][0],signature,signatureLen) == 0){
        Serial.println("SE050 Generated Signature matches test vector");
      }else{
        Serial.println("SE050 Generated Signature does not match test vector");
        Serial.print("Signature from test vector: ");
        printBufferHex(&s[i][0], S_LEN);
      }
    }else{
      Serial.println("SE050 Generated Signature does not match test vector");
      Serial.print("Signature from test vector: ");
      printBufferHex(&s[i][0], S_LEN);
    }


    // To make the signature verifcation fail, uncomment the next line:
    //signature[0] = 0x00;

    // validate the signature
    if (SE05X.VerifyRSASSA_PSS(KeyId, hash, hashLen, &s[i][0], S_LEN)){
      Serial.println("test vector Verified");
      if(result[i]){
        Serial.println("---TEST PASSED---");
      }else{
        Serial.println("---TEST FAILED---");
      }
    }
    else
    {
      Serial.println("failed to verify test vector");
      if(!result[i]){
        Serial.println("---TEST PASSED---");
      }else{
        Serial.println("---TEST FAILED---");
      }
    }
  }

  SE05X.deleteBinaryObject(KeyId);
}


void loop() {

}
